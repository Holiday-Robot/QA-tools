VERSION ""

NS_ :

BS_:

BU_: HETC_M_MOB HETC_M_WST HETC_L_ARM HETC_L_TACT HETC_R_ARM HETC_R_TACT HMDH_201 HMDH_202 HMDH_203 HMDH_204 HMDH_205 HMDH_206 HMDH_207

BO_ 2163313871 STATUS_HETC_R_ARM_to_HMDH_207: 48 HETC_R_ARM
 SG_ SubCode M : 0|8@1+ (1,0) [0|0] "" HMDH_207
 SG_ Ping_CanId m5 : 8|8@1+ (1,0) [0|0] "" HMDH_207
 SG_ Ping_HostId m5 : 16|8@1+ (1,0) [0|0] "" HMDH_207
 SG_ Ping_Pid m5 : 24|16@1+ (1,0) [0|0] "" HMDH_207
 SG_ Ping_Bid m5 : 40|16@1+ (1,0) [0|0] "" HMDH_207
 SG_ Ping_Mid m5 : 56|16@1+ (1,0) [0|0] "" HMDH_207
 SG_ Ping_VerMajor m5 : 72|8@1+ (1,0) [0|0] "" HMDH_207
 SG_ Ping_VerMinor m5 : 80|8@1+ (1,0) [0|0] "" HMDH_207
 SG_ Ping_VerPatch m5 : 88|8@1+ (1,0) [0|0] "" HMDH_207
 SG_ Ping_Name0 m5 : 96|8@1+ (1,0) [0|0] "" HMDH_207
 SG_ Ping_Name1 m5 : 104|8@1+ (1,0) [0|0] "" HMDH_207
 SG_ Ping_Name2 m5 : 112|8@1+ (1,0) [0|0] "" HMDH_207
 SG_ Ping_Name3 m5 : 120|8@1+ (1,0) [0|0] "" HMDH_207
 SG_ Ping_Name4 m5 : 128|8@1+ (1,0) [0|0] "" HMDH_207
 SG_ Ping_Name5 m5 : 136|8@1+ (1,0) [0|0] "" HMDH_207
 SG_ Ping_Name6 m5 : 144|8@1+ (1,0) [0|0] "" HMDH_207
 SG_ Ping_Name7 m5 : 152|8@1+ (1,0) [0|0] "" HMDH_207
 SG_ Ping_Name8 m5 : 160|8@1+ (1,0) [0|0] "" HMDH_207
 SG_ Ping_Name9 m5 : 168|8@1+ (1,0) [0|0] "" HMDH_207
 SG_ Ping_Name10 m5 : 176|8@1+ (1,0) [0|0] "" HMDH_207
 SG_ Ping_Name11 m5 : 184|8@1+ (1,0) [0|0] "" HMDH_207
 SG_ Ping_Name12 m5 : 192|8@1+ (1,0) [0|0] "" HMDH_207
 SG_ Ping_Name13 m5 : 200|8@1+ (1,0) [0|0] "" HMDH_207
 SG_ Ping_Name14 m5 : 208|8@1+ (1,0) [0|0] "" HMDH_207
 SG_ Ping_Name15 m5 : 216|8@1+ (1,0) [0|0] "" HMDH_207
 SG_ Ping_FmtVer m5 : 224|8@1+ (1,0) [0|0] "" HMDH_207
 SG_ Ping_GitRev m5 : 232|32@1+ (1,0) [0|0] "" HMDH_207
 SG_ Ping_FwCrc m5 : 264|16@1+ (1,0) [0|0] "" HMDH_207
 SG_ Ping_UptimeS m5 : 280|16@1+ (1,0) [0|0] "s" HMDH_207
 SG_ Ecat_CanId m31 : 8|8@1+ (1,0) [0|0] "" HMDH_207
 SG_ Ecat_Name0 m31 : 16|8@1+ (1,0) [0|0] "" HMDH_207
 SG_ Ecat_Name1 m31 : 24|8@1+ (1,0) [0|0] "" HMDH_207
 SG_ Ecat_Name2 m31 : 32|8@1+ (1,0) [0|0] "" HMDH_207
 SG_ Ecat_Name3 m31 : 40|8@1+ (1,0) [0|0] "" HMDH_207
 SG_ Ecat_Name4 m31 : 48|8@1+ (1,0) [0|0] "" HMDH_207
 SG_ Ecat_Name5 m31 : 56|8@1+ (1,0) [0|0] "" HMDH_207
 SG_ Ecat_Name6 m31 : 64|8@1+ (1,0) [0|0] "" HMDH_207
 SG_ Ecat_Name7 m31 : 72|8@1+ (1,0) [0|0] "" HMDH_207
 SG_ Ecat_Name8 m31 : 80|8@1+ (1,0) [0|0] "" HMDH_207
 SG_ Ecat_Name9 m31 : 88|8@1+ (1,0) [0|0] "" HMDH_207
 SG_ Ecat_Name10 m31 : 96|8@1+ (1,0) [0|0] "" HMDH_207
 SG_ Ecat_Name11 m31 : 104|8@1+ (1,0) [0|0] "" HMDH_207
 SG_ Ecat_Name12 m31 : 112|8@1+ (1,0) [0|0] "" HMDH_207
 SG_ Ecat_Name13 m31 : 120|8@1+ (1,0) [0|0] "" HMDH_207
 SG_ Ecat_Name14 m31 : 128|8@1+ (1,0) [0|0] "" HMDH_207
 SG_ Ecat_Name15 m31 : 136|8@1+ (1,0) [0|0] "" HMDH_207
 SG_ Ecat_Link m31 : 144|8@1+ (1,0) [0|0] "" HMDH_207
 SG_ Ecat_InvalidFrame0 m31 : 152|8@1+ (1,0) [0|0] "" HMDH_207
 SG_ Ecat_InvalidFrame1 m31 : 160|8@1+ (1,0) [0|0] "" HMDH_207
 SG_ Ecat_InvalidFrame2 m31 : 168|8@1+ (1,0) [0|0] "" HMDH_207
 SG_ Ecat_InvalidFrame3 m31 : 176|8@1+ (1,0) [0|0] "" HMDH_207
 SG_ Ecat_RxError0 m31 : 184|8@1+ (1,0) [0|0] "" HMDH_207
 SG_ Ecat_RxError1 m31 : 192|8@1+ (1,0) [0|0] "" HMDH_207
 SG_ Ecat_RxError2 m31 : 200|8@1+ (1,0) [0|0] "" HMDH_207
 SG_ Ecat_RxError3 m31 : 208|8@1+ (1,0) [0|0] "" HMDH_207
 SG_ Ecat_FwdRxError0 m31 : 216|8@1+ (1,0) [0|0] "" HMDH_207
 SG_ Ecat_FwdRxError1 m31 : 224|8@1+ (1,0) [0|0] "" HMDH_207
 SG_ Ecat_FwdRxError2 m31 : 232|8@1+ (1,0) [0|0] "" HMDH_207
 SG_ Ecat_FwdRxError3 m31 : 240|8@1+ (1,0) [0|0] "" HMDH_207
 SG_ Ecat_PuError m31 : 248|8@1+ (1,0) [0|0] "" HMDH_207
 SG_ Ecat_PdiError m31 : 256|8@1+ (1,0) [0|0] "" HMDH_207
 SG_ Ecat_LostLink0 m31 : 264|8@1+ (1,0) [0|0] "" HMDH_207
 SG_ Ecat_LostLink1 m31 : 272|8@1+ (1,0) [0|0] "" HMDH_207
 SG_ Ecat_LostLink2 m31 : 280|8@1+ (1,0) [0|0] "" HMDH_207
 SG_ Ecat_LostLink3 m31 : 288|8@1+ (1,0) [0|0] "" HMDH_207
 SG_ Saf_CanId m32 : 8|8@1+ (1,0) [0|0] "" HMDH_207
 SG_ Saf_Name0 m32 : 16|8@1+ (1,0) [0|0] "" HMDH_207
 SG_ Saf_Name1 m32 : 24|8@1+ (1,0) [0|0] "" HMDH_207
 SG_ Saf_Name2 m32 : 32|8@1+ (1,0) [0|0] "" HMDH_207
 SG_ Saf_Name3 m32 : 40|8@1+ (1,0) [0|0] "" HMDH_207
 SG_ Saf_Name4 m32 : 48|8@1+ (1,0) [0|0] "" HMDH_207
 SG_ Saf_Name5 m32 : 56|8@1+ (1,0) [0|0] "" HMDH_207
 SG_ Saf_Name6 m32 : 64|8@1+ (1,0) [0|0] "" HMDH_207
 SG_ Saf_Name7 m32 : 72|8@1+ (1,0) [0|0] "" HMDH_207
 SG_ Saf_Name8 m32 : 80|8@1+ (1,0) [0|0] "" HMDH_207
 SG_ Saf_Name9 m32 : 88|8@1+ (1,0) [0|0] "" HMDH_207
 SG_ Saf_Name10 m32 : 96|8@1+ (1,0) [0|0] "" HMDH_207
 SG_ Saf_Name11 m32 : 104|8@1+ (1,0) [0|0] "" HMDH_207
 SG_ Saf_Name12 m32 : 112|8@1+ (1,0) [0|0] "" HMDH_207
 SG_ Saf_Name13 m32 : 120|8@1+ (1,0) [0|0] "" HMDH_207
 SG_ Saf_Name14 m32 : 128|8@1+ (1,0) [0|0] "" HMDH_207
 SG_ Saf_Name15 m32 : 136|8@1+ (1,0) [0|0] "" HMDH_207
 SG_ Saf_State m32 : 144|8@1+ (1,0) [0|0] "" HMDH_207
 SG_ Saf_Bits m32 : 152|16@1+ (1,0) [0|0] "" HMDH_207
 SG_ Saf_Estop m32 : 168|8@1+ (1,0) [0|0] "" HMDH_207
 SG_ Saf_FatalLatched m32 : 176|16@1+ (1,0) [0|0] "" HMDH_207
 SG_ Saf_ErrCode m32 : 192|32@1+ (1,0) [0|0] "" HMDH_207

BO_ 2163316324 STATUS_HETC_R_TACT_to_HETC_M_MOB: 48 HETC_R_TACT
 SG_ SubCode M : 0|8@1+ (1,0) [0|0] "" HETC_M_MOB
 SG_ Ping_CanId m5 : 8|8@1+ (1,0) [0|0] "" HETC_M_MOB
 SG_ Ping_HostId m5 : 16|8@1+ (1,0) [0|0] "" HETC_M_MOB
 SG_ Ping_Pid m5 : 24|16@1+ (1,0) [0|0] "" HETC_M_MOB
 SG_ Ping_Bid m5 : 40|16@1+ (1,0) [0|0] "" HETC_M_MOB
 SG_ Ping_Mid m5 : 56|16@1+ (1,0) [0|0] "" HETC_M_MOB
 SG_ Ping_VerMajor m5 : 72|8@1+ (1,0) [0|0] "" HETC_M_MOB
 SG_ Ping_VerMinor m5 : 80|8@1+ (1,0) [0|0] "" HETC_M_MOB
 SG_ Ping_VerPatch m5 : 88|8@1+ (1,0) [0|0] "" HETC_M_MOB
 SG_ Ping_Name0 m5 : 96|8@1+ (1,0) [0|0] "" HETC_M_MOB
 SG_ Ping_Name1 m5 : 104|8@1+ (1,0) [0|0] "" HETC_M_MOB
 SG_ Ping_Name2 m5 : 112|8@1+ (1,0) [0|0] "" HETC_M_MOB
 SG_ Ping_Name3 m5 : 120|8@1+ (1,0) [0|0] "" HETC_M_MOB
 SG_ Ping_Name4 m5 : 128|8@1+ (1,0) [0|0] "" HETC_M_MOB
 SG_ Ping_Name5 m5 : 136|8@1+ (1,0) [0|0] "" HETC_M_MOB
 SG_ Ping_Name6 m5 : 144|8@1+ (1,0) [0|0] "" HETC_M_MOB
 SG_ Ping_Name7 m5 : 152|8@1+ (1,0) [0|0] "" HETC_M_MOB
 SG_ Ping_Name8 m5 : 160|8@1+ (1,0) [0|0] "" HETC_M_MOB
 SG_ Ping_Name9 m5 : 168|8@1+ (1,0) [0|0] "" HETC_M_MOB
 SG_ Ping_Name10 m5 : 176|8@1+ (1,0) [0|0] "" HETC_M_MOB
 SG_ Ping_Name11 m5 : 184|8@1+ (1,0) [0|0] "" HETC_M_MOB
 SG_ Ping_Name12 m5 : 192|8@1+ (1,0) [0|0] "" HETC_M_MOB
 SG_ Ping_Name13 m5 : 200|8@1+ (1,0) [0|0] "" HETC_M_MOB
 SG_ Ping_Name14 m5 : 208|8@1+ (1,0) [0|0] "" HETC_M_MOB
 SG_ Ping_Name15 m5 : 216|8@1+ (1,0) [0|0] "" HETC_M_MOB
 SG_ Ping_FmtVer m5 : 224|8@1+ (1,0) [0|0] "" HETC_M_MOB
 SG_ Ping_GitRev m5 : 232|32@1+ (1,0) [0|0] "" HETC_M_MOB
 SG_ Ping_FwCrc m5 : 264|16@1+ (1,0) [0|0] "" HETC_M_MOB
 SG_ Ping_UptimeS m5 : 280|16@1+ (1,0) [0|0] "s" HETC_M_MOB
 SG_ Ecat_CanId m31 : 8|8@1+ (1,0) [0|0] "" HETC_M_MOB
 SG_ Ecat_Name0 m31 : 16|8@1+ (1,0) [0|0] "" HETC_M_MOB
 SG_ Ecat_Name1 m31 : 24|8@1+ (1,0) [0|0] "" HETC_M_MOB
 SG_ Ecat_Name2 m31 : 32|8@1+ (1,0) [0|0] "" HETC_M_MOB
 SG_ Ecat_Name3 m31 : 40|8@1+ (1,0) [0|0] "" HETC_M_MOB
 SG_ Ecat_Name4 m31 : 48|8@1+ (1,0) [0|0] "" HETC_M_MOB
 SG_ Ecat_Name5 m31 : 56|8@1+ (1,0) [0|0] "" HETC_M_MOB
 SG_ Ecat_Name6 m31 : 64|8@1+ (1,0) [0|0] "" HETC_M_MOB
 SG_ Ecat_Name7 m31 : 72|8@1+ (1,0) [0|0] "" HETC_M_MOB
 SG_ Ecat_Name8 m31 : 80|8@1+ (1,0) [0|0] "" HETC_M_MOB
 SG_ Ecat_Name9 m31 : 88|8@1+ (1,0) [0|0] "" HETC_M_MOB
 SG_ Ecat_Name10 m31 : 96|8@1+ (1,0) [0|0] "" HETC_M_MOB
 SG_ Ecat_Name11 m31 : 104|8@1+ (1,0) [0|0] "" HETC_M_MOB
 SG_ Ecat_Name12 m31 : 112|8@1+ (1,0) [0|0] "" HETC_M_MOB
 SG_ Ecat_Name13 m31 : 120|8@1+ (1,0) [0|0] "" HETC_M_MOB
 SG_ Ecat_Name14 m31 : 128|8@1+ (1,0) [0|0] "" HETC_M_MOB
 SG_ Ecat_Name15 m31 : 136|8@1+ (1,0) [0|0] "" HETC_M_MOB
 SG_ Ecat_Link m31 : 144|8@1+ (1,0) [0|0] "" HETC_M_MOB
 SG_ Ecat_InvalidFrame0 m31 : 152|8@1+ (1,0) [0|0] "" HETC_M_MOB
 SG_ Ecat_InvalidFrame1 m31 : 160|8@1+ (1,0) [0|0] "" HETC_M_MOB
 SG_ Ecat_InvalidFrame2 m31 : 168|8@1+ (1,0) [0|0] "" HETC_M_MOB
 SG_ Ecat_InvalidFrame3 m31 : 176|8@1+ (1,0) [0|0] "" HETC_M_MOB
 SG_ Ecat_RxError0 m31 : 184|8@1+ (1,0) [0|0] "" HETC_M_MOB
 SG_ Ecat_RxError1 m31 : 192|8@1+ (1,0) [0|0] "" HETC_M_MOB
 SG_ Ecat_RxError2 m31 : 200|8@1+ (1,0) [0|0] "" HETC_M_MOB
 SG_ Ecat_RxError3 m31 : 208|8@1+ (1,0) [0|0] "" HETC_M_MOB
 SG_ Ecat_FwdRxError0 m31 : 216|8@1+ (1,0) [0|0] "" HETC_M_MOB
 SG_ Ecat_FwdRxError1 m31 : 224|8@1+ (1,0) [0|0] "" HETC_M_MOB
 SG_ Ecat_FwdRxError2 m31 : 232|8@1+ (1,0) [0|0] "" HETC_M_MOB
 SG_ Ecat_FwdRxError3 m31 : 240|8@1+ (1,0) [0|0] "" HETC_M_MOB
 SG_ Ecat_PuError m31 : 248|8@1+ (1,0) [0|0] "" HETC_M_MOB
 SG_ Ecat_PdiError m31 : 256|8@1+ (1,0) [0|0] "" HETC_M_MOB
 SG_ Ecat_LostLink0 m31 : 264|8@1+ (1,0) [0|0] "" HETC_M_MOB
 SG_ Ecat_LostLink1 m31 : 272|8@1+ (1,0) [0|0] "" HETC_M_MOB
 SG_ Ecat_LostLink2 m31 : 280|8@1+ (1,0) [0|0] "" HETC_M_MOB
 SG_ Ecat_LostLink3 m31 : 288|8@1+ (1,0) [0|0] "" HETC_M_MOB
 SG_ Saf_CanId m32 : 8|8@1+ (1,0) [0|0] "" HETC_M_MOB
 SG_ Saf_Name0 m32 : 16|8@1+ (1,0) [0|0] "" HETC_M_MOB
 SG_ Saf_Name1 m32 : 24|8@1+ (1,0) [0|0] "" HETC_M_MOB
 SG_ Saf_Name2 m32 : 32|8@1+ (1,0) [0|0] "" HETC_M_MOB
 SG_ Saf_Name3 m32 : 40|8@1+ (1,0) [0|0] "" HETC_M_MOB
 SG_ Saf_Name4 m32 : 48|8@1+ (1,0) [0|0] "" HETC_M_MOB
 SG_ Saf_Name5 m32 : 56|8@1+ (1,0) [0|0] "" HETC_M_MOB
 SG_ Saf_Name6 m32 : 64|8@1+ (1,0) [0|0] "" HETC_M_MOB
 SG_ Saf_Name7 m32 : 72|8@1+ (1,0) [0|0] "" HETC_M_MOB
 SG_ Saf_Name8 m32 : 80|8@1+ (1,0) [0|0] "" HETC_M_MOB
 SG_ Saf_Name9 m32 : 88|8@1+ (1,0) [0|0] "" HETC_M_MOB
 SG_ Saf_Name10 m32 : 96|8@1+ (1,0) [0|0] "" HETC_M_MOB
 SG_ Saf_Name11 m32 : 104|8@1+ (1,0) [0|0] "" HETC_M_MOB
 SG_ Saf_Name12 m32 : 112|8@1+ (1,0) [0|0] "" HETC_M_MOB
 SG_ Saf_Name13 m32 : 120|8@1+ (1,0) [0|0] "" HETC_M_MOB
 SG_ Saf_Name14 m32 : 128|8@1+ (1,0) [0|0] "" HETC_M_MOB
 SG_ Saf_Name15 m32 : 136|8@1+ (1,0) [0|0] "" HETC_M_MOB
 SG_ Saf_State m32 : 144|8@1+ (1,0) [0|0] "" HETC_M_MOB
 SG_ Saf_Bits m32 : 152|16@1+ (1,0) [0|0] "" HETC_M_MOB
 SG_ Saf_Estop m32 : 168|8@1+ (1,0) [0|0] "" HETC_M_MOB
 SG_ Saf_FatalLatched m32 : 176|16@1+ (1,0) [0|0] "" HETC_M_MOB
 SG_ Saf_ErrCode m32 : 192|32@1+ (1,0) [0|0] "" HETC_M_MOB

BO_ 2163316334 STATUS_HETC_R_TACT_to_HETC_M_WST: 48 HETC_R_TACT
 SG_ SubCode M : 0|8@1+ (1,0) [0|0] "" HETC_M_WST
 SG_ Ping_CanId m5 : 8|8@1+ (1,0) [0|0] "" HETC_M_WST
 SG_ Ping_HostId m5 : 16|8@1+ (1,0) [0|0] "" HETC_M_WST
 SG_ Ping_Pid m5 : 24|16@1+ (1,0) [0|0] "" HETC_M_WST
 SG_ Ping_Bid m5 : 40|16@1+ (1,0) [0|0] "" HETC_M_WST
 SG_ Ping_Mid m5 : 56|16@1+ (1,0) [0|0] "" HETC_M_WST
 SG_ Ping_VerMajor m5 : 72|8@1+ (1,0) [0|0] "" HETC_M_WST
 SG_ Ping_VerMinor m5 : 80|8@1+ (1,0) [0|0] "" HETC_M_WST
 SG_ Ping_VerPatch m5 : 88|8@1+ (1,0) [0|0] "" HETC_M_WST
 SG_ Ping_Name0 m5 : 96|8@1+ (1,0) [0|0] "" HETC_M_WST
 SG_ Ping_Name1 m5 : 104|8@1+ (1,0) [0|0] "" HETC_M_WST
 SG_ Ping_Name2 m5 : 112|8@1+ (1,0) [0|0] "" HETC_M_WST
 SG_ Ping_Name3 m5 : 120|8@1+ (1,0) [0|0] "" HETC_M_WST
 SG_ Ping_Name4 m5 : 128|8@1+ (1,0) [0|0] "" HETC_M_WST
 SG_ Ping_Name5 m5 : 136|8@1+ (1,0) [0|0] "" HETC_M_WST
 SG_ Ping_Name6 m5 : 144|8@1+ (1,0) [0|0] "" HETC_M_WST
 SG_ Ping_Name7 m5 : 152|8@1+ (1,0) [0|0] "" HETC_M_WST
 SG_ Ping_Name8 m5 : 160|8@1+ (1,0) [0|0] "" HETC_M_WST
 SG_ Ping_Name9 m5 : 168|8@1+ (1,0) [0|0] "" HETC_M_WST
 SG_ Ping_Name10 m5 : 176|8@1+ (1,0) [0|0] "" HETC_M_WST
 SG_ Ping_Name11 m5 : 184|8@1+ (1,0) [0|0] "" HETC_M_WST
 SG_ Ping_Name12 m5 : 192|8@1+ (1,0) [0|0] "" HETC_M_WST
 SG_ Ping_Name13 m5 : 200|8@1+ (1,0) [0|0] "" HETC_M_WST
 SG_ Ping_Name14 m5 : 208|8@1+ (1,0) [0|0] "" HETC_M_WST
 SG_ Ping_Name15 m5 : 216|8@1+ (1,0) [0|0] "" HETC_M_WST
 SG_ Ping_FmtVer m5 : 224|8@1+ (1,0) [0|0] "" HETC_M_WST
 SG_ Ping_GitRev m5 : 232|32@1+ (1,0) [0|0] "" HETC_M_WST
 SG_ Ping_FwCrc m5 : 264|16@1+ (1,0) [0|0] "" HETC_M_WST
 SG_ Ping_UptimeS m5 : 280|16@1+ (1,0) [0|0] "s" HETC_M_WST
 SG_ Ecat_CanId m31 : 8|8@1+ (1,0) [0|0] "" HETC_M_WST
 SG_ Ecat_Name0 m31 : 16|8@1+ (1,0) [0|0] "" HETC_M_WST
 SG_ Ecat_Name1 m31 : 24|8@1+ (1,0) [0|0] "" HETC_M_WST
 SG_ Ecat_Name2 m31 : 32|8@1+ (1,0) [0|0] "" HETC_M_WST
 SG_ Ecat_Name3 m31 : 40|8@1+ (1,0) [0|0] "" HETC_M_WST
 SG_ Ecat_Name4 m31 : 48|8@1+ (1,0) [0|0] "" HETC_M_WST
 SG_ Ecat_Name5 m31 : 56|8@1+ (1,0) [0|0] "" HETC_M_WST
 SG_ Ecat_Name6 m31 : 64|8@1+ (1,0) [0|0] "" HETC_M_WST
 SG_ Ecat_Name7 m31 : 72|8@1+ (1,0) [0|0] "" HETC_M_WST
 SG_ Ecat_Name8 m31 : 80|8@1+ (1,0) [0|0] "" HETC_M_WST
 SG_ Ecat_Name9 m31 : 88|8@1+ (1,0) [0|0] "" HETC_M_WST
 SG_ Ecat_Name10 m31 : 96|8@1+ (1,0) [0|0] "" HETC_M_WST
 SG_ Ecat_Name11 m31 : 104|8@1+ (1,0) [0|0] "" HETC_M_WST
 SG_ Ecat_Name12 m31 : 112|8@1+ (1,0) [0|0] "" HETC_M_WST
 SG_ Ecat_Name13 m31 : 120|8@1+ (1,0) [0|0] "" HETC_M_WST
 SG_ Ecat_Name14 m31 : 128|8@1+ (1,0) [0|0] "" HETC_M_WST
 SG_ Ecat_Name15 m31 : 136|8@1+ (1,0) [0|0] "" HETC_M_WST
 SG_ Ecat_Link m31 : 144|8@1+ (1,0) [0|0] "" HETC_M_WST
 SG_ Ecat_InvalidFrame0 m31 : 152|8@1+ (1,0) [0|0] "" HETC_M_WST
 SG_ Ecat_InvalidFrame1 m31 : 160|8@1+ (1,0) [0|0] "" HETC_M_WST
 SG_ Ecat_InvalidFrame2 m31 : 168|8@1+ (1,0) [0|0] "" HETC_M_WST
 SG_ Ecat_InvalidFrame3 m31 : 176|8@1+ (1,0) [0|0] "" HETC_M_WST
 SG_ Ecat_RxError0 m31 : 184|8@1+ (1,0) [0|0] "" HETC_M_WST
 SG_ Ecat_RxError1 m31 : 192|8@1+ (1,0) [0|0] "" HETC_M_WST
 SG_ Ecat_RxError2 m31 : 200|8@1+ (1,0) [0|0] "" HETC_M_WST
 SG_ Ecat_RxError3 m31 : 208|8@1+ (1,0) [0|0] "" HETC_M_WST
 SG_ Ecat_FwdRxError0 m31 : 216|8@1+ (1,0) [0|0] "" HETC_M_WST
 SG_ Ecat_FwdRxError1 m31 : 224|8@1+ (1,0) [0|0] "" HETC_M_WST
 SG_ Ecat_FwdRxError2 m31 : 232|8@1+ (1,0) [0|0] "" HETC_M_WST
 SG_ Ecat_FwdRxError3 m31 : 240|8@1+ (1,0) [0|0] "" HETC_M_WST
 SG_ Ecat_PuError m31 : 248|8@1+ (1,0) [0|0] "" HETC_M_WST
 SG_ Ecat_PdiError m31 : 256|8@1+ (1,0) [0|0] "" HETC_M_WST
 SG_ Ecat_LostLink0 m31 : 264|8@1+ (1,0) [0|0] "" HETC_M_WST
 SG_ Ecat_LostLink1 m31 : 272|8@1+ (1,0) [0|0] "" HETC_M_WST
 SG_ Ecat_LostLink2 m31 : 280|8@1+ (1,0) [0|0] "" HETC_M_WST
 SG_ Ecat_LostLink3 m31 : 288|8@1+ (1,0) [0|0] "" HETC_M_WST
 SG_ Saf_CanId m32 : 8|8@1+ (1,0) [0|0] "" HETC_M_WST
 SG_ Saf_Name0 m32 : 16|8@1+ (1,0) [0|0] "" HETC_M_WST
 SG_ Saf_Name1 m32 : 24|8@1+ (1,0) [0|0] "" HETC_M_WST
 SG_ Saf_Name2 m32 : 32|8@1+ (1,0) [0|0] "" HETC_M_WST
 SG_ Saf_Name3 m32 : 40|8@1+ (1,0) [0|0] "" HETC_M_WST
 SG_ Saf_Name4 m32 : 48|8@1+ (1,0) [0|0] "" HETC_M_WST
 SG_ Saf_Name5 m32 : 56|8@1+ (1,0) [0|0] "" HETC_M_WST
 SG_ Saf_Name6 m32 : 64|8@1+ (1,0) [0|0] "" HETC_M_WST
 SG_ Saf_Name7 m32 : 72|8@1+ (1,0) [0|0] "" HETC_M_WST
 SG_ Saf_Name8 m32 : 80|8@1+ (1,0) [0|0] "" HETC_M_WST
 SG_ Saf_Name9 m32 : 88|8@1+ (1,0) [0|0] "" HETC_M_WST
 SG_ Saf_Name10 m32 : 96|8@1+ (1,0) [0|0] "" HETC_M_WST
 SG_ Saf_Name11 m32 : 104|8@1+ (1,0) [0|0] "" HETC_M_WST
 SG_ Saf_Name12 m32 : 112|8@1+ (1,0) [0|0] "" HETC_M_WST
 SG_ Saf_Name13 m32 : 120|8@1+ (1,0) [0|0] "" HETC_M_WST
 SG_ Saf_Name14 m32 : 128|8@1+ (1,0) [0|0] "" HETC_M_WST
 SG_ Saf_Name15 m32 : 136|8@1+ (1,0) [0|0] "" HETC_M_WST
 SG_ Saf_State m32 : 144|8@1+ (1,0) [0|0] "" HETC_M_WST
 SG_ Saf_Bits m32 : 152|16@1+ (1,0) [0|0] "" HETC_M_WST
 SG_ Saf_Estop m32 : 168|8@1+ (1,0) [0|0] "" HETC_M_WST
 SG_ Saf_FatalLatched m32 : 176|16@1+ (1,0) [0|0] "" HETC_M_WST
 SG_ Saf_ErrCode m32 : 192|32@1+ (1,0) [0|0] "" HETC_M_WST

BO_ 2163316344 STATUS_HETC_R_TACT_to_HETC_L_ARM: 48 HETC_R_TACT
 SG_ SubCode M : 0|8@1+ (1,0) [0|0] "" HETC_L_ARM
 SG_ Ping_CanId m5 : 8|8@1+ (1,0) [0|0] "" HETC_L_ARM
 SG_ Ping_HostId m5 : 16|8@1+ (1,0) [0|0] "" HETC_L_ARM
 SG_ Ping_Pid m5 : 24|16@1+ (1,0) [0|0] "" HETC_L_ARM
 SG_ Ping_Bid m5 : 40|16@1+ (1,0) [0|0] "" HETC_L_ARM
 SG_ Ping_Mid m5 : 56|16@1+ (1,0) [0|0] "" HETC_L_ARM
 SG_ Ping_VerMajor m5 : 72|8@1+ (1,0) [0|0] "" HETC_L_ARM
 SG_ Ping_VerMinor m5 : 80|8@1+ (1,0) [0|0] "" HETC_L_ARM
 SG_ Ping_VerPatch m5 : 88|8@1+ (1,0) [0|0] "" HETC_L_ARM
 SG_ Ping_Name0 m5 : 96|8@1+ (1,0) [0|0] "" HETC_L_ARM
 SG_ Ping_Name1 m5 : 104|8@1+ (1,0) [0|0] "" HETC_L_ARM
 SG_ Ping_Name2 m5 : 112|8@1+ (1,0) [0|0] "" HETC_L_ARM
 SG_ Ping_Name3 m5 : 120|8@1+ (1,0) [0|0] "" HETC_L_ARM
 SG_ Ping_Name4 m5 : 128|8@1+ (1,0) [0|0] "" HETC_L_ARM
 SG_ Ping_Name5 m5 : 136|8@1+ (1,0) [0|0] "" HETC_L_ARM
 SG_ Ping_Name6 m5 : 144|8@1+ (1,0) [0|0] "" HETC_L_ARM
 SG_ Ping_Name7 m5 : 152|8@1+ (1,0) [0|0] "" HETC_L_ARM
 SG_ Ping_Name8 m5 : 160|8@1+ (1,0) [0|0] "" HETC_L_ARM
 SG_ Ping_Name9 m5 : 168|8@1+ (1,0) [0|0] "" HETC_L_ARM
 SG_ Ping_Name10 m5 : 176|8@1+ (1,0) [0|0] "" HETC_L_ARM
 SG_ Ping_Name11 m5 : 184|8@1+ (1,0) [0|0] "" HETC_L_ARM
 SG_ Ping_Name12 m5 : 192|8@1+ (1,0) [0|0] "" HETC_L_ARM
 SG_ Ping_Name13 m5 : 200|8@1+ (1,0) [0|0] "" HETC_L_ARM
 SG_ Ping_Name14 m5 : 208|8@1+ (1,0) [0|0] "" HETC_L_ARM
 SG_ Ping_Name15 m5 : 216|8@1+ (1,0) [0|0] "" HETC_L_ARM
 SG_ Ping_FmtVer m5 : 224|8@1+ (1,0) [0|0] "" HETC_L_ARM
 SG_ Ping_GitRev m5 : 232|32@1+ (1,0) [0|0] "" HETC_L_ARM
 SG_ Ping_FwCrc m5 : 264|16@1+ (1,0) [0|0] "" HETC_L_ARM
 SG_ Ping_UptimeS m5 : 280|16@1+ (1,0) [0|0] "s" HETC_L_ARM
 SG_ Ecat_CanId m31 : 8|8@1+ (1,0) [0|0] "" HETC_L_ARM
 SG_ Ecat_Name0 m31 : 16|8@1+ (1,0) [0|0] "" HETC_L_ARM
 SG_ Ecat_Name1 m31 : 24|8@1+ (1,0) [0|0] "" HETC_L_ARM
 SG_ Ecat_Name2 m31 : 32|8@1+ (1,0) [0|0] "" HETC_L_ARM
 SG_ Ecat_Name3 m31 : 40|8@1+ (1,0) [0|0] "" HETC_L_ARM
 SG_ Ecat_Name4 m31 : 48|8@1+ (1,0) [0|0] "" HETC_L_ARM
 SG_ Ecat_Name5 m31 : 56|8@1+ (1,0) [0|0] "" HETC_L_ARM
 SG_ Ecat_Name6 m31 : 64|8@1+ (1,0) [0|0] "" HETC_L_ARM
 SG_ Ecat_Name7 m31 : 72|8@1+ (1,0) [0|0] "" HETC_L_ARM
 SG_ Ecat_Name8 m31 : 80|8@1+ (1,0) [0|0] "" HETC_L_ARM
 SG_ Ecat_Name9 m31 : 88|8@1+ (1,0) [0|0] "" HETC_L_ARM
 SG_ Ecat_Name10 m31 : 96|8@1+ (1,0) [0|0] "" HETC_L_ARM
 SG_ Ecat_Name11 m31 : 104|8@1+ (1,0) [0|0] "" HETC_L_ARM
 SG_ Ecat_Name12 m31 : 112|8@1+ (1,0) [0|0] "" HETC_L_ARM
 SG_ Ecat_Name13 m31 : 120|8@1+ (1,0) [0|0] "" HETC_L_ARM
 SG_ Ecat_Name14 m31 : 128|8@1+ (1,0) [0|0] "" HETC_L_ARM
 SG_ Ecat_Name15 m31 : 136|8@1+ (1,0) [0|0] "" HETC_L_ARM
 SG_ Ecat_Link m31 : 144|8@1+ (1,0) [0|0] "" HETC_L_ARM
 SG_ Ecat_InvalidFrame0 m31 : 152|8@1+ (1,0) [0|0] "" HETC_L_ARM
 SG_ Ecat_InvalidFrame1 m31 : 160|8@1+ (1,0) [0|0] "" HETC_L_ARM
 SG_ Ecat_InvalidFrame2 m31 : 168|8@1+ (1,0) [0|0] "" HETC_L_ARM
 SG_ Ecat_InvalidFrame3 m31 : 176|8@1+ (1,0) [0|0] "" HETC_L_ARM
 SG_ Ecat_RxError0 m31 : 184|8@1+ (1,0) [0|0] "" HETC_L_ARM
 SG_ Ecat_RxError1 m31 : 192|8@1+ (1,0) [0|0] "" HETC_L_ARM
 SG_ Ecat_RxError2 m31 : 200|8@1+ (1,0) [0|0] "" HETC_L_ARM
 SG_ Ecat_RxError3 m31 : 208|8@1+ (1,0) [0|0] "" HETC_L_ARM
 SG_ Ecat_FwdRxError0 m31 : 216|8@1+ (1,0) [0|0] "" HETC_L_ARM
 SG_ Ecat_FwdRxError1 m31 : 224|8@1+ (1,0) [0|0] "" HETC_L_ARM
 SG_ Ecat_FwdRxError2 m31 : 232|8@1+ (1,0) [0|0] "" HETC_L_ARM
 SG_ Ecat_FwdRxError3 m31 : 240|8@1+ (1,0) [0|0] "" HETC_L_ARM
 SG_ Ecat_PuError m31 : 248|8@1+ (1,0) [0|0] "" HETC_L_ARM
 SG_ Ecat_PdiError m31 : 256|8@1+ (1,0) [0|0] "" HETC_L_ARM
 SG_ Ecat_LostLink0 m31 : 264|8@1+ (1,0) [0|0] "" HETC_L_ARM
 SG_ Ecat_LostLink1 m31 : 272|8@1+ (1,0) [0|0] "" HETC_L_ARM
 SG_ Ecat_LostLink2 m31 : 280|8@1+ (1,0) [0|0] "" HETC_L_ARM
 SG_ Ecat_LostLink3 m31 : 288|8@1+ (1,0) [0|0] "" HETC_L_ARM
 SG_ Saf_CanId m32 : 8|8@1+ (1,0) [0|0] "" HETC_L_ARM
 SG_ Saf_Name0 m32 : 16|8@1+ (1,0) [0|0] "" HETC_L_ARM
 SG_ Saf_Name1 m32 : 24|8@1+ (1,0) [0|0] "" HETC_L_ARM
 SG_ Saf_Name2 m32 : 32|8@1+ (1,0) [0|0] "" HETC_L_ARM
 SG_ Saf_Name3 m32 : 40|8@1+ (1,0) [0|0] "" HETC_L_ARM
 SG_ Saf_Name4 m32 : 48|8@1+ (1,0) [0|0] "" HETC_L_ARM
 SG_ Saf_Name5 m32 : 56|8@1+ (1,0) [0|0] "" HETC_L_ARM
 SG_ Saf_Name6 m32 : 64|8@1+ (1,0) [0|0] "" HETC_L_ARM
 SG_ Saf_Name7 m32 : 72|8@1+ (1,0) [0|0] "" HETC_L_ARM
 SG_ Saf_Name8 m32 : 80|8@1+ (1,0) [0|0] "" HETC_L_ARM
 SG_ Saf_Name9 m32 : 88|8@1+ (1,0) [0|0] "" HETC_L_ARM
 SG_ Saf_Name10 m32 : 96|8@1+ (1,0) [0|0] "" HETC_L_ARM
 SG_ Saf_Name11 m32 : 104|8@1+ (1,0) [0|0] "" HETC_L_ARM
 SG_ Saf_Name12 m32 : 112|8@1+ (1,0) [0|0] "" HETC_L_ARM
 SG_ Saf_Name13 m32 : 120|8@1+ (1,0) [0|0] "" HETC_L_ARM
 SG_ Saf_Name14 m32 : 128|8@1+ (1,0) [0|0] "" HETC_L_ARM
 SG_ Saf_Name15 m32 : 136|8@1+ (1,0) [0|0] "" HETC_L_ARM
 SG_ Saf_State m32 : 144|8@1+ (1,0) [0|0] "" HETC_L_ARM
 SG_ Saf_Bits m32 : 152|16@1+ (1,0) [0|0] "" HETC_L_ARM
 SG_ Saf_Estop m32 : 168|8@1+ (1,0) [0|0] "" HETC_L_ARM
 SG_ Saf_FatalLatched m32 : 176|16@1+ (1,0) [0|0] "" HETC_L_ARM
 SG_ Saf_ErrCode m32 : 192|32@1+ (1,0) [0|0] "" HETC_L_ARM

BO_ 2163316354 STATUS_HETC_R_TACT_to_HETC_L_TACT: 48 HETC_R_TACT
 SG_ SubCode M : 0|8@1+ (1,0) [0|0] "" HETC_L_TACT
 SG_ Ping_CanId m5 : 8|8@1+ (1,0) [0|0] "" HETC_L_TACT
 SG_ Ping_HostId m5 : 16|8@1+ (1,0) [0|0] "" HETC_L_TACT
 SG_ Ping_Pid m5 : 24|16@1+ (1,0) [0|0] "" HETC_L_TACT
 SG_ Ping_Bid m5 : 40|16@1+ (1,0) [0|0] "" HETC_L_TACT
 SG_ Ping_Mid m5 : 56|16@1+ (1,0) [0|0] "" HETC_L_TACT
 SG_ Ping_VerMajor m5 : 72|8@1+ (1,0) [0|0] "" HETC_L_TACT
 SG_ Ping_VerMinor m5 : 80|8@1+ (1,0) [0|0] "" HETC_L_TACT
 SG_ Ping_VerPatch m5 : 88|8@1+ (1,0) [0|0] "" HETC_L_TACT
 SG_ Ping_Name0 m5 : 96|8@1+ (1,0) [0|0] "" HETC_L_TACT
 SG_ Ping_Name1 m5 : 104|8@1+ (1,0) [0|0] "" HETC_L_TACT
 SG_ Ping_Name2 m5 : 112|8@1+ (1,0) [0|0] "" HETC_L_TACT
 SG_ Ping_Name3 m5 : 120|8@1+ (1,0) [0|0] "" HETC_L_TACT
 SG_ Ping_Name4 m5 : 128|8@1+ (1,0) [0|0] "" HETC_L_TACT
 SG_ Ping_Name5 m5 : 136|8@1+ (1,0) [0|0] "" HETC_L_TACT
 SG_ Ping_Name6 m5 : 144|8@1+ (1,0) [0|0] "" HETC_L_TACT
 SG_ Ping_Name7 m5 : 152|8@1+ (1,0) [0|0] "" HETC_L_TACT
 SG_ Ping_Name8 m5 : 160|8@1+ (1,0) [0|0] "" HETC_L_TACT
 SG_ Ping_Name9 m5 : 168|8@1+ (1,0) [0|0] "" HETC_L_TACT
 SG_ Ping_Name10 m5 : 176|8@1+ (1,0) [0|0] "" HETC_L_TACT
 SG_ Ping_Name11 m5 : 184|8@1+ (1,0) [0|0] "" HETC_L_TACT
 SG_ Ping_Name12 m5 : 192|8@1+ (1,0) [0|0] "" HETC_L_TACT
 SG_ Ping_Name13 m5 : 200|8@1+ (1,0) [0|0] "" HETC_L_TACT
 SG_ Ping_Name14 m5 : 208|8@1+ (1,0) [0|0] "" HETC_L_TACT
 SG_ Ping_Name15 m5 : 216|8@1+ (1,0) [0|0] "" HETC_L_TACT
 SG_ Ping_FmtVer m5 : 224|8@1+ (1,0) [0|0] "" HETC_L_TACT
 SG_ Ping_GitRev m5 : 232|32@1+ (1,0) [0|0] "" HETC_L_TACT
 SG_ Ping_FwCrc m5 : 264|16@1+ (1,0) [0|0] "" HETC_L_TACT
 SG_ Ping_UptimeS m5 : 280|16@1+ (1,0) [0|0] "s" HETC_L_TACT
 SG_ Ecat_CanId m31 : 8|8@1+ (1,0) [0|0] "" HETC_L_TACT
 SG_ Ecat_Name0 m31 : 16|8@1+ (1,0) [0|0] "" HETC_L_TACT
 SG_ Ecat_Name1 m31 : 24|8@1+ (1,0) [0|0] "" HETC_L_TACT
 SG_ Ecat_Name2 m31 : 32|8@1+ (1,0) [0|0] "" HETC_L_TACT
 SG_ Ecat_Name3 m31 : 40|8@1+ (1,0) [0|0] "" HETC_L_TACT
 SG_ Ecat_Name4 m31 : 48|8@1+ (1,0) [0|0] "" HETC_L_TACT
 SG_ Ecat_Name5 m31 : 56|8@1+ (1,0) [0|0] "" HETC_L_TACT
 SG_ Ecat_Name6 m31 : 64|8@1+ (1,0) [0|0] "" HETC_L_TACT
 SG_ Ecat_Name7 m31 : 72|8@1+ (1,0) [0|0] "" HETC_L_TACT
 SG_ Ecat_Name8 m31 : 80|8@1+ (1,0) [0|0] "" HETC_L_TACT
 SG_ Ecat_Name9 m31 : 88|8@1+ (1,0) [0|0] "" HETC_L_TACT
 SG_ Ecat_Name10 m31 : 96|8@1+ (1,0) [0|0] "" HETC_L_TACT
 SG_ Ecat_Name11 m31 : 104|8@1+ (1,0) [0|0] "" HETC_L_TACT
 SG_ Ecat_Name12 m31 : 112|8@1+ (1,0) [0|0] "" HETC_L_TACT
 SG_ Ecat_Name13 m31 : 120|8@1+ (1,0) [0|0] "" HETC_L_TACT
 SG_ Ecat_Name14 m31 : 128|8@1+ (1,0) [0|0] "" HETC_L_TACT
 SG_ Ecat_Name15 m31 : 136|8@1+ (1,0) [0|0] "" HETC_L_TACT
 SG_ Ecat_Link m31 : 144|8@1+ (1,0) [0|0] "" HETC_L_TACT
 SG_ Ecat_InvalidFrame0 m31 : 152|8@1+ (1,0) [0|0] "" HETC_L_TACT
 SG_ Ecat_InvalidFrame1 m31 : 160|8@1+ (1,0) [0|0] "" HETC_L_TACT
 SG_ Ecat_InvalidFrame2 m31 : 168|8@1+ (1,0) [0|0] "" HETC_L_TACT
 SG_ Ecat_InvalidFrame3 m31 : 176|8@1+ (1,0) [0|0] "" HETC_L_TACT
 SG_ Ecat_RxError0 m31 : 184|8@1+ (1,0) [0|0] "" HETC_L_TACT
 SG_ Ecat_RxError1 m31 : 192|8@1+ (1,0) [0|0] "" HETC_L_TACT
 SG_ Ecat_RxError2 m31 : 200|8@1+ (1,0) [0|0] "" HETC_L_TACT
 SG_ Ecat_RxError3 m31 : 208|8@1+ (1,0) [0|0] "" HETC_L_TACT
 SG_ Ecat_FwdRxError0 m31 : 216|8@1+ (1,0) [0|0] "" HETC_L_TACT
 SG_ Ecat_FwdRxError1 m31 : 224|8@1+ (1,0) [0|0] "" HETC_L_TACT
 SG_ Ecat_FwdRxError2 m31 : 232|8@1+ (1,0) [0|0] "" HETC_L_TACT
 SG_ Ecat_FwdRxError3 m31 : 240|8@1+ (1,0) [0|0] "" HETC_L_TACT
 SG_ Ecat_PuError m31 : 248|8@1+ (1,0) [0|0] "" HETC_L_TACT
 SG_ Ecat_PdiError m31 : 256|8@1+ (1,0) [0|0] "" HETC_L_TACT
 SG_ Ecat_LostLink0 m31 : 264|8@1+ (1,0) [0|0] "" HETC_L_TACT
 SG_ Ecat_LostLink1 m31 : 272|8@1+ (1,0) [0|0] "" HETC_L_TACT
 SG_ Ecat_LostLink2 m31 : 280|8@1+ (1,0) [0|0] "" HETC_L_TACT
 SG_ Ecat_LostLink3 m31 : 288|8@1+ (1,0) [0|0] "" HETC_L_TACT
 SG_ Saf_CanId m32 : 8|8@1+ (1,0) [0|0] "" HETC_L_TACT
 SG_ Saf_Name0 m32 : 16|8@1+ (1,0) [0|0] "" HETC_L_TACT
 SG_ Saf_Name1 m32 : 24|8@1+ (1,0) [0|0] "" HETC_L_TACT
 SG_ Saf_Name2 m32 : 32|8@1+ (1,0) [0|0] "" HETC_L_TACT
 SG_ Saf_Name3 m32 : 40|8@1+ (1,0) [0|0] "" HETC_L_TACT
 SG_ Saf_Name4 m32 : 48|8@1+ (1,0) [0|0] "" HETC_L_TACT
 SG_ Saf_Name5 m32 : 56|8@1+ (1,0) [0|0] "" HETC_L_TACT
 SG_ Saf_Name6 m32 : 64|8@1+ (1,0) [0|0] "" HETC_L_TACT
 SG_ Saf_Name7 m32 : 72|8@1+ (1,0) [0|0] "" HETC_L_TACT
 SG_ Saf_Name8 m32 : 80|8@1+ (1,0) [0|0] "" HETC_L_TACT
 SG_ Saf_Name9 m32 : 88|8@1+ (1,0) [0|0] "" HETC_L_TACT
 SG_ Saf_Name10 m32 : 96|8@1+ (1,0) [0|0] "" HETC_L_TACT
 SG_ Saf_Name11 m32 : 104|8@1+ (1,0) [0|0] "" HETC_L_TACT
 SG_ Saf_Name12 m32 : 112|8@1+ (1,0) [0|0] "" HETC_L_TACT
 SG_ Saf_Name13 m32 : 120|8@1+ (1,0) [0|0] "" HETC_L_TACT
 SG_ Saf_Name14 m32 : 128|8@1+ (1,0) [0|0] "" HETC_L_TACT
 SG_ Saf_Name15 m32 : 136|8@1+ (1,0) [0|0] "" HETC_L_TACT
 SG_ Saf_State m32 : 144|8@1+ (1,0) [0|0] "" HETC_L_TACT
 SG_ Saf_Bits m32 : 152|16@1+ (1,0) [0|0] "" HETC_L_TACT
 SG_ Saf_Estop m32 : 168|8@1+ (1,0) [0|0] "" HETC_L_TACT
 SG_ Saf_FatalLatched m32 : 176|16@1+ (1,0) [0|0] "" HETC_L_TACT
 SG_ Saf_ErrCode m32 : 192|32@1+ (1,0) [0|0] "" HETC_L_TACT

BO_ 2163316364 STATUS_HETC_R_TACT_to_HETC_R_ARM: 48 HETC_R_TACT
 SG_ SubCode M : 0|8@1+ (1,0) [0|0] "" HETC_R_ARM
 SG_ Ping_CanId m5 : 8|8@1+ (1,0) [0|0] "" HETC_R_ARM
 SG_ Ping_HostId m5 : 16|8@1+ (1,0) [0|0] "" HETC_R_ARM
 SG_ Ping_Pid m5 : 24|16@1+ (1,0) [0|0] "" HETC_R_ARM
 SG_ Ping_Bid m5 : 40|16@1+ (1,0) [0|0] "" HETC_R_ARM
 SG_ Ping_Mid m5 : 56|16@1+ (1,0) [0|0] "" HETC_R_ARM
 SG_ Ping_VerMajor m5 : 72|8@1+ (1,0) [0|0] "" HETC_R_ARM
 SG_ Ping_VerMinor m5 : 80|8@1+ (1,0) [0|0] "" HETC_R_ARM
 SG_ Ping_VerPatch m5 : 88|8@1+ (1,0) [0|0] "" HETC_R_ARM
 SG_ Ping_Name0 m5 : 96|8@1+ (1,0) [0|0] "" HETC_R_ARM
 SG_ Ping_Name1 m5 : 104|8@1+ (1,0) [0|0] "" HETC_R_ARM
 SG_ Ping_Name2 m5 : 112|8@1+ (1,0) [0|0] "" HETC_R_ARM
 SG_ Ping_Name3 m5 : 120|8@1+ (1,0) [0|0] "" HETC_R_ARM
 SG_ Ping_Name4 m5 : 128|8@1+ (1,0) [0|0] "" HETC_R_ARM
 SG_ Ping_Name5 m5 : 136|8@1+ (1,0) [0|0] "" HETC_R_ARM
 SG_ Ping_Name6 m5 : 144|8@1+ (1,0) [0|0] "" HETC_R_ARM
 SG_ Ping_Name7 m5 : 152|8@1+ (1,0) [0|0] "" HETC_R_ARM
 SG_ Ping_Name8 m5 : 160|8@1+ (1,0) [0|0] "" HETC_R_ARM
 SG_ Ping_Name9 m5 : 168|8@1+ (1,0) [0|0] "" HETC_R_ARM
 SG_ Ping_Name10 m5 : 176|8@1+ (1,0) [0|0] "" HETC_R_ARM
 SG_ Ping_Name11 m5 : 184|8@1+ (1,0) [0|0] "" HETC_R_ARM
 SG_ Ping_Name12 m5 : 192|8@1+ (1,0) [0|0] "" HETC_R_ARM
 SG_ Ping_Name13 m5 : 200|8@1+ (1,0) [0|0] "" HETC_R_ARM
 SG_ Ping_Name14 m5 : 208|8@1+ (1,0) [0|0] "" HETC_R_ARM
 SG_ Ping_Name15 m5 : 216|8@1+ (1,0) [0|0] "" HETC_R_ARM
 SG_ Ping_FmtVer m5 : 224|8@1+ (1,0) [0|0] "" HETC_R_ARM
 SG_ Ping_GitRev m5 : 232|32@1+ (1,0) [0|0] "" HETC_R_ARM
 SG_ Ping_FwCrc m5 : 264|16@1+ (1,0) [0|0] "" HETC_R_ARM
 SG_ Ping_UptimeS m5 : 280|16@1+ (1,0) [0|0] "s" HETC_R_ARM
 SG_ Ecat_CanId m31 : 8|8@1+ (1,0) [0|0] "" HETC_R_ARM
 SG_ Ecat_Name0 m31 : 16|8@1+ (1,0) [0|0] "" HETC_R_ARM
 SG_ Ecat_Name1 m31 : 24|8@1+ (1,0) [0|0] "" HETC_R_ARM
 SG_ Ecat_Name2 m31 : 32|8@1+ (1,0) [0|0] "" HETC_R_ARM
 SG_ Ecat_Name3 m31 : 40|8@1+ (1,0) [0|0] "" HETC_R_ARM
 SG_ Ecat_Name4 m31 : 48|8@1+ (1,0) [0|0] "" HETC_R_ARM
 SG_ Ecat_Name5 m31 : 56|8@1+ (1,0) [0|0] "" HETC_R_ARM
 SG_ Ecat_Name6 m31 : 64|8@1+ (1,0) [0|0] "" HETC_R_ARM
 SG_ Ecat_Name7 m31 : 72|8@1+ (1,0) [0|0] "" HETC_R_ARM
 SG_ Ecat_Name8 m31 : 80|8@1+ (1,0) [0|0] "" HETC_R_ARM
 SG_ Ecat_Name9 m31 : 88|8@1+ (1,0) [0|0] "" HETC_R_ARM
 SG_ Ecat_Name10 m31 : 96|8@1+ (1,0) [0|0] "" HETC_R_ARM
 SG_ Ecat_Name11 m31 : 104|8@1+ (1,0) [0|0] "" HETC_R_ARM
 SG_ Ecat_Name12 m31 : 112|8@1+ (1,0) [0|0] "" HETC_R_ARM
 SG_ Ecat_Name13 m31 : 120|8@1+ (1,0) [0|0] "" HETC_R_ARM
 SG_ Ecat_Name14 m31 : 128|8@1+ (1,0) [0|0] "" HETC_R_ARM
 SG_ Ecat_Name15 m31 : 136|8@1+ (1,0) [0|0] "" HETC_R_ARM
 SG_ Ecat_Link m31 : 144|8@1+ (1,0) [0|0] "" HETC_R_ARM
 SG_ Ecat_InvalidFrame0 m31 : 152|8@1+ (1,0) [0|0] "" HETC_R_ARM
 SG_ Ecat_InvalidFrame1 m31 : 160|8@1+ (1,0) [0|0] "" HETC_R_ARM
 SG_ Ecat_InvalidFrame2 m31 : 168|8@1+ (1,0) [0|0] "" HETC_R_ARM
 SG_ Ecat_InvalidFrame3 m31 : 176|8@1+ (1,0) [0|0] "" HETC_R_ARM
 SG_ Ecat_RxError0 m31 : 184|8@1+ (1,0) [0|0] "" HETC_R_ARM
 SG_ Ecat_RxError1 m31 : 192|8@1+ (1,0) [0|0] "" HETC_R_ARM
 SG_ Ecat_RxError2 m31 : 200|8@1+ (1,0) [0|0] "" HETC_R_ARM
 SG_ Ecat_RxError3 m31 : 208|8@1+ (1,0) [0|0] "" HETC_R_ARM
 SG_ Ecat_FwdRxError0 m31 : 216|8@1+ (1,0) [0|0] "" HETC_R_ARM
 SG_ Ecat_FwdRxError1 m31 : 224|8@1+ (1,0) [0|0] "" HETC_R_ARM
 SG_ Ecat_FwdRxError2 m31 : 232|8@1+ (1,0) [0|0] "" HETC_R_ARM
 SG_ Ecat_FwdRxError3 m31 : 240|8@1+ (1,0) [0|0] "" HETC_R_ARM
 SG_ Ecat_PuError m31 : 248|8@1+ (1,0) [0|0] "" HETC_R_ARM
 SG_ Ecat_PdiError m31 : 256|8@1+ (1,0) [0|0] "" HETC_R_ARM
 SG_ Ecat_LostLink0 m31 : 264|8@1+ (1,0) [0|0] "" HETC_R_ARM
 SG_ Ecat_LostLink1 m31 : 272|8@1+ (1,0) [0|0] "" HETC_R_ARM
 SG_ Ecat_LostLink2 m31 : 280|8@1+ (1,0) [0|0] "" HETC_R_ARM
 SG_ Ecat_LostLink3 m31 : 288|8@1+ (1,0) [0|0] "" HETC_R_ARM
 SG_ Saf_CanId m32 : 8|8@1+ (1,0) [0|0] "" HETC_R_ARM
 SG_ Saf_Name0 m32 : 16|8@1+ (1,0) [0|0] "" HETC_R_ARM
 SG_ Saf_Name1 m32 : 24|8@1+ (1,0) [0|0] "" HETC_R_ARM
 SG_ Saf_Name2 m32 : 32|8@1+ (1,0) [0|0] "" HETC_R_ARM
 SG_ Saf_Name3 m32 : 40|8@1+ (1,0) [0|0] "" HETC_R_ARM
 SG_ Saf_Name4 m32 : 48|8@1+ (1,0) [0|0] "" HETC_R_ARM
 SG_ Saf_Name5 m32 : 56|8@1+ (1,0) [0|0] "" HETC_R_ARM
 SG_ Saf_Name6 m32 : 64|8@1+ (1,0) [0|0] "" HETC_R_ARM
 SG_ Saf_Name7 m32 : 72|8@1+ (1,0) [0|0] "" HETC_R_ARM
 SG_ Saf_Name8 m32 : 80|8@1+ (1,0) [0|0] "" HETC_R_ARM
 SG_ Saf_Name9 m32 : 88|8@1+ (1,0) [0|0] "" HETC_R_ARM
 SG_ Saf_Name10 m32 : 96|8@1+ (1,0) [0|0] "" HETC_R_ARM
 SG_ Saf_Name11 m32 : 104|8@1+ (1,0) [0|0] "" HETC_R_ARM
 SG_ Saf_Name12 m32 : 112|8@1+ (1,0) [0|0] "" HETC_R_ARM
 SG_ Saf_Name13 m32 : 120|8@1+ (1,0) [0|0] "" HETC_R_ARM
 SG_ Saf_Name14 m32 : 128|8@1+ (1,0) [0|0] "" HETC_R_ARM
 SG_ Saf_Name15 m32 : 136|8@1+ (1,0) [0|0] "" HETC_R_ARM
 SG_ Saf_State m32 : 144|8@1+ (1,0) [0|0] "" HETC_R_ARM
 SG_ Saf_Bits m32 : 152|16@1+ (1,0) [0|0] "" HETC_R_ARM
 SG_ Saf_Estop m32 : 168|8@1+ (1,0) [0|0] "" HETC_R_ARM
 SG_ Saf_FatalLatched m32 : 176|16@1+ (1,0) [0|0] "" HETC_R_ARM
 SG_ Saf_ErrCode m32 : 192|32@1+ (1,0) [0|0] "" HETC_R_ARM

BO_ 2163316425 STATUS_HETC_R_TACT_to_HMDH_201: 48 HETC_R_TACT
 SG_ SubCode M : 0|8@1+ (1,0) [0|0] "" HMDH_201
 SG_ Ping_CanId m5 : 8|8@1+ (1,0) [0|0] "" HMDH_201
 SG_ Ping_HostId m5 : 16|8@1+ (1,0) [0|0] "" HMDH_201
 SG_ Ping_Pid m5 : 24|16@1+ (1,0) [0|0] "" HMDH_201
 SG_ Ping_Bid m5 : 40|16@1+ (1,0) [0|0] "" HMDH_201
 SG_ Ping_Mid m5 : 56|16@1+ (1,0) [0|0] "" HMDH_201
 SG_ Ping_VerMajor m5 : 72|8@1+ (1,0) [0|0] "" HMDH_201
 SG_ Ping_VerMinor m5 : 80|8@1+ (1,0) [0|0] "" HMDH_201
 SG_ Ping_VerPatch m5 : 88|8@1+ (1,0) [0|0] "" HMDH_201
 SG_ Ping_Name0 m5 : 96|8@1+ (1,0) [0|0] "" HMDH_201
 SG_ Ping_Name1 m5 : 104|8@1+ (1,0) [0|0] "" HMDH_201
 SG_ Ping_Name2 m5 : 112|8@1+ (1,0) [0|0] "" HMDH_201
 SG_ Ping_Name3 m5 : 120|8@1+ (1,0) [0|0] "" HMDH_201
 SG_ Ping_Name4 m5 : 128|8@1+ (1,0) [0|0] "" HMDH_201
 SG_ Ping_Name5 m5 : 136|8@1+ (1,0) [0|0] "" HMDH_201
 SG_ Ping_Name6 m5 : 144|8@1+ (1,0) [0|0] "" HMDH_201
 SG_ Ping_Name7 m5 : 152|8@1+ (1,0) [0|0] "" HMDH_201
 SG_ Ping_Name8 m5 : 160|8@1+ (1,0) [0|0] "" HMDH_201
 SG_ Ping_Name9 m5 : 168|8@1+ (1,0) [0|0] "" HMDH_201
 SG_ Ping_Name10 m5 : 176|8@1+ (1,0) [0|0] "" HMDH_201
 SG_ Ping_Name11 m5 : 184|8@1+ (1,0) [0|0] "" HMDH_201
 SG_ Ping_Name12 m5 : 192|8@1+ (1,0) [0|0] "" HMDH_201
 SG_ Ping_Name13 m5 : 200|8@1+ (1,0) [0|0] "" HMDH_201
 SG_ Ping_Name14 m5 : 208|8@1+ (1,0) [0|0] "" HMDH_201
 SG_ Ping_Name15 m5 : 216|8@1+ (1,0) [0|0] "" HMDH_201
 SG_ Ping_FmtVer m5 : 224|8@1+ (1,0) [0|0] "" HMDH_201
 SG_ Ping_GitRev m5 : 232|32@1+ (1,0) [0|0] "" HMDH_201
 SG_ Ping_FwCrc m5 : 264|16@1+ (1,0) [0|0] "" HMDH_201
 SG_ Ping_UptimeS m5 : 280|16@1+ (1,0) [0|0] "s" HMDH_201
 SG_ Ecat_CanId m31 : 8|8@1+ (1,0) [0|0] "" HMDH_201
 SG_ Ecat_Name0 m31 : 16|8@1+ (1,0) [0|0] "" HMDH_201
 SG_ Ecat_Name1 m31 : 24|8@1+ (1,0) [0|0] "" HMDH_201
 SG_ Ecat_Name2 m31 : 32|8@1+ (1,0) [0|0] "" HMDH_201
 SG_ Ecat_Name3 m31 : 40|8@1+ (1,0) [0|0] "" HMDH_201
 SG_ Ecat_Name4 m31 : 48|8@1+ (1,0) [0|0] "" HMDH_201
 SG_ Ecat_Name5 m31 : 56|8@1+ (1,0) [0|0] "" HMDH_201
 SG_ Ecat_Name6 m31 : 64|8@1+ (1,0) [0|0] "" HMDH_201
 SG_ Ecat_Name7 m31 : 72|8@1+ (1,0) [0|0] "" HMDH_201
 SG_ Ecat_Name8 m31 : 80|8@1+ (1,0) [0|0] "" HMDH_201
 SG_ Ecat_Name9 m31 : 88|8@1+ (1,0) [0|0] "" HMDH_201
 SG_ Ecat_Name10 m31 : 96|8@1+ (1,0) [0|0] "" HMDH_201
 SG_ Ecat_Name11 m31 : 104|8@1+ (1,0) [0|0] "" HMDH_201
 SG_ Ecat_Name12 m31 : 112|8@1+ (1,0) [0|0] "" HMDH_201
 SG_ Ecat_Name13 m31 : 120|8@1+ (1,0) [0|0] "" HMDH_201
 SG_ Ecat_Name14 m31 : 128|8@1+ (1,0) [0|0] "" HMDH_201
 SG_ Ecat_Name15 m31 : 136|8@1+ (1,0) [0|0] "" HMDH_201
 SG_ Ecat_Link m31 : 144|8@1+ (1,0) [0|0] "" HMDH_201
 SG_ Ecat_InvalidFrame0 m31 : 152|8@1+ (1,0) [0|0] "" HMDH_201
 SG_ Ecat_InvalidFrame1 m31 : 160|8@1+ (1,0) [0|0] "" HMDH_201
 SG_ Ecat_InvalidFrame2 m31 : 168|8@1+ (1,0) [0|0] "" HMDH_201
 SG_ Ecat_InvalidFrame3 m31 : 176|8@1+ (1,0) [0|0] "" HMDH_201
 SG_ Ecat_RxError0 m31 : 184|8@1+ (1,0) [0|0] "" HMDH_201
 SG_ Ecat_RxError1 m31 : 192|8@1+ (1,0) [0|0] "" HMDH_201
 SG_ Ecat_RxError2 m31 : 200|8@1+ (1,0) [0|0] "" HMDH_201
 SG_ Ecat_RxError3 m31 : 208|8@1+ (1,0) [0|0] "" HMDH_201
 SG_ Ecat_FwdRxError0 m31 : 216|8@1+ (1,0) [0|0] "" HMDH_201
 SG_ Ecat_FwdRxError1 m31 : 224|8@1+ (1,0) [0|0] "" HMDH_201
 SG_ Ecat_FwdRxError2 m31 : 232|8@1+ (1,0) [0|0] "" HMDH_201
 SG_ Ecat_FwdRxError3 m31 : 240|8@1+ (1,0) [0|0] "" HMDH_201
 SG_ Ecat_PuError m31 : 248|8@1+ (1,0) [0|0] "" HMDH_201
 SG_ Ecat_PdiError m31 : 256|8@1+ (1,0) [0|0] "" HMDH_201
 SG_ Ecat_LostLink0 m31 : 264|8@1+ (1,0) [0|0] "" HMDH_201
 SG_ Ecat_LostLink1 m31 : 272|8@1+ (1,0) [0|0] "" HMDH_201
 SG_ Ecat_LostLink2 m31 : 280|8@1+ (1,0) [0|0] "" HMDH_201
 SG_ Ecat_LostLink3 m31 : 288|8@1+ (1,0) [0|0] "" HMDH_201
 SG_ Saf_CanId m32 : 8|8@1+ (1,0) [0|0] "" HMDH_201
 SG_ Saf_Name0 m32 : 16|8@1+ (1,0) [0|0] "" HMDH_201
 SG_ Saf_Name1 m32 : 24|8@1+ (1,0) [0|0] "" HMDH_201
 SG_ Saf_Name2 m32 : 32|8@1+ (1,0) [0|0] "" HMDH_201
 SG_ Saf_Name3 m32 : 40|8@1+ (1,0) [0|0] "" HMDH_201
 SG_ Saf_Name4 m32 : 48|8@1+ (1,0) [0|0] "" HMDH_201
 SG_ Saf_Name5 m32 : 56|8@1+ (1,0) [0|0] "" HMDH_201
 SG_ Saf_Name6 m32 : 64|8@1+ (1,0) [0|0] "" HMDH_201
 SG_ Saf_Name7 m32 : 72|8@1+ (1,0) [0|0] "" HMDH_201
 SG_ Saf_Name8 m32 : 80|8@1+ (1,0) [0|0] "" HMDH_201
 SG_ Saf_Name9 m32 : 88|8@1+ (1,0) [0|0] "" HMDH_201
 SG_ Saf_Name10 m32 : 96|8@1+ (1,0) [0|0] "" HMDH_201
 SG_ Saf_Name11 m32 : 104|8@1+ (1,0) [0|0] "" HMDH_201
 SG_ Saf_Name12 m32 : 112|8@1+ (1,0) [0|0] "" HMDH_201
 SG_ Saf_Name13 m32 : 120|8@1+ (1,0) [0|0] "" HMDH_201
 SG_ Saf_Name14 m32 : 128|8@1+ (1,0) [0|0] "" HMDH_201
 SG_ Saf_Name15 m32 : 136|8@1+ (1,0) [0|0] "" HMDH_201
 SG_ Saf_State m32 : 144|8@1+ (1,0) [0|0] "" HMDH_201
 SG_ Saf_Bits m32 : 152|16@1+ (1,0) [0|0] "" HMDH_201
 SG_ Saf_Estop m32 : 168|8@1+ (1,0) [0|0] "" HMDH_201
 SG_ Saf_FatalLatched m32 : 176|16@1+ (1,0) [0|0] "" HMDH_201
 SG_ Saf_ErrCode m32 : 192|32@1+ (1,0) [0|0] "" HMDH_201

BO_ 2163316426 STATUS_HETC_R_TACT_to_HMDH_202: 48 HETC_R_TACT
 SG_ SubCode M : 0|8@1+ (1,0) [0|0] "" HMDH_202
 SG_ Ping_CanId m5 : 8|8@1+ (1,0) [0|0] "" HMDH_202
 SG_ Ping_HostId m5 : 16|8@1+ (1,0) [0|0] "" HMDH_202
 SG_ Ping_Pid m5 : 24|16@1+ (1,0) [0|0] "" HMDH_202
 SG_ Ping_Bid m5 : 40|16@1+ (1,0) [0|0] "" HMDH_202
 SG_ Ping_Mid m5 : 56|16@1+ (1,0) [0|0] "" HMDH_202
 SG_ Ping_VerMajor m5 : 72|8@1+ (1,0) [0|0] "" HMDH_202
 SG_ Ping_VerMinor m5 : 80|8@1+ (1,0) [0|0] "" HMDH_202
 SG_ Ping_VerPatch m5 : 88|8@1+ (1,0) [0|0] "" HMDH_202
 SG_ Ping_Name0 m5 : 96|8@1+ (1,0) [0|0] "" HMDH_202
 SG_ Ping_Name1 m5 : 104|8@1+ (1,0) [0|0] "" HMDH_202
 SG_ Ping_Name2 m5 : 112|8@1+ (1,0) [0|0] "" HMDH_202
 SG_ Ping_Name3 m5 : 120|8@1+ (1,0) [0|0] "" HMDH_202
 SG_ Ping_Name4 m5 : 128|8@1+ (1,0) [0|0] "" HMDH_202
 SG_ Ping_Name5 m5 : 136|8@1+ (1,0) [0|0] "" HMDH_202
 SG_ Ping_Name6 m5 : 144|8@1+ (1,0) [0|0] "" HMDH_202
 SG_ Ping_Name7 m5 : 152|8@1+ (1,0) [0|0] "" HMDH_202
 SG_ Ping_Name8 m5 : 160|8@1+ (1,0) [0|0] "" HMDH_202
 SG_ Ping_Name9 m5 : 168|8@1+ (1,0) [0|0] "" HMDH_202
 SG_ Ping_Name10 m5 : 176|8@1+ (1,0) [0|0] "" HMDH_202
 SG_ Ping_Name11 m5 : 184|8@1+ (1,0) [0|0] "" HMDH_202
 SG_ Ping_Name12 m5 : 192|8@1+ (1,0) [0|0] "" HMDH_202
 SG_ Ping_Name13 m5 : 200|8@1+ (1,0) [0|0] "" HMDH_202
 SG_ Ping_Name14 m5 : 208|8@1+ (1,0) [0|0] "" HMDH_202
 SG_ Ping_Name15 m5 : 216|8@1+ (1,0) [0|0] "" HMDH_202
 SG_ Ping_FmtVer m5 : 224|8@1+ (1,0) [0|0] "" HMDH_202
 SG_ Ping_GitRev m5 : 232|32@1+ (1,0) [0|0] "" HMDH_202
 SG_ Ping_FwCrc m5 : 264|16@1+ (1,0) [0|0] "" HMDH_202
 SG_ Ping_UptimeS m5 : 280|16@1+ (1,0) [0|0] "s" HMDH_202
 SG_ Ecat_CanId m31 : 8|8@1+ (1,0) [0|0] "" HMDH_202
 SG_ Ecat_Name0 m31 : 16|8@1+ (1,0) [0|0] "" HMDH_202
 SG_ Ecat_Name1 m31 : 24|8@1+ (1,0) [0|0] "" HMDH_202
 SG_ Ecat_Name2 m31 : 32|8@1+ (1,0) [0|0] "" HMDH_202
 SG_ Ecat_Name3 m31 : 40|8@1+ (1,0) [0|0] "" HMDH_202
 SG_ Ecat_Name4 m31 : 48|8@1+ (1,0) [0|0] "" HMDH_202
 SG_ Ecat_Name5 m31 : 56|8@1+ (1,0) [0|0] "" HMDH_202
 SG_ Ecat_Name6 m31 : 64|8@1+ (1,0) [0|0] "" HMDH_202
 SG_ Ecat_Name7 m31 : 72|8@1+ (1,0) [0|0] "" HMDH_202
 SG_ Ecat_Name8 m31 : 80|8@1+ (1,0) [0|0] "" HMDH_202
 SG_ Ecat_Name9 m31 : 88|8@1+ (1,0) [0|0] "" HMDH_202
 SG_ Ecat_Name10 m31 : 96|8@1+ (1,0) [0|0] "" HMDH_202
 SG_ Ecat_Name11 m31 : 104|8@1+ (1,0) [0|0] "" HMDH_202
 SG_ Ecat_Name12 m31 : 112|8@1+ (1,0) [0|0] "" HMDH_202
 SG_ Ecat_Name13 m31 : 120|8@1+ (1,0) [0|0] "" HMDH_202
 SG_ Ecat_Name14 m31 : 128|8@1+ (1,0) [0|0] "" HMDH_202
 SG_ Ecat_Name15 m31 : 136|8@1+ (1,0) [0|0] "" HMDH_202
 SG_ Ecat_Link m31 : 144|8@1+ (1,0) [0|0] "" HMDH_202
 SG_ Ecat_InvalidFrame0 m31 : 152|8@1+ (1,0) [0|0] "" HMDH_202
 SG_ Ecat_InvalidFrame1 m31 : 160|8@1+ (1,0) [0|0] "" HMDH_202
 SG_ Ecat_InvalidFrame2 m31 : 168|8@1+ (1,0) [0|0] "" HMDH_202
 SG_ Ecat_InvalidFrame3 m31 : 176|8@1+ (1,0) [0|0] "" HMDH_202
 SG_ Ecat_RxError0 m31 : 184|8@1+ (1,0) [0|0] "" HMDH_202
 SG_ Ecat_RxError1 m31 : 192|8@1+ (1,0) [0|0] "" HMDH_202
 SG_ Ecat_RxError2 m31 : 200|8@1+ (1,0) [0|0] "" HMDH_202
 SG_ Ecat_RxError3 m31 : 208|8@1+ (1,0) [0|0] "" HMDH_202
 SG_ Ecat_FwdRxError0 m31 : 216|8@1+ (1,0) [0|0] "" HMDH_202
 SG_ Ecat_FwdRxError1 m31 : 224|8@1+ (1,0) [0|0] "" HMDH_202
 SG_ Ecat_FwdRxError2 m31 : 232|8@1+ (1,0) [0|0] "" HMDH_202
 SG_ Ecat_FwdRxError3 m31 : 240|8@1+ (1,0) [0|0] "" HMDH_202
 SG_ Ecat_PuError m31 : 248|8@1+ (1,0) [0|0] "" HMDH_202
 SG_ Ecat_PdiError m31 : 256|8@1+ (1,0) [0|0] "" HMDH_202
 SG_ Ecat_LostLink0 m31 : 264|8@1+ (1,0) [0|0] "" HMDH_202
 SG_ Ecat_LostLink1 m31 : 272|8@1+ (1,0) [0|0] "" HMDH_202
 SG_ Ecat_LostLink2 m31 : 280|8@1+ (1,0) [0|0] "" HMDH_202
 SG_ Ecat_LostLink3 m31 : 288|8@1+ (1,0) [0|0] "" HMDH_202
 SG_ Saf_CanId m32 : 8|8@1+ (1,0) [0|0] "" HMDH_202
 SG_ Saf_Name0 m32 : 16|8@1+ (1,0) [0|0] "" HMDH_202
 SG_ Saf_Name1 m32 : 24|8@1+ (1,0) [0|0] "" HMDH_202
 SG_ Saf_Name2 m32 : 32|8@1+ (1,0) [0|0] "" HMDH_202
 SG_ Saf_Name3 m32 : 40|8@1+ (1,0) [0|0] "" HMDH_202
 SG_ Saf_Name4 m32 : 48|8@1+ (1,0) [0|0] "" HMDH_202
 SG_ Saf_Name5 m32 : 56|8@1+ (1,0) [0|0] "" HMDH_202
 SG_ Saf_Name6 m32 : 64|8@1+ (1,0) [0|0] "" HMDH_202
 SG_ Saf_Name7 m32 : 72|8@1+ (1,0) [0|0] "" HMDH_202
 SG_ Saf_Name8 m32 : 80|8@1+ (1,0) [0|0] "" HMDH_202
 SG_ Saf_Name9 m32 : 88|8@1+ (1,0) [0|0] "" HMDH_202
 SG_ Saf_Name10 m32 : 96|8@1+ (1,0) [0|0] "" HMDH_202
 SG_ Saf_Name11 m32 : 104|8@1+ (1,0) [0|0] "" HMDH_202
 SG_ Saf_Name12 m32 : 112|8@1+ (1,0) [0|0] "" HMDH_202
 SG_ Saf_Name13 m32 : 120|8@1+ (1,0) [0|0] "" HMDH_202
 SG_ Saf_Name14 m32 : 128|8@1+ (1,0) [0|0] "" HMDH_202
 SG_ Saf_Name15 m32 : 136|8@1+ (1,0) [0|0] "" HMDH_202
 SG_ Saf_State m32 : 144|8@1+ (1,0) [0|0] "" HMDH_202
 SG_ Saf_Bits m32 : 152|16@1+ (1,0) [0|0] "" HMDH_202
 SG_ Saf_Estop m32 : 168|8@1+ (1,0) [0|0] "" HMDH_202
 SG_ Saf_FatalLatched m32 : 176|16@1+ (1,0) [0|0] "" HMDH_202
 SG_ Saf_ErrCode m32 : 192|32@1+ (1,0) [0|0] "" HMDH_202

BO_ 2163316427 STATUS_HETC_R_TACT_to_HMDH_203: 48 HETC_R_TACT
 SG_ SubCode M : 0|8@1+ (1,0) [0|0] "" HMDH_203
 SG_ Ping_CanId m5 : 8|8@1+ (1,0) [0|0] "" HMDH_203
 SG_ Ping_HostId m5 : 16|8@1+ (1,0) [0|0] "" HMDH_203
 SG_ Ping_Pid m5 : 24|16@1+ (1,0) [0|0] "" HMDH_203
 SG_ Ping_Bid m5 : 40|16@1+ (1,0) [0|0] "" HMDH_203
 SG_ Ping_Mid m5 : 56|16@1+ (1,0) [0|0] "" HMDH_203
 SG_ Ping_VerMajor m5 : 72|8@1+ (1,0) [0|0] "" HMDH_203
 SG_ Ping_VerMinor m5 : 80|8@1+ (1,0) [0|0] "" HMDH_203
 SG_ Ping_VerPatch m5 : 88|8@1+ (1,0) [0|0] "" HMDH_203
 SG_ Ping_Name0 m5 : 96|8@1+ (1,0) [0|0] "" HMDH_203
 SG_ Ping_Name1 m5 : 104|8@1+ (1,0) [0|0] "" HMDH_203
 SG_ Ping_Name2 m5 : 112|8@1+ (1,0) [0|0] "" HMDH_203
 SG_ Ping_Name3 m5 : 120|8@1+ (1,0) [0|0] "" HMDH_203
 SG_ Ping_Name4 m5 : 128|8@1+ (1,0) [0|0] "" HMDH_203
 SG_ Ping_Name5 m5 : 136|8@1+ (1,0) [0|0] "" HMDH_203
 SG_ Ping_Name6 m5 : 144|8@1+ (1,0) [0|0] "" HMDH_203
 SG_ Ping_Name7 m5 : 152|8@1+ (1,0) [0|0] "" HMDH_203
 SG_ Ping_Name8 m5 : 160|8@1+ (1,0) [0|0] "" HMDH_203
 SG_ Ping_Name9 m5 : 168|8@1+ (1,0) [0|0] "" HMDH_203
 SG_ Ping_Name10 m5 : 176|8@1+ (1,0) [0|0] "" HMDH_203
 SG_ Ping_Name11 m5 : 184|8@1+ (1,0) [0|0] "" HMDH_203
 SG_ Ping_Name12 m5 : 192|8@1+ (1,0) [0|0] "" HMDH_203
 SG_ Ping_Name13 m5 : 200|8@1+ (1,0) [0|0] "" HMDH_203
 SG_ Ping_Name14 m5 : 208|8@1+ (1,0) [0|0] "" HMDH_203
 SG_ Ping_Name15 m5 : 216|8@1+ (1,0) [0|0] "" HMDH_203
 SG_ Ping_FmtVer m5 : 224|8@1+ (1,0) [0|0] "" HMDH_203
 SG_ Ping_GitRev m5 : 232|32@1+ (1,0) [0|0] "" HMDH_203
 SG_ Ping_FwCrc m5 : 264|16@1+ (1,0) [0|0] "" HMDH_203
 SG_ Ping_UptimeS m5 : 280|16@1+ (1,0) [0|0] "s" HMDH_203
 SG_ Ecat_CanId m31 : 8|8@1+ (1,0) [0|0] "" HMDH_203
 SG_ Ecat_Name0 m31 : 16|8@1+ (1,0) [0|0] "" HMDH_203
 SG_ Ecat_Name1 m31 : 24|8@1+ (1,0) [0|0] "" HMDH_203
 SG_ Ecat_Name2 m31 : 32|8@1+ (1,0) [0|0] "" HMDH_203
 SG_ Ecat_Name3 m31 : 40|8@1+ (1,0) [0|0] "" HMDH_203
 SG_ Ecat_Name4 m31 : 48|8@1+ (1,0) [0|0] "" HMDH_203
 SG_ Ecat_Name5 m31 : 56|8@1+ (1,0) [0|0] "" HMDH_203
 SG_ Ecat_Name6 m31 : 64|8@1+ (1,0) [0|0] "" HMDH_203
 SG_ Ecat_Name7 m31 : 72|8@1+ (1,0) [0|0] "" HMDH_203
 SG_ Ecat_Name8 m31 : 80|8@1+ (1,0) [0|0] "" HMDH_203
 SG_ Ecat_Name9 m31 : 88|8@1+ (1,0) [0|0] "" HMDH_203
 SG_ Ecat_Name10 m31 : 96|8@1+ (1,0) [0|0] "" HMDH_203
 SG_ Ecat_Name11 m31 : 104|8@1+ (1,0) [0|0] "" HMDH_203
 SG_ Ecat_Name12 m31 : 112|8@1+ (1,0) [0|0] "" HMDH_203
 SG_ Ecat_Name13 m31 : 120|8@1+ (1,0) [0|0] "" HMDH_203
 SG_ Ecat_Name14 m31 : 128|8@1+ (1,0) [0|0] "" HMDH_203
 SG_ Ecat_Name15 m31 : 136|8@1+ (1,0) [0|0] "" HMDH_203
 SG_ Ecat_Link m31 : 144|8@1+ (1,0) [0|0] "" HMDH_203
 SG_ Ecat_InvalidFrame0 m31 : 152|8@1+ (1,0) [0|0] "" HMDH_203
 SG_ Ecat_InvalidFrame1 m31 : 160|8@1+ (1,0) [0|0] "" HMDH_203
 SG_ Ecat_InvalidFrame2 m31 : 168|8@1+ (1,0) [0|0] "" HMDH_203
 SG_ Ecat_InvalidFrame3 m31 : 176|8@1+ (1,0) [0|0] "" HMDH_203
 SG_ Ecat_RxError0 m31 : 184|8@1+ (1,0) [0|0] "" HMDH_203
 SG_ Ecat_RxError1 m31 : 192|8@1+ (1,0) [0|0] "" HMDH_203
 SG_ Ecat_RxError2 m31 : 200|8@1+ (1,0) [0|0] "" HMDH_203
 SG_ Ecat_RxError3 m31 : 208|8@1+ (1,0) [0|0] "" HMDH_203
 SG_ Ecat_FwdRxError0 m31 : 216|8@1+ (1,0) [0|0] "" HMDH_203
 SG_ Ecat_FwdRxError1 m31 : 224|8@1+ (1,0) [0|0] "" HMDH_203
 SG_ Ecat_FwdRxError2 m31 : 232|8@1+ (1,0) [0|0] "" HMDH_203
 SG_ Ecat_FwdRxError3 m31 : 240|8@1+ (1,0) [0|0] "" HMDH_203
 SG_ Ecat_PuError m31 : 248|8@1+ (1,0) [0|0] "" HMDH_203
 SG_ Ecat_PdiError m31 : 256|8@1+ (1,0) [0|0] "" HMDH_203
 SG_ Ecat_LostLink0 m31 : 264|8@1+ (1,0) [0|0] "" HMDH_203
 SG_ Ecat_LostLink1 m31 : 272|8@1+ (1,0) [0|0] "" HMDH_203
 SG_ Ecat_LostLink2 m31 : 280|8@1+ (1,0) [0|0] "" HMDH_203
 SG_ Ecat_LostLink3 m31 : 288|8@1+ (1,0) [0|0] "" HMDH_203
 SG_ Saf_CanId m32 : 8|8@1+ (1,0) [0|0] "" HMDH_203
 SG_ Saf_Name0 m32 : 16|8@1+ (1,0) [0|0] "" HMDH_203
 SG_ Saf_Name1 m32 : 24|8@1+ (1,0) [0|0] "" HMDH_203
 SG_ Saf_Name2 m32 : 32|8@1+ (1,0) [0|0] "" HMDH_203
 SG_ Saf_Name3 m32 : 40|8@1+ (1,0) [0|0] "" HMDH_203
 SG_ Saf_Name4 m32 : 48|8@1+ (1,0) [0|0] "" HMDH_203
 SG_ Saf_Name5 m32 : 56|8@1+ (1,0) [0|0] "" HMDH_203
 SG_ Saf_Name6 m32 : 64|8@1+ (1,0) [0|0] "" HMDH_203
 SG_ Saf_Name7 m32 : 72|8@1+ (1,0) [0|0] "" HMDH_203
 SG_ Saf_Name8 m32 : 80|8@1+ (1,0) [0|0] "" HMDH_203
 SG_ Saf_Name9 m32 : 88|8@1+ (1,0) [0|0] "" HMDH_203
 SG_ Saf_Name10 m32 : 96|8@1+ (1,0) [0|0] "" HMDH_203
 SG_ Saf_Name11 m32 : 104|8@1+ (1,0) [0|0] "" HMDH_203
 SG_ Saf_Name12 m32 : 112|8@1+ (1,0) [0|0] "" HMDH_203
 SG_ Saf_Name13 m32 : 120|8@1+ (1,0) [0|0] "" HMDH_203
 SG_ Saf_Name14 m32 : 128|8@1+ (1,0) [0|0] "" HMDH_203
 SG_ Saf_Name15 m32 : 136|8@1+ (1,0) [0|0] "" HMDH_203
 SG_ Saf_State m32 : 144|8@1+ (1,0) [0|0] "" HMDH_203
 SG_ Saf_Bits m32 : 152|16@1+ (1,0) [0|0] "" HMDH_203
 SG_ Saf_Estop m32 : 168|8@1+ (1,0) [0|0] "" HMDH_203
 SG_ Saf_FatalLatched m32 : 176|16@1+ (1,0) [0|0] "" HMDH_203
 SG_ Saf_ErrCode m32 : 192|32@1+ (1,0) [0|0] "" HMDH_203

BO_ 2163316428 STATUS_HETC_R_TACT_to_HMDH_204: 48 HETC_R_TACT
 SG_ SubCode M : 0|8@1+ (1,0) [0|0] "" HMDH_204
 SG_ Ping_CanId m5 : 8|8@1+ (1,0) [0|0] "" HMDH_204
 SG_ Ping_HostId m5 : 16|8@1+ (1,0) [0|0] "" HMDH_204
 SG_ Ping_Pid m5 : 24|16@1+ (1,0) [0|0] "" HMDH_204
 SG_ Ping_Bid m5 : 40|16@1+ (1,0) [0|0] "" HMDH_204
 SG_ Ping_Mid m5 : 56|16@1+ (1,0) [0|0] "" HMDH_204
 SG_ Ping_VerMajor m5 : 72|8@1+ (1,0) [0|0] "" HMDH_204
 SG_ Ping_VerMinor m5 : 80|8@1+ (1,0) [0|0] "" HMDH_204
 SG_ Ping_VerPatch m5 : 88|8@1+ (1,0) [0|0] "" HMDH_204
 SG_ Ping_Name0 m5 : 96|8@1+ (1,0) [0|0] "" HMDH_204
 SG_ Ping_Name1 m5 : 104|8@1+ (1,0) [0|0] "" HMDH_204
 SG_ Ping_Name2 m5 : 112|8@1+ (1,0) [0|0] "" HMDH_204
 SG_ Ping_Name3 m5 : 120|8@1+ (1,0) [0|0] "" HMDH_204
 SG_ Ping_Name4 m5 : 128|8@1+ (1,0) [0|0] "" HMDH_204
 SG_ Ping_Name5 m5 : 136|8@1+ (1,0) [0|0] "" HMDH_204
 SG_ Ping_Name6 m5 : 144|8@1+ (1,0) [0|0] "" HMDH_204
 SG_ Ping_Name7 m5 : 152|8@1+ (1,0) [0|0] "" HMDH_204
 SG_ Ping_Name8 m5 : 160|8@1+ (1,0) [0|0] "" HMDH_204
 SG_ Ping_Name9 m5 : 168|8@1+ (1,0) [0|0] "" HMDH_204
 SG_ Ping_Name10 m5 : 176|8@1+ (1,0) [0|0] "" HMDH_204
 SG_ Ping_Name11 m5 : 184|8@1+ (1,0) [0|0] "" HMDH_204
 SG_ Ping_Name12 m5 : 192|8@1+ (1,0) [0|0] "" HMDH_204
 SG_ Ping_Name13 m5 : 200|8@1+ (1,0) [0|0] "" HMDH_204
 SG_ Ping_Name14 m5 : 208|8@1+ (1,0) [0|0] "" HMDH_204
 SG_ Ping_Name15 m5 : 216|8@1+ (1,0) [0|0] "" HMDH_204
 SG_ Ping_FmtVer m5 : 224|8@1+ (1,0) [0|0] "" HMDH_204
 SG_ Ping_GitRev m5 : 232|32@1+ (1,0) [0|0] "" HMDH_204
 SG_ Ping_FwCrc m5 : 264|16@1+ (1,0) [0|0] "" HMDH_204
 SG_ Ping_UptimeS m5 : 280|16@1+ (1,0) [0|0] "s" HMDH_204
 SG_ Ecat_CanId m31 : 8|8@1+ (1,0) [0|0] "" HMDH_204
 SG_ Ecat_Name0 m31 : 16|8@1+ (1,0) [0|0] "" HMDH_204
 SG_ Ecat_Name1 m31 : 24|8@1+ (1,0) [0|0] "" HMDH_204
 SG_ Ecat_Name2 m31 : 32|8@1+ (1,0) [0|0] "" HMDH_204
 SG_ Ecat_Name3 m31 : 40|8@1+ (1,0) [0|0] "" HMDH_204
 SG_ Ecat_Name4 m31 : 48|8@1+ (1,0) [0|0] "" HMDH_204
 SG_ Ecat_Name5 m31 : 56|8@1+ (1,0) [0|0] "" HMDH_204
 SG_ Ecat_Name6 m31 : 64|8@1+ (1,0) [0|0] "" HMDH_204
 SG_ Ecat_Name7 m31 : 72|8@1+ (1,0) [0|0] "" HMDH_204
 SG_ Ecat_Name8 m31 : 80|8@1+ (1,0) [0|0] "" HMDH_204
 SG_ Ecat_Name9 m31 : 88|8@1+ (1,0) [0|0] "" HMDH_204
 SG_ Ecat_Name10 m31 : 96|8@1+ (1,0) [0|0] "" HMDH_204
 SG_ Ecat_Name11 m31 : 104|8@1+ (1,0) [0|0] "" HMDH_204
 SG_ Ecat_Name12 m31 : 112|8@1+ (1,0) [0|0] "" HMDH_204
 SG_ Ecat_Name13 m31 : 120|8@1+ (1,0) [0|0] "" HMDH_204
 SG_ Ecat_Name14 m31 : 128|8@1+ (1,0) [0|0] "" HMDH_204
 SG_ Ecat_Name15 m31 : 136|8@1+ (1,0) [0|0] "" HMDH_204
 SG_ Ecat_Link m31 : 144|8@1+ (1,0) [0|0] "" HMDH_204
 SG_ Ecat_InvalidFrame0 m31 : 152|8@1+ (1,0) [0|0] "" HMDH_204
 SG_ Ecat_InvalidFrame1 m31 : 160|8@1+ (1,0) [0|0] "" HMDH_204
 SG_ Ecat_InvalidFrame2 m31 : 168|8@1+ (1,0) [0|0] "" HMDH_204
 SG_ Ecat_InvalidFrame3 m31 : 176|8@1+ (1,0) [0|0] "" HMDH_204
 SG_ Ecat_RxError0 m31 : 184|8@1+ (1,0) [0|0] "" HMDH_204
 SG_ Ecat_RxError1 m31 : 192|8@1+ (1,0) [0|0] "" HMDH_204
 SG_ Ecat_RxError2 m31 : 200|8@1+ (1,0) [0|0] "" HMDH_204
 SG_ Ecat_RxError3 m31 : 208|8@1+ (1,0) [0|0] "" HMDH_204
 SG_ Ecat_FwdRxError0 m31 : 216|8@1+ (1,0) [0|0] "" HMDH_204
 SG_ Ecat_FwdRxError1 m31 : 224|8@1+ (1,0) [0|0] "" HMDH_204
 SG_ Ecat_FwdRxError2 m31 : 232|8@1+ (1,0) [0|0] "" HMDH_204
 SG_ Ecat_FwdRxError3 m31 : 240|8@1+ (1,0) [0|0] "" HMDH_204
 SG_ Ecat_PuError m31 : 248|8@1+ (1,0) [0|0] "" HMDH_204
 SG_ Ecat_PdiError m31 : 256|8@1+ (1,0) [0|0] "" HMDH_204
 SG_ Ecat_LostLink0 m31 : 264|8@1+ (1,0) [0|0] "" HMDH_204
 SG_ Ecat_LostLink1 m31 : 272|8@1+ (1,0) [0|0] "" HMDH_204
 SG_ Ecat_LostLink2 m31 : 280|8@1+ (1,0) [0|0] "" HMDH_204
 SG_ Ecat_LostLink3 m31 : 288|8@1+ (1,0) [0|0] "" HMDH_204
 SG_ Saf_CanId m32 : 8|8@1+ (1,0) [0|0] "" HMDH_204
 SG_ Saf_Name0 m32 : 16|8@1+ (1,0) [0|0] "" HMDH_204
 SG_ Saf_Name1 m32 : 24|8@1+ (1,0) [0|0] "" HMDH_204
 SG_ Saf_Name2 m32 : 32|8@1+ (1,0) [0|0] "" HMDH_204
 SG_ Saf_Name3 m32 : 40|8@1+ (1,0) [0|0] "" HMDH_204
 SG_ Saf_Name4 m32 : 48|8@1+ (1,0) [0|0] "" HMDH_204
 SG_ Saf_Name5 m32 : 56|8@1+ (1,0) [0|0] "" HMDH_204
 SG_ Saf_Name6 m32 : 64|8@1+ (1,0) [0|0] "" HMDH_204
 SG_ Saf_Name7 m32 : 72|8@1+ (1,0) [0|0] "" HMDH_204
 SG_ Saf_Name8 m32 : 80|8@1+ (1,0) [0|0] "" HMDH_204
 SG_ Saf_Name9 m32 : 88|8@1+ (1,0) [0|0] "" HMDH_204
 SG_ Saf_Name10 m32 : 96|8@1+ (1,0) [0|0] "" HMDH_204
 SG_ Saf_Name11 m32 : 104|8@1+ (1,0) [0|0] "" HMDH_204
 SG_ Saf_Name12 m32 : 112|8@1+ (1,0) [0|0] "" HMDH_204
 SG_ Saf_Name13 m32 : 120|8@1+ (1,0) [0|0] "" HMDH_204
 SG_ Saf_Name14 m32 : 128|8@1+ (1,0) [0|0] "" HMDH_204
 SG_ Saf_Name15 m32 : 136|8@1+ (1,0) [0|0] "" HMDH_204
 SG_ Saf_State m32 : 144|8@1+ (1,0) [0|0] "" HMDH_204
 SG_ Saf_Bits m32 : 152|16@1+ (1,0) [0|0] "" HMDH_204
 SG_ Saf_Estop m32 : 168|8@1+ (1,0) [0|0] "" HMDH_204
 SG_ Saf_FatalLatched m32 : 176|16@1+ (1,0) [0|0] "" HMDH_204
 SG_ Saf_ErrCode m32 : 192|32@1+ (1,0) [0|0] "" HMDH_204

BO_ 2163316429 STATUS_HETC_R_TACT_to_HMDH_205: 48 HETC_R_TACT
 SG_ SubCode M : 0|8@1+ (1,0) [0|0] "" HMDH_205
 SG_ Ping_CanId m5 : 8|8@1+ (1,0) [0|0] "" HMDH_205
 SG_ Ping_HostId m5 : 16|8@1+ (1,0) [0|0] "" HMDH_205
 SG_ Ping_Pid m5 : 24|16@1+ (1,0) [0|0] "" HMDH_205
 SG_ Ping_Bid m5 : 40|16@1+ (1,0) [0|0] "" HMDH_205
 SG_ Ping_Mid m5 : 56|16@1+ (1,0) [0|0] "" HMDH_205
 SG_ Ping_VerMajor m5 : 72|8@1+ (1,0) [0|0] "" HMDH_205
 SG_ Ping_VerMinor m5 : 80|8@1+ (1,0) [0|0] "" HMDH_205
 SG_ Ping_VerPatch m5 : 88|8@1+ (1,0) [0|0] "" HMDH_205
 SG_ Ping_Name0 m5 : 96|8@1+ (1,0) [0|0] "" HMDH_205
 SG_ Ping_Name1 m5 : 104|8@1+ (1,0) [0|0] "" HMDH_205
 SG_ Ping_Name2 m5 : 112|8@1+ (1,0) [0|0] "" HMDH_205
 SG_ Ping_Name3 m5 : 120|8@1+ (1,0) [0|0] "" HMDH_205
 SG_ Ping_Name4 m5 : 128|8@1+ (1,0) [0|0] "" HMDH_205
 SG_ Ping_Name5 m5 : 136|8@1+ (1,0) [0|0] "" HMDH_205
 SG_ Ping_Name6 m5 : 144|8@1+ (1,0) [0|0] "" HMDH_205
 SG_ Ping_Name7 m5 : 152|8@1+ (1,0) [0|0] "" HMDH_205
 SG_ Ping_Name8 m5 : 160|8@1+ (1,0) [0|0] "" HMDH_205
 SG_ Ping_Name9 m5 : 168|8@1+ (1,0) [0|0] "" HMDH_205
 SG_ Ping_Name10 m5 : 176|8@1+ (1,0) [0|0] "" HMDH_205
 SG_ Ping_Name11 m5 : 184|8@1+ (1,0) [0|0] "" HMDH_205
 SG_ Ping_Name12 m5 : 192|8@1+ (1,0) [0|0] "" HMDH_205
 SG_ Ping_Name13 m5 : 200|8@1+ (1,0) [0|0] "" HMDH_205
 SG_ Ping_Name14 m5 : 208|8@1+ (1,0) [0|0] "" HMDH_205
 SG_ Ping_Name15 m5 : 216|8@1+ (1,0) [0|0] "" HMDH_205
 SG_ Ping_FmtVer m5 : 224|8@1+ (1,0) [0|0] "" HMDH_205
 SG_ Ping_GitRev m5 : 232|32@1+ (1,0) [0|0] "" HMDH_205
 SG_ Ping_FwCrc m5 : 264|16@1+ (1,0) [0|0] "" HMDH_205
 SG_ Ping_UptimeS m5 : 280|16@1+ (1,0) [0|0] "s" HMDH_205
 SG_ Ecat_CanId m31 : 8|8@1+ (1,0) [0|0] "" HMDH_205
 SG_ Ecat_Name0 m31 : 16|8@1+ (1,0) [0|0] "" HMDH_205
 SG_ Ecat_Name1 m31 : 24|8@1+ (1,0) [0|0] "" HMDH_205
 SG_ Ecat_Name2 m31 : 32|8@1+ (1,0) [0|0] "" HMDH_205
 SG_ Ecat_Name3 m31 : 40|8@1+ (1,0) [0|0] "" HMDH_205
 SG_ Ecat_Name4 m31 : 48|8@1+ (1,0) [0|0] "" HMDH_205
 SG_ Ecat_Name5 m31 : 56|8@1+ (1,0) [0|0] "" HMDH_205
 SG_ Ecat_Name6 m31 : 64|8@1+ (1,0) [0|0] "" HMDH_205
 SG_ Ecat_Name7 m31 : 72|8@1+ (1,0) [0|0] "" HMDH_205
 SG_ Ecat_Name8 m31 : 80|8@1+ (1,0) [0|0] "" HMDH_205
 SG_ Ecat_Name9 m31 : 88|8@1+ (1,0) [0|0] "" HMDH_205
 SG_ Ecat_Name10 m31 : 96|8@1+ (1,0) [0|0] "" HMDH_205
 SG_ Ecat_Name11 m31 : 104|8@1+ (1,0) [0|0] "" HMDH_205
 SG_ Ecat_Name12 m31 : 112|8@1+ (1,0) [0|0] "" HMDH_205
 SG_ Ecat_Name13 m31 : 120|8@1+ (1,0) [0|0] "" HMDH_205
 SG_ Ecat_Name14 m31 : 128|8@1+ (1,0) [0|0] "" HMDH_205
 SG_ Ecat_Name15 m31 : 136|8@1+ (1,0) [0|0] "" HMDH_205
 SG_ Ecat_Link m31 : 144|8@1+ (1,0) [0|0] "" HMDH_205
 SG_ Ecat_InvalidFrame0 m31 : 152|8@1+ (1,0) [0|0] "" HMDH_205
 SG_ Ecat_InvalidFrame1 m31 : 160|8@1+ (1,0) [0|0] "" HMDH_205
 SG_ Ecat_InvalidFrame2 m31 : 168|8@1+ (1,0) [0|0] "" HMDH_205
 SG_ Ecat_InvalidFrame3 m31 : 176|8@1+ (1,0) [0|0] "" HMDH_205
 SG_ Ecat_RxError0 m31 : 184|8@1+ (1,0) [0|0] "" HMDH_205
 SG_ Ecat_RxError1 m31 : 192|8@1+ (1,0) [0|0] "" HMDH_205
 SG_ Ecat_RxError2 m31 : 200|8@1+ (1,0) [0|0] "" HMDH_205
 SG_ Ecat_RxError3 m31 : 208|8@1+ (1,0) [0|0] "" HMDH_205
 SG_ Ecat_FwdRxError0 m31 : 216|8@1+ (1,0) [0|0] "" HMDH_205
 SG_ Ecat_FwdRxError1 m31 : 224|8@1+ (1,0) [0|0] "" HMDH_205
 SG_ Ecat_FwdRxError2 m31 : 232|8@1+ (1,0) [0|0] "" HMDH_205
 SG_ Ecat_FwdRxError3 m31 : 240|8@1+ (1,0) [0|0] "" HMDH_205
 SG_ Ecat_PuError m31 : 248|8@1+ (1,0) [0|0] "" HMDH_205
 SG_ Ecat_PdiError m31 : 256|8@1+ (1,0) [0|0] "" HMDH_205
 SG_ Ecat_LostLink0 m31 : 264|8@1+ (1,0) [0|0] "" HMDH_205
 SG_ Ecat_LostLink1 m31 : 272|8@1+ (1,0) [0|0] "" HMDH_205
 SG_ Ecat_LostLink2 m31 : 280|8@1+ (1,0) [0|0] "" HMDH_205
 SG_ Ecat_LostLink3 m31 : 288|8@1+ (1,0) [0|0] "" HMDH_205
 SG_ Saf_CanId m32 : 8|8@1+ (1,0) [0|0] "" HMDH_205
 SG_ Saf_Name0 m32 : 16|8@1+ (1,0) [0|0] "" HMDH_205
 SG_ Saf_Name1 m32 : 24|8@1+ (1,0) [0|0] "" HMDH_205
 SG_ Saf_Name2 m32 : 32|8@1+ (1,0) [0|0] "" HMDH_205
 SG_ Saf_Name3 m32 : 40|8@1+ (1,0) [0|0] "" HMDH_205
 SG_ Saf_Name4 m32 : 48|8@1+ (1,0) [0|0] "" HMDH_205
 SG_ Saf_Name5 m32 : 56|8@1+ (1,0) [0|0] "" HMDH_205
 SG_ Saf_Name6 m32 : 64|8@1+ (1,0) [0|0] "" HMDH_205
 SG_ Saf_Name7 m32 : 72|8@1+ (1,0) [0|0] "" HMDH_205
 SG_ Saf_Name8 m32 : 80|8@1+ (1,0) [0|0] "" HMDH_205
 SG_ Saf_Name9 m32 : 88|8@1+ (1,0) [0|0] "" HMDH_205
 SG_ Saf_Name10 m32 : 96|8@1+ (1,0) [0|0] "" HMDH_205
 SG_ Saf_Name11 m32 : 104|8@1+ (1,0) [0|0] "" HMDH_205
 SG_ Saf_Name12 m32 : 112|8@1+ (1,0) [0|0] "" HMDH_205
 SG_ Saf_Name13 m32 : 120|8@1+ (1,0) [0|0] "" HMDH_205
 SG_ Saf_Name14 m32 : 128|8@1+ (1,0) [0|0] "" HMDH_205
 SG_ Saf_Name15 m32 : 136|8@1+ (1,0) [0|0] "" HMDH_205
 SG_ Saf_State m32 : 144|8@1+ (1,0) [0|0] "" HMDH_205
 SG_ Saf_Bits m32 : 152|16@1+ (1,0) [0|0] "" HMDH_205
 SG_ Saf_Estop m32 : 168|8@1+ (1,0) [0|0] "" HMDH_205
 SG_ Saf_FatalLatched m32 : 176|16@1+ (1,0) [0|0] "" HMDH_205
 SG_ Saf_ErrCode m32 : 192|32@1+ (1,0) [0|0] "" HMDH_205

BO_ 2163316430 STATUS_HETC_R_TACT_to_HMDH_206: 48 HETC_R_TACT
 SG_ SubCode M : 0|8@1+ (1,0) [0|0] "" HMDH_206
 SG_ Ping_CanId m5 : 8|8@1+ (1,0) [0|0] "" HMDH_206
 SG_ Ping_HostId m5 : 16|8@1+ (1,0) [0|0] "" HMDH_206
 SG_ Ping_Pid m5 : 24|16@1+ (1,0) [0|0] "" HMDH_206
 SG_ Ping_Bid m5 : 40|16@1+ (1,0) [0|0] "" HMDH_206
 SG_ Ping_Mid m5 : 56|16@1+ (1,0) [0|0] "" HMDH_206
 SG_ Ping_VerMajor m5 : 72|8@1+ (1,0) [0|0] "" HMDH_206
 SG_ Ping_VerMinor m5 : 80|8@1+ (1,0) [0|0] "" HMDH_206
 SG_ Ping_VerPatch m5 : 88|8@1+ (1,0) [0|0] "" HMDH_206
 SG_ Ping_Name0 m5 : 96|8@1+ (1,0) [0|0] "" HMDH_206
 SG_ Ping_Name1 m5 : 104|8@1+ (1,0) [0|0] "" HMDH_206
 SG_ Ping_Name2 m5 : 112|8@1+ (1,0) [0|0] "" HMDH_206
 SG_ Ping_Name3 m5 : 120|8@1+ (1,0) [0|0] "" HMDH_206
 SG_ Ping_Name4 m5 : 128|8@1+ (1,0) [0|0] "" HMDH_206
 SG_ Ping_Name5 m5 : 136|8@1+ (1,0) [0|0] "" HMDH_206
 SG_ Ping_Name6 m5 : 144|8@1+ (1,0) [0|0] "" HMDH_206
 SG_ Ping_Name7 m5 : 152|8@1+ (1,0) [0|0] "" HMDH_206
 SG_ Ping_Name8 m5 : 160|8@1+ (1,0) [0|0] "" HMDH_206
 SG_ Ping_Name9 m5 : 168|8@1+ (1,0) [0|0] "" HMDH_206
 SG_ Ping_Name10 m5 : 176|8@1+ (1,0) [0|0] "" HMDH_206
 SG_ Ping_Name11 m5 : 184|8@1+ (1,0) [0|0] "" HMDH_206
 SG_ Ping_Name12 m5 : 192|8@1+ (1,0) [0|0] "" HMDH_206
 SG_ Ping_Name13 m5 : 200|8@1+ (1,0) [0|0] "" HMDH_206
 SG_ Ping_Name14 m5 : 208|8@1+ (1,0) [0|0] "" HMDH_206
 SG_ Ping_Name15 m5 : 216|8@1+ (1,0) [0|0] "" HMDH_206
 SG_ Ping_FmtVer m5 : 224|8@1+ (1,0) [0|0] "" HMDH_206
 SG_ Ping_GitRev m5 : 232|32@1+ (1,0) [0|0] "" HMDH_206
 SG_ Ping_FwCrc m5 : 264|16@1+ (1,0) [0|0] "" HMDH_206
 SG_ Ping_UptimeS m5 : 280|16@1+ (1,0) [0|0] "s" HMDH_206
 SG_ Ecat_CanId m31 : 8|8@1+ (1,0) [0|0] "" HMDH_206
 SG_ Ecat_Name0 m31 : 16|8@1+ (1,0) [0|0] "" HMDH_206
 SG_ Ecat_Name1 m31 : 24|8@1+ (1,0) [0|0] "" HMDH_206
 SG_ Ecat_Name2 m31 : 32|8@1+ (1,0) [0|0] "" HMDH_206
 SG_ Ecat_Name3 m31 : 40|8@1+ (1,0) [0|0] "" HMDH_206
 SG_ Ecat_Name4 m31 : 48|8@1+ (1,0) [0|0] "" HMDH_206
 SG_ Ecat_Name5 m31 : 56|8@1+ (1,0) [0|0] "" HMDH_206
 SG_ Ecat_Name6 m31 : 64|8@1+ (1,0) [0|0] "" HMDH_206
 SG_ Ecat_Name7 m31 : 72|8@1+ (1,0) [0|0] "" HMDH_206
 SG_ Ecat_Name8 m31 : 80|8@1+ (1,0) [0|0] "" HMDH_206
 SG_ Ecat_Name9 m31 : 88|8@1+ (1,0) [0|0] "" HMDH_206
 SG_ Ecat_Name10 m31 : 96|8@1+ (1,0) [0|0] "" HMDH_206
 SG_ Ecat_Name11 m31 : 104|8@1+ (1,0) [0|0] "" HMDH_206
 SG_ Ecat_Name12 m31 : 112|8@1+ (1,0) [0|0] "" HMDH_206
 SG_ Ecat_Name13 m31 : 120|8@1+ (1,0) [0|0] "" HMDH_206
 SG_ Ecat_Name14 m31 : 128|8@1+ (1,0) [0|0] "" HMDH_206
 SG_ Ecat_Name15 m31 : 136|8@1+ (1,0) [0|0] "" HMDH_206
 SG_ Ecat_Link m31 : 144|8@1+ (1,0) [0|0] "" HMDH_206
 SG_ Ecat_InvalidFrame0 m31 : 152|8@1+ (1,0) [0|0] "" HMDH_206
 SG_ Ecat_InvalidFrame1 m31 : 160|8@1+ (1,0) [0|0] "" HMDH_206
 SG_ Ecat_InvalidFrame2 m31 : 168|8@1+ (1,0) [0|0] "" HMDH_206
 SG_ Ecat_InvalidFrame3 m31 : 176|8@1+ (1,0) [0|0] "" HMDH_206
 SG_ Ecat_RxError0 m31 : 184|8@1+ (1,0) [0|0] "" HMDH_206
 SG_ Ecat_RxError1 m31 : 192|8@1+ (1,0) [0|0] "" HMDH_206
 SG_ Ecat_RxError2 m31 : 200|8@1+ (1,0) [0|0] "" HMDH_206
 SG_ Ecat_RxError3 m31 : 208|8@1+ (1,0) [0|0] "" HMDH_206
 SG_ Ecat_FwdRxError0 m31 : 216|8@1+ (1,0) [0|0] "" HMDH_206
 SG_ Ecat_FwdRxError1 m31 : 224|8@1+ (1,0) [0|0] "" HMDH_206
 SG_ Ecat_FwdRxError2 m31 : 232|8@1+ (1,0) [0|0] "" HMDH_206
 SG_ Ecat_FwdRxError3 m31 : 240|8@1+ (1,0) [0|0] "" HMDH_206
 SG_ Ecat_PuError m31 : 248|8@1+ (1,0) [0|0] "" HMDH_206
 SG_ Ecat_PdiError m31 : 256|8@1+ (1,0) [0|0] "" HMDH_206
 SG_ Ecat_LostLink0 m31 : 264|8@1+ (1,0) [0|0] "" HMDH_206
 SG_ Ecat_LostLink1 m31 : 272|8@1+ (1,0) [0|0] "" HMDH_206
 SG_ Ecat_LostLink2 m31 : 280|8@1+ (1,0) [0|0] "" HMDH_206
 SG_ Ecat_LostLink3 m31 : 288|8@1+ (1,0) [0|0] "" HMDH_206
 SG_ Saf_CanId m32 : 8|8@1+ (1,0) [0|0] "" HMDH_206
 SG_ Saf_Name0 m32 : 16|8@1+ (1,0) [0|0] "" HMDH_206
 SG_ Saf_Name1 m32 : 24|8@1+ (1,0) [0|0] "" HMDH_206
 SG_ Saf_Name2 m32 : 32|8@1+ (1,0) [0|0] "" HMDH_206
 SG_ Saf_Name3 m32 : 40|8@1+ (1,0) [0|0] "" HMDH_206
 SG_ Saf_Name4 m32 : 48|8@1+ (1,0) [0|0] "" HMDH_206
 SG_ Saf_Name5 m32 : 56|8@1+ (1,0) [0|0] "" HMDH_206
 SG_ Saf_Name6 m32 : 64|8@1+ (1,0) [0|0] "" HMDH_206
 SG_ Saf_Name7 m32 : 72|8@1+ (1,0) [0|0] "" HMDH_206
 SG_ Saf_Name8 m32 : 80|8@1+ (1,0) [0|0] "" HMDH_206
 SG_ Saf_Name9 m32 : 88|8@1+ (1,0) [0|0] "" HMDH_206
 SG_ Saf_Name10 m32 : 96|8@1+ (1,0) [0|0] "" HMDH_206
 SG_ Saf_Name11 m32 : 104|8@1+ (1,0) [0|0] "" HMDH_206
 SG_ Saf_Name12 m32 : 112|8@1+ (1,0) [0|0] "" HMDH_206
 SG_ Saf_Name13 m32 : 120|8@1+ (1,0) [0|0] "" HMDH_206
 SG_ Saf_Name14 m32 : 128|8@1+ (1,0) [0|0] "" HMDH_206
 SG_ Saf_Name15 m32 : 136|8@1+ (1,0) [0|0] "" HMDH_206
 SG_ Saf_State m32 : 144|8@1+ (1,0) [0|0] "" HMDH_206
 SG_ Saf_Bits m32 : 152|16@1+ (1,0) [0|0] "" HMDH_206
 SG_ Saf_Estop m32 : 168|8@1+ (1,0) [0|0] "" HMDH_206
 SG_ Saf_FatalLatched m32 : 176|16@1+ (1,0) [0|0] "" HMDH_206
 SG_ Saf_ErrCode m32 : 192|32@1+ (1,0) [0|0] "" HMDH_206

BO_ 2163316431 STATUS_HETC_R_TACT_to_HMDH_207: 48 HETC_R_TACT
 SG_ SubCode M : 0|8@1+ (1,0) [0|0] "" HMDH_207
 SG_ Ping_CanId m5 : 8|8@1+ (1,0) [0|0] "" HMDH_207
 SG_ Ping_HostId m5 : 16|8@1+ (1,0) [0|0] "" HMDH_207
 SG_ Ping_Pid m5 : 24|16@1+ (1,0) [0|0] "" HMDH_207
 SG_ Ping_Bid m5 : 40|16@1+ (1,0) [0|0] "" HMDH_207
 SG_ Ping_Mid m5 : 56|16@1+ (1,0) [0|0] "" HMDH_207
 SG_ Ping_VerMajor m5 : 72|8@1+ (1,0) [0|0] "" HMDH_207
 SG_ Ping_VerMinor m5 : 80|8@1+ (1,0) [0|0] "" HMDH_207
 SG_ Ping_VerPatch m5 : 88|8@1+ (1,0) [0|0] "" HMDH_207
 SG_ Ping_Name0 m5 : 96|8@1+ (1,0) [0|0] "" HMDH_207
 SG_ Ping_Name1 m5 : 104|8@1+ (1,0) [0|0] "" HMDH_207
 SG_ Ping_Name2 m5 : 112|8@1+ (1,0) [0|0] "" HMDH_207
 SG_ Ping_Name3 m5 : 120|8@1+ (1,0) [0|0] "" HMDH_207
 SG_ Ping_Name4 m5 : 128|8@1+ (1,0) [0|0] "" HMDH_207
 SG_ Ping_Name5 m5 : 136|8@1+ (1,0) [0|0] "" HMDH_207
 SG_ Ping_Name6 m5 : 144|8@1+ (1,0) [0|0] "" HMDH_207
 SG_ Ping_Name7 m5 : 152|8@1+ (1,0) [0|0] "" HMDH_207
 SG_ Ping_Name8 m5 : 160|8@1+ (1,0) [0|0] "" HMDH_207
 SG_ Ping_Name9 m5 : 168|8@1+ (1,0) [0|0] "" HMDH_207
 SG_ Ping_Name10 m5 : 176|8@1+ (1,0) [0|0] "" HMDH_207
 SG_ Ping_Name11 m5 : 184|8@1+ (1,0) [0|0] "" HMDH_207
 SG_ Ping_Name12 m5 : 192|8@1+ (1,0) [0|0] "" HMDH_207
 SG_ Ping_Name13 m5 : 200|8@1+ (1,0) [0|0] "" HMDH_207
 SG_ Ping_Name14 m5 : 208|8@1+ (1,0) [0|0] "" HMDH_207
 SG_ Ping_Name15 m5 : 216|8@1+ (1,0) [0|0] "" HMDH_207
 SG_ Ping_FmtVer m5 : 224|8@1+ (1,0) [0|0] "" HMDH_207
 SG_ Ping_GitRev m5 : 232|32@1+ (1,0) [0|0] "" HMDH_207
 SG_ Ping_FwCrc m5 : 264|16@1+ (1,0) [0|0] "" HMDH_207
 SG_ Ping_UptimeS m5 : 280|16@1+ (1,0) [0|0] "s" HMDH_207
 SG_ Ecat_CanId m31 : 8|8@1+ (1,0) [0|0] "" HMDH_207
 SG_ Ecat_Name0 m31 : 16|8@1+ (1,0) [0|0] "" HMDH_207
 SG_ Ecat_Name1 m31 : 24|8@1+ (1,0) [0|0] "" HMDH_207
 SG_ Ecat_Name2 m31 : 32|8@1+ (1,0) [0|0] "" HMDH_207
 SG_ Ecat_Name3 m31 : 40|8@1+ (1,0) [0|0] "" HMDH_207
 SG_ Ecat_Name4 m31 : 48|8@1+ (1,0) [0|0] "" HMDH_207
 SG_ Ecat_Name5 m31 : 56|8@1+ (1,0) [0|0] "" HMDH_207
 SG_ Ecat_Name6 m31 : 64|8@1+ (1,0) [0|0] "" HMDH_207
 SG_ Ecat_Name7 m31 : 72|8@1+ (1,0) [0|0] "" HMDH_207
 SG_ Ecat_Name8 m31 : 80|8@1+ (1,0) [0|0] "" HMDH_207
 SG_ Ecat_Name9 m31 : 88|8@1+ (1,0) [0|0] "" HMDH_207
 SG_ Ecat_Name10 m31 : 96|8@1+ (1,0) [0|0] "" HMDH_207
 SG_ Ecat_Name11 m31 : 104|8@1+ (1,0) [0|0] "" HMDH_207
 SG_ Ecat_Name12 m31 : 112|8@1+ (1,0) [0|0] "" HMDH_207
 SG_ Ecat_Name13 m31 : 120|8@1+ (1,0) [0|0] "" HMDH_207
 SG_ Ecat_Name14 m31 : 128|8@1+ (1,0) [0|0] "" HMDH_207
 SG_ Ecat_Name15 m31 : 136|8@1+ (1,0) [0|0] "" HMDH_207
 SG_ Ecat_Link m31 : 144|8@1+ (1,0) [0|0] "" HMDH_207
 SG_ Ecat_InvalidFrame0 m31 : 152|8@1+ (1,0) [0|0] "" HMDH_207
 SG_ Ecat_InvalidFrame1 m31 : 160|8@1+ (1,0) [0|0] "" HMDH_207
 SG_ Ecat_InvalidFrame2 m31 : 168|8@1+ (1,0) [0|0] "" HMDH_207
 SG_ Ecat_InvalidFrame3 m31 : 176|8@1+ (1,0) [0|0] "" HMDH_207
 SG_ Ecat_RxError0 m31 : 184|8@1+ (1,0) [0|0] "" HMDH_207
 SG_ Ecat_RxError1 m31 : 192|8@1+ (1,0) [0|0] "" HMDH_207
 SG_ Ecat_RxError2 m31 : 200|8@1+ (1,0) [0|0] "" HMDH_207
 SG_ Ecat_RxError3 m31 : 208|8@1+ (1,0) [0|0] "" HMDH_207
 SG_ Ecat_FwdRxError0 m31 : 216|8@1+ (1,0) [0|0] "" HMDH_207
 SG_ Ecat_FwdRxError1 m31 : 224|8@1+ (1,0) [0|0] "" HMDH_207
 SG_ Ecat_FwdRxError2 m31 : 232|8@1+ (1,0) [0|0] "" HMDH_207
 SG_ Ecat_FwdRxError3 m31 : 240|8@1+ (1,0) [0|0] "" HMDH_207
 SG_ Ecat_PuError m31 : 248|8@1+ (1,0) [0|0] "" HMDH_207
 SG_ Ecat_PdiError m31 : 256|8@1+ (1,0) [0|0] "" HMDH_207
 SG_ Ecat_LostLink0 m31 : 264|8@1+ (1,0) [0|0] "" HMDH_207
 SG_ Ecat_LostLink1 m31 : 272|8@1+ (1,0) [0|0] "" HMDH_207
 SG_ Ecat_LostLink2 m31 : 280|8@1+ (1,0) [0|0] "" HMDH_207
 SG_ Ecat_LostLink3 m31 : 288|8@1+ (1,0) [0|0] "" HMDH_207
 SG_ Saf_CanId m32 : 8|8@1+ (1,0) [0|0] "" HMDH_207
 SG_ Saf_Name0 m32 : 16|8@1+ (1,0) [0|0] "" HMDH_207
 SG_ Saf_Name1 m32 : 24|8@1+ (1,0) [0|0] "" HMDH_207
 SG_ Saf_Name2 m32 : 32|8@1+ (1,0) [0|0] "" HMDH_207
 SG_ Saf_Name3 m32 : 40|8@1+ (1,0) [0|0] "" HMDH_207
 SG_ Saf_Name4 m32 : 48|8@1+ (1,0) [0|0] "" HMDH_207
 SG_ Saf_Name5 m32 : 56|8@1+ (1,0) [0|0] "" HMDH_207
 SG_ Saf_Name6 m32 : 64|8@1+ (1,0) [0|0] "" HMDH_207
 SG_ Saf_Name7 m32 : 72|8@1+ (1,0) [0|0] "" HMDH_207
 SG_ Saf_Name8 m32 : 80|8@1+ (1,0) [0|0] "" HMDH_207
 SG_ Saf_Name9 m32 : 88|8@1+ (1,0) [0|0] "" HMDH_207
 SG_ Saf_Name10 m32 : 96|8@1+ (1,0) [0|0] "" HMDH_207
 SG_ Saf_Name11 m32 : 104|8@1+ (1,0) [0|0] "" HMDH_207
 SG_ Saf_Name12 m32 : 112|8@1+ (1,0) [0|0] "" HMDH_207
 SG_ Saf_Name13 m32 : 120|8@1+ (1,0) [0|0] "" HMDH_207
 SG_ Saf_Name14 m32 : 128|8@1+ (1,0) [0|0] "" HMDH_207
 SG_ Saf_Name15 m32 : 136|8@1+ (1,0) [0|0] "" HMDH_207
 SG_ Saf_State m32 : 144|8@1+ (1,0) [0|0] "" HMDH_207
 SG_ Saf_Bits m32 : 152|16@1+ (1,0) [0|0] "" HMDH_207
 SG_ Saf_Estop m32 : 168|8@1+ (1,0) [0|0] "" HMDH_207
 SG_ Saf_FatalLatched m32 : 176|16@1+ (1,0) [0|0] "" HMDH_207
 SG_ Saf_ErrCode m32 : 192|32@1+ (1,0) [0|0] "" HMDH_207

BO_ 2163329380 STATUS_HMDH_201_to_HETC_M_MOB: 48 HMDH_201
 SG_ SubCode M : 0|8@1+ (1,0) [0|0] "" HETC_M_MOB
 SG_ Ping_CanId m5 : 8|8@1+ (1,0) [0|0] "" HETC_M_MOB
 SG_ Ping_HostId m5 : 16|8@1+ (1,0) [0|0] "" HETC_M_MOB
 SG_ Ping_Pid m5 : 24|16@1+ (1,0) [0|0] "" HETC_M_MOB
 SG_ Ping_Bid m5 : 40|16@1+ (1,0) [0|0] "" HETC_M_MOB
 SG_ Ping_Mid m5 : 56|16@1+ (1,0) [0|0] "" HETC_M_MOB
 SG_ Ping_VerMajor m5 : 72|8@1+ (1,0) [0|0] "" HETC_M_MOB
 SG_ Ping_VerMinor m5 : 80|8@1+ (1,0) [0|0] "" HETC_M_MOB
 SG_ Ping_VerPatch m5 : 88|8@1+ (1,0) [0|0] "" HETC_M_MOB
 SG_ Ping_Name0 m5 : 96|8@1+ (1,0) [0|0] "" HETC_M_MOB
 SG_ Ping_Name1 m5 : 104|8@1+ (1,0) [0|0] "" HETC_M_MOB
 SG_ Ping_Name2 m5 : 112|8@1+ (1,0) [0|0] "" HETC_M_MOB
 SG_ Ping_Name3 m5 : 120|8@1+ (1,0) [0|0] "" HETC_M_MOB
 SG_ Ping_Name4 m5 : 128|8@1+ (1,0) [0|0] "" HETC_M_MOB
 SG_ Ping_Name5 m5 : 136|8@1+ (1,0) [0|0] "" HETC_M_MOB
 SG_ Ping_Name6 m5 : 144|8@1+ (1,0) [0|0] "" HETC_M_MOB
 SG_ Ping_Name7 m5 : 152|8@1+ (1,0) [0|0] "" HETC_M_MOB
 SG_ Ping_Name8 m5 : 160|8@1+ (1,0) [0|0] "" HETC_M_MOB
 SG_ Ping_Name9 m5 : 168|8@1+ (1,0) [0|0] "" HETC_M_MOB
 SG_ Ping_Name10 m5 : 176|8@1+ (1,0) [0|0] "" HETC_M_MOB
 SG_ Ping_Name11 m5 : 184|8@1+ (1,0) [0|0] "" HETC_M_MOB
 SG_ Ping_Name12 m5 : 192|8@1+ (1,0) [0|0] "" HETC_M_MOB
 SG_ Ping_Name13 m5 : 200|8@1+ (1,0) [0|0] "" HETC_M_MOB
 SG_ Ping_Name14 m5 : 208|8@1+ (1,0) [0|0] "" HETC_M_MOB
 SG_ Ping_Name15 m5 : 216|8@1+ (1,0) [0|0] "" HETC_M_MOB
 SG_ Ping_FmtVer m5 : 224|8@1+ (1,0) [0|0] "" HETC_M_MOB
 SG_ Ping_GitRev m5 : 232|32@1+ (1,0) [0|0] "" HETC_M_MOB
 SG_ Ping_FwCrc m5 : 264|16@1+ (1,0) [0|0] "" HETC_M_MOB
 SG_ Ping_UptimeS m5 : 280|16@1+ (1,0) [0|0] "s" HETC_M_MOB
 SG_ Ecat_CanId m31 : 8|8@1+ (1,0) [0|0] "" HETC_M_MOB
 SG_ Ecat_Name0 m31 : 16|8@1+ (1,0) [0|0] "" HETC_M_MOB
 SG_ Ecat_Name1 m31 : 24|8@1+ (1,0) [0|0] "" HETC_M_MOB
 SG_ Ecat_Name2 m31 : 32|8@1+ (1,0) [0|0] "" HETC_M_MOB
 SG_ Ecat_Name3 m31 : 40|8@1+ (1,0) [0|0] "" HETC_M_MOB
 SG_ Ecat_Name4 m31 : 48|8@1+ (1,0) [0|0] "" HETC_M_MOB
 SG_ Ecat_Name5 m31 : 56|8@1+ (1,0) [0|0] "" HETC_M_MOB
 SG_ Ecat_Name6 m31 : 64|8@1+ (1,0) [0|0] "" HETC_M_MOB
 SG_ Ecat_Name7 m31 : 72|8@1+ (1,0) [0|0] "" HETC_M_MOB
 SG_ Ecat_Name8 m31 : 80|8@1+ (1,0) [0|0] "" HETC_M_MOB
 SG_ Ecat_Name9 m31 : 88|8@1+ (1,0) [0|0] "" HETC_M_MOB
 SG_ Ecat_Name10 m31 : 96|8@1+ (1,0) [0|0] "" HETC_M_MOB
 SG_ Ecat_Name11 m31 : 104|8@1+ (1,0) [0|0] "" HETC_M_MOB
 SG_ Ecat_Name12 m31 : 112|8@1+ (1,0) [0|0] "" HETC_M_MOB
 SG_ Ecat_Name13 m31 : 120|8@1+ (1,0) [0|0] "" HETC_M_MOB
 SG_ Ecat_Name14 m31 : 128|8@1+ (1,0) [0|0] "" HETC_M_MOB
 SG_ Ecat_Name15 m31 : 136|8@1+ (1,0) [0|0] "" HETC_M_MOB
 SG_ Ecat_Link m31 : 144|8@1+ (1,0) [0|0] "" HETC_M_MOB
 SG_ Ecat_InvalidFrame0 m31 : 152|8@1+ (1,0) [0|0] "" HETC_M_MOB
 SG_ Ecat_InvalidFrame1 m31 : 160|8@1+ (1,0) [0|0] "" HETC_M_MOB
 SG_ Ecat_InvalidFrame2 m31 : 168|8@1+ (1,0) [0|0] "" HETC_M_MOB
 SG_ Ecat_InvalidFrame3 m31 : 176|8@1+ (1,0) [0|0] "" HETC_M_MOB
 SG_ Ecat_RxError0 m31 : 184|8@1+ (1,0) [0|0] "" HETC_M_MOB
 SG_ Ecat_RxError1 m31 : 192|8@1+ (1,0) [0|0] "" HETC_M_MOB
 SG_ Ecat_RxError2 m31 : 200|8@1+ (1,0) [0|0] "" HETC_M_MOB
 SG_ Ecat_RxError3 m31 : 208|8@1+ (1,0) [0|0] "" HETC_M_MOB
 SG_ Ecat_FwdRxError0 m31 : 216|8@1+ (1,0) [0|0] "" HETC_M_MOB
 SG_ Ecat_FwdRxError1 m31 : 224|8@1+ (1,0) [0|0] "" HETC_M_MOB
 SG_ Ecat_FwdRxError2 m31 : 232|8@1+ (1,0) [0|0] "" HETC_M_MOB
 SG_ Ecat_FwdRxError3 m31 : 240|8@1+ (1,0) [0|0] "" HETC_M_MOB
 SG_ Ecat_PuError m31 : 248|8@1+ (1,0) [0|0] "" HETC_M_MOB
 SG_ Ecat_PdiError m31 : 256|8@1+ (1,0) [0|0] "" HETC_M_MOB
 SG_ Ecat_LostLink0 m31 : 264|8@1+ (1,0) [0|0] "" HETC_M_MOB
 SG_ Ecat_LostLink1 m31 : 272|8@1+ (1,0) [0|0] "" HETC_M_MOB
 SG_ Ecat_LostLink2 m31 : 280|8@1+ (1,0) [0|0] "" HETC_M_MOB
 SG_ Ecat_LostLink3 m31 : 288|8@1+ (1,0) [0|0] "" HETC_M_MOB
 SG_ Saf_CanId m32 : 8|8@1+ (1,0) [0|0] "" HETC_M_MOB
 SG_ Saf_Name0 m32 : 16|8@1+ (1,0) [0|0] "" HETC_M_MOB
 SG_ Saf_Name1 m32 : 24|8@1+ (1,0) [0|0] "" HETC_M_MOB
 SG_ Saf_Name2 m32 : 32|8@1+ (1,0) [0|0] "" HETC_M_MOB
 SG_ Saf_Name3 m32 : 40|8@1+ (1,0) [0|0] "" HETC_M_MOB
 SG_ Saf_Name4 m32 : 48|8@1+ (1,0) [0|0] "" HETC_M_MOB
 SG_ Saf_Name5 m32 : 56|8@1+ (1,0) [0|0] "" HETC_M_MOB
 SG_ Saf_Name6 m32 : 64|8@1+ (1,0) [0|0] "" HETC_M_MOB
 SG_ Saf_Name7 m32 : 72|8@1+ (1,0) [0|0] "" HETC_M_MOB
 SG_ Saf_Name8 m32 : 80|8@1+ (1,0) [0|0] "" HETC_M_MOB
 SG_ Saf_Name9 m32 : 88|8@1+ (1,0) [0|0] "" HETC_M_MOB
 SG_ Saf_Name10 m32 : 96|8@1+ (1,0) [0|0] "" HETC_M_MOB
 SG_ Saf_Name11 m32 : 104|8@1+ (1,0) [0|0] "" HETC_M_MOB
 SG_ Saf_Name12 m32 : 112|8@1+ (1,0) [0|0] "" HETC_M_MOB
 SG_ Saf_Name13 m32 : 120|8@1+ (1,0) [0|0] "" HETC_M_MOB
 SG_ Saf_Name14 m32 : 128|8@1+ (1,0) [0|0] "" HETC_M_MOB
 SG_ Saf_Name15 m32 : 136|8@1+ (1,0) [0|0] "" HETC_M_MOB
 SG_ Saf_State m32 : 144|8@1+ (1,0) [0|0] "" HETC_M_MOB
 SG_ Saf_Bits m32 : 152|16@1+ (1,0) [0|0] "" HETC_M_MOB
 SG_ Saf_Estop m32 : 168|8@1+ (1,0) [0|0] "" HETC_M_MOB
 SG_ Saf_FatalLatched m32 : 176|16@1+ (1,0) [0|0] "" HETC_M_MOB
 SG_ Saf_ErrCode m32 : 192|32@1+ (1,0) [0|0] "" HETC_M_MOB

BO_ 2163329390 STATUS_HMDH_201_to_HETC_M_WST: 48 HMDH_201
 SG_ SubCode M : 0|8@1+ (1,0) [0|0] "" HETC_M_WST
 SG_ Ping_CanId m5 : 8|8@1+ (1,0) [0|0] "" HETC_M_WST
 SG_ Ping_HostId m5 : 16|8@1+ (1,0) [0|0] "" HETC_M_WST
 SG_ Ping_Pid m5 : 24|16@1+ (1,0) [0|0] "" HETC_M_WST
 SG_ Ping_Bid m5 : 40|16@1+ (1,0) [0|0] "" HETC_M_WST
 SG_ Ping_Mid m5 : 56|16@1+ (1,0) [0|0] "" HETC_M_WST
 SG_ Ping_VerMajor m5 : 72|8@1+ (1,0) [0|0] "" HETC_M_WST
 SG_ Ping_VerMinor m5 : 80|8@1+ (1,0) [0|0] "" HETC_M_WST
 SG_ Ping_VerPatch m5 : 88|8@1+ (1,0) [0|0] "" HETC_M_WST
 SG_ Ping_Name0 m5 : 96|8@1+ (1,0) [0|0] "" HETC_M_WST
 SG_ Ping_Name1 m5 : 104|8@1+ (1,0) [0|0] "" HETC_M_WST
 SG_ Ping_Name2 m5 : 112|8@1+ (1,0) [0|0] "" HETC_M_WST
 SG_ Ping_Name3 m5 : 120|8@1+ (1,0) [0|0] "" HETC_M_WST
 SG_ Ping_Name4 m5 : 128|8@1+ (1,0) [0|0] "" HETC_M_WST
 SG_ Ping_Name5 m5 : 136|8@1+ (1,0) [0|0] "" HETC_M_WST
 SG_ Ping_Name6 m5 : 144|8@1+ (1,0) [0|0] "" HETC_M_WST
 SG_ Ping_Name7 m5 : 152|8@1+ (1,0) [0|0] "" HETC_M_WST
 SG_ Ping_Name8 m5 : 160|8@1+ (1,0) [0|0] "" HETC_M_WST
 SG_ Ping_Name9 m5 : 168|8@1+ (1,0) [0|0] "" HETC_M_WST
 SG_ Ping_Name10 m5 : 176|8@1+ (1,0) [0|0] "" HETC_M_WST
 SG_ Ping_Name11 m5 : 184|8@1+ (1,0) [0|0] "" HETC_M_WST
 SG_ Ping_Name12 m5 : 192|8@1+ (1,0) [0|0] "" HETC_M_WST
 SG_ Ping_Name13 m5 : 200|8@1+ (1,0) [0|0] "" HETC_M_WST
 SG_ Ping_Name14 m5 : 208|8@1+ (1,0) [0|0] "" HETC_M_WST
 SG_ Ping_Name15 m5 : 216|8@1+ (1,0) [0|0] "" HETC_M_WST
 SG_ Ping_FmtVer m5 : 224|8@1+ (1,0) [0|0] "" HETC_M_WST
 SG_ Ping_GitRev m5 : 232|32@1+ (1,0) [0|0] "" HETC_M_WST
 SG_ Ping_FwCrc m5 : 264|16@1+ (1,0) [0|0] "" HETC_M_WST
 SG_ Ping_UptimeS m5 : 280|16@1+ (1,0) [0|0] "s" HETC_M_WST
 SG_ Ecat_CanId m31 : 8|8@1+ (1,0) [0|0] "" HETC_M_WST
 SG_ Ecat_Name0 m31 : 16|8@1+ (1,0) [0|0] "" HETC_M_WST
 SG_ Ecat_Name1 m31 : 24|8@1+ (1,0) [0|0] "" HETC_M_WST
 SG_ Ecat_Name2 m31 : 32|8@1+ (1,0) [0|0] "" HETC_M_WST
 SG_ Ecat_Name3 m31 : 40|8@1+ (1,0) [0|0] "" HETC_M_WST
 SG_ Ecat_Name4 m31 : 48|8@1+ (1,0) [0|0] "" HETC_M_WST
 SG_ Ecat_Name5 m31 : 56|8@1+ (1,0) [0|0] "" HETC_M_WST
 SG_ Ecat_Name6 m31 : 64|8@1+ (1,0) [0|0] "" HETC_M_WST
 SG_ Ecat_Name7 m31 : 72|8@1+ (1,0) [0|0] "" HETC_M_WST
 SG_ Ecat_Name8 m31 : 80|8@1+ (1,0) [0|0] "" HETC_M_WST
 SG_ Ecat_Name9 m31 : 88|8@1+ (1,0) [0|0] "" HETC_M_WST
 SG_ Ecat_Name10 m31 : 96|8@1+ (1,0) [0|0] "" HETC_M_WST
 SG_ Ecat_Name11 m31 : 104|8@1+ (1,0) [0|0] "" HETC_M_WST
 SG_ Ecat_Name12 m31 : 112|8@1+ (1,0) [0|0] "" HETC_M_WST
 SG_ Ecat_Name13 m31 : 120|8@1+ (1,0) [0|0] "" HETC_M_WST
 SG_ Ecat_Name14 m31 : 128|8@1+ (1,0) [0|0] "" HETC_M_WST
 SG_ Ecat_Name15 m31 : 136|8@1+ (1,0) [0|0] "" HETC_M_WST
 SG_ Ecat_Link m31 : 144|8@1+ (1,0) [0|0] "" HETC_M_WST
 SG_ Ecat_InvalidFrame0 m31 : 152|8@1+ (1,0) [0|0] "" HETC_M_WST
 SG_ Ecat_InvalidFrame1 m31 : 160|8@1+ (1,0) [0|0] "" HETC_M_WST
 SG_ Ecat_InvalidFrame2 m31 : 168|8@1+ (1,0) [0|0] "" HETC_M_WST
 SG_ Ecat_InvalidFrame3 m31 : 176|8@1+ (1,0) [0|0] "" HETC_M_WST
 SG_ Ecat_RxError0 m31 : 184|8@1+ (1,0) [0|0] "" HETC_M_WST
 SG_ Ecat_RxError1 m31 : 192|8@1+ (1,0) [0|0] "" HETC_M_WST
 SG_ Ecat_RxError2 m31 : 200|8@1+ (1,0) [0|0] "" HETC_M_WST
 SG_ Ecat_RxError3 m31 : 208|8@1+ (1,0) [0|0] "" HETC_M_WST
 SG_ Ecat_FwdRxError0 m31 : 216|8@1+ (1,0) [0|0] "" HETC_M_WST
 SG_ Ecat_FwdRxError1 m31 : 224|8@1+ (1,0) [0|0] "" HETC_M_WST
 SG_ Ecat_FwdRxError2 m31 : 232|8@1+ (1,0) [0|0] "" HETC_M_WST
 SG_ Ecat_FwdRxError3 m31 : 240|8@1+ (1,0) [0|0] "" HETC_M_WST
 SG_ Ecat_PuError m31 : 248|8@1+ (1,0) [0|0] "" HETC_M_WST
 SG_ Ecat_PdiError m31 : 256|8@1+ (1,0) [0|0] "" HETC_M_WST
 SG_ Ecat_LostLink0 m31 : 264|8@1+ (1,0) [0|0] "" HETC_M_WST
 SG_ Ecat_LostLink1 m31 : 272|8@1+ (1,0) [0|0] "" HETC_M_WST
 SG_ Ecat_LostLink2 m31 : 280|8@1+ (1,0) [0|0] "" HETC_M_WST
 SG_ Ecat_LostLink3 m31 : 288|8@1+ (1,0) [0|0] "" HETC_M_WST
 SG_ Saf_CanId m32 : 8|8@1+ (1,0) [0|0] "" HETC_M_WST
 SG_ Saf_Name0 m32 : 16|8@1+ (1,0) [0|0] "" HETC_M_WST
 SG_ Saf_Name1 m32 : 24|8@1+ (1,0) [0|0] "" HETC_M_WST
 SG_ Saf_Name2 m32 : 32|8@1+ (1,0) [0|0] "" HETC_M_WST
 SG_ Saf_Name3 m32 : 40|8@1+ (1,0) [0|0] "" HETC_M_WST
 SG_ Saf_Name4 m32 : 48|8@1+ (1,0) [0|0] "" HETC_M_WST
 SG_ Saf_Name5 m32 : 56|8@1+ (1,0) [0|0] "" HETC_M_WST
 SG_ Saf_Name6 m32 : 64|8@1+ (1,0) [0|0] "" HETC_M_WST
 SG_ Saf_Name7 m32 : 72|8@1+ (1,0) [0|0] "" HETC_M_WST
 SG_ Saf_Name8 m32 : 80|8@1+ (1,0) [0|0] "" HETC_M_WST
 SG_ Saf_Name9 m32 : 88|8@1+ (1,0) [0|0] "" HETC_M_WST
 SG_ Saf_Name10 m32 : 96|8@1+ (1,0) [0|0] "" HETC_M_WST
 SG_ Saf_Name11 m32 : 104|8@1+ (1,0) [0|0] "" HETC_M_WST
 SG_ Saf_Name12 m32 : 112|8@1+ (1,0) [0|0] "" HETC_M_WST
 SG_ Saf_Name13 m32 : 120|8@1+ (1,0) [0|0] "" HETC_M_WST
 SG_ Saf_Name14 m32 : 128|8@1+ (1,0) [0|0] "" HETC_M_WST
 SG_ Saf_Name15 m32 : 136|8@1+ (1,0) [0|0] "" HETC_M_WST
 SG_ Saf_State m32 : 144|8@1+ (1,0) [0|0] "" HETC_M_WST
 SG_ Saf_Bits m32 : 152|16@1+ (1,0) [0|0] "" HETC_M_WST
 SG_ Saf_Estop m32 : 168|8@1+ (1,0) [0|0] "" HETC_M_WST
 SG_ Saf_FatalLatched m32 : 176|16@1+ (1,0) [0|0] "" HETC_M_WST
 SG_ Saf_ErrCode m32 : 192|32@1+ (1,0) [0|0] "" HETC_M_WST

BO_ 2163329400 STATUS_HMDH_201_to_HETC_L_ARM: 48 HMDH_201
 SG_ SubCode M : 0|8@1+ (1,0) [0|0] "" HETC_L_ARM
 SG_ Ping_CanId m5 : 8|8@1+ (1,0) [0|0] "" HETC_L_ARM
 SG_ Ping_HostId m5 : 16|8@1+ (1,0) [0|0] "" HETC_L_ARM
 SG_ Ping_Pid m5 : 24|16@1+ (1,0) [0|0] "" HETC_L_ARM
 SG_ Ping_Bid m5 : 40|16@1+ (1,0) [0|0] "" HETC_L_ARM
 SG_ Ping_Mid m5 : 56|16@1+ (1,0) [0|0] "" HETC_L_ARM
 SG_ Ping_VerMajor m5 : 72|8@1+ (1,0) [0|0] "" HETC_L_ARM
 SG_ Ping_VerMinor m5 : 80|8@1+ (1,0) [0|0] "" HETC_L_ARM
 SG_ Ping_VerPatch m5 : 88|8@1+ (1,0) [0|0] "" HETC_L_ARM
 SG_ Ping_Name0 m5 : 96|8@1+ (1,0) [0|0] "" HETC_L_ARM
 SG_ Ping_Name1 m5 : 104|8@1+ (1,0) [0|0] "" HETC_L_ARM
 SG_ Ping_Name2 m5 : 112|8@1+ (1,0) [0|0] "" HETC_L_ARM
 SG_ Ping_Name3 m5 : 120|8@1+ (1,0) [0|0] "" HETC_L_ARM
 SG_ Ping_Name4 m5 : 128|8@1+ (1,0) [0|0] "" HETC_L_ARM
 SG_ Ping_Name5 m5 : 136|8@1+ (1,0) [0|0] "" HETC_L_ARM
 SG_ Ping_Name6 m5 : 144|8@1+ (1,0) [0|0] "" HETC_L_ARM
 SG_ Ping_Name7 m5 : 152|8@1+ (1,0) [0|0] "" HETC_L_ARM
 SG_ Ping_Name8 m5 : 160|8@1+ (1,0) [0|0] "" HETC_L_ARM
 SG_ Ping_Name9 m5 : 168|8@1+ (1,0) [0|0] "" HETC_L_ARM
 SG_ Ping_Name10 m5 : 176|8@1+ (1,0) [0|0] "" HETC_L_ARM
 SG_ Ping_Name11 m5 : 184|8@1+ (1,0) [0|0] "" HETC_L_ARM
 SG_ Ping_Name12 m5 : 192|8@1+ (1,0) [0|0] "" HETC_L_ARM
 SG_ Ping_Name13 m5 : 200|8@1+ (1,0) [0|0] "" HETC_L_ARM
 SG_ Ping_Name14 m5 : 208|8@1+ (1,0) [0|0] "" HETC_L_ARM
 SG_ Ping_Name15 m5 : 216|8@1+ (1,0) [0|0] "" HETC_L_ARM
 SG_ Ping_FmtVer m5 : 224|8@1+ (1,0) [0|0] "" HETC_L_ARM
 SG_ Ping_GitRev m5 : 232|32@1+ (1,0) [0|0] "" HETC_L_ARM
 SG_ Ping_FwCrc m5 : 264|16@1+ (1,0) [0|0] "" HETC_L_ARM
 SG_ Ping_UptimeS m5 : 280|16@1+ (1,0) [0|0] "s" HETC_L_ARM
 SG_ Ecat_CanId m31 : 8|8@1+ (1,0) [0|0] "" HETC_L_ARM
 SG_ Ecat_Name0 m31 : 16|8@1+ (1,0) [0|0] "" HETC_L_ARM
 SG_ Ecat_Name1 m31 : 24|8@1+ (1,0) [0|0] "" HETC_L_ARM
 SG_ Ecat_Name2 m31 : 32|8@1+ (1,0) [0|0] "" HETC_L_ARM
 SG_ Ecat_Name3 m31 : 40|8@1+ (1,0) [0|0] "" HETC_L_ARM
 SG_ Ecat_Name4 m31 : 48|8@1+ (1,0) [0|0] "" HETC_L_ARM
 SG_ Ecat_Name5 m31 : 56|8@1+ (1,0) [0|0] "" HETC_L_ARM
 SG_ Ecat_Name6 m31 : 64|8@1+ (1,0) [0|0] "" HETC_L_ARM
 SG_ Ecat_Name7 m31 : 72|8@1+ (1,0) [0|0] "" HETC_L_ARM
 SG_ Ecat_Name8 m31 : 80|8@1+ (1,0) [0|0] "" HETC_L_ARM
 SG_ Ecat_Name9 m31 : 88|8@1+ (1,0) [0|0] "" HETC_L_ARM
 SG_ Ecat_Name10 m31 : 96|8@1+ (1,0) [0|0] "" HETC_L_ARM
 SG_ Ecat_Name11 m31 : 104|8@1+ (1,0) [0|0] "" HETC_L_ARM
 SG_ Ecat_Name12 m31 : 112|8@1+ (1,0) [0|0] "" HETC_L_ARM
 SG_ Ecat_Name13 m31 : 120|8@1+ (1,0) [0|0] "" HETC_L_ARM
 SG_ Ecat_Name14 m31 : 128|8@1+ (1,0) [0|0] "" HETC_L_ARM
 SG_ Ecat_Name15 m31 : 136|8@1+ (1,0) [0|0] "" HETC_L_ARM
 SG_ Ecat_Link m31 : 144|8@1+ (1,0) [0|0] "" HETC_L_ARM
 SG_ Ecat_InvalidFrame0 m31 : 152|8@1+ (1,0) [0|0] "" HETC_L_ARM
 SG_ Ecat_InvalidFrame1 m31 : 160|8@1+ (1,0) [0|0] "" HETC_L_ARM
 SG_ Ecat_InvalidFrame2 m31 : 168|8@1+ (1,0) [0|0] "" HETC_L_ARM
 SG_ Ecat_InvalidFrame3 m31 : 176|8@1+ (1,0) [0|0] "" HETC_L_ARM
 SG_ Ecat_RxError0 m31 : 184|8@1+ (1,0) [0|0] "" HETC_L_ARM
 SG_ Ecat_RxError1 m31 : 192|8@1+ (1,0) [0|0] "" HETC_L_ARM
 SG_ Ecat_RxError2 m31 : 200|8@1+ (1,0) [0|0] "" HETC_L_ARM
 SG_ Ecat_RxError3 m31 : 208|8@1+ (1,0) [0|0] "" HETC_L_ARM
 SG_ Ecat_FwdRxError0 m31 : 216|8@1+ (1,0) [0|0] "" HETC_L_ARM
 SG_ Ecat_FwdRxError1 m31 : 224|8@1+ (1,0) [0|0] "" HETC_L_ARM
 SG_ Ecat_FwdRxError2 m31 : 232|8@1+ (1,0) [0|0] "" HETC_L_ARM
 SG_ Ecat_FwdRxError3 m31 : 240|8@1+ (1,0) [0|0] "" HETC_L_ARM
 SG_ Ecat_PuError m31 : 248|8@1+ (1,0) [0|0] "" HETC_L_ARM
 SG_ Ecat_PdiError m31 : 256|8@1+ (1,0) [0|0] "" HETC_L_ARM
 SG_ Ecat_LostLink0 m31 : 264|8@1+ (1,0) [0|0] "" HETC_L_ARM
 SG_ Ecat_LostLink1 m31 : 272|8@1+ (1,0) [0|0] "" HETC_L_ARM
 SG_ Ecat_LostLink2 m31 : 280|8@1+ (1,0) [0|0] "" HETC_L_ARM
 SG_ Ecat_LostLink3 m31 : 288|8@1+ (1,0) [0|0] "" HETC_L_ARM
 SG_ Saf_CanId m32 : 8|8@1+ (1,0) [0|0] "" HETC_L_ARM
 SG_ Saf_Name0 m32 : 16|8@1+ (1,0) [0|0] "" HETC_L_ARM
 SG_ Saf_Name1 m32 : 24|8@1+ (1,0) [0|0] "" HETC_L_ARM
 SG_ Saf_Name2 m32 : 32|8@1+ (1,0) [0|0] "" HETC_L_ARM
 SG_ Saf_Name3 m32 : 40|8@1+ (1,0) [0|0] "" HETC_L_ARM
 SG_ Saf_Name4 m32 : 48|8@1+ (1,0) [0|0] "" HETC_L_ARM
 SG_ Saf_Name5 m32 : 56|8@1+ (1,0) [0|0] "" HETC_L_ARM
 SG_ Saf_Name6 m32 : 64|8@1+ (1,0) [0|0] "" HETC_L_ARM
 SG_ Saf_Name7 m32 : 72|8@1+ (1,0) [0|0] "" HETC_L_ARM
 SG_ Saf_Name8 m32 : 80|8@1+ (1,0) [0|0] "" HETC_L_ARM
 SG_ Saf_Name9 m32 : 88|8@1+ (1,0) [0|0] "" HETC_L_ARM
 SG_ Saf_Name10 m32 : 96|8@1+ (1,0) [0|0] "" HETC_L_ARM
 SG_ Saf_Name11 m32 : 104|8@1+ (1,0) [0|0] "" HETC_L_ARM
 SG_ Saf_Name12 m32 : 112|8@1+ (1,0) [0|0] "" HETC_L_ARM
 SG_ Saf_Name13 m32 : 120|8@1+ (1,0) [0|0] "" HETC_L_ARM
 SG_ Saf_Name14 m32 : 128|8@1+ (1,0) [0|0] "" HETC_L_ARM
 SG_ Saf_Name15 m32 : 136|8@1+ (1,0) [0|0] "" HETC_L_ARM
 SG_ Saf_State m32 : 144|8@1+ (1,0) [0|0] "" HETC_L_ARM
 SG_ Saf_Bits m32 : 152|16@1+ (1,0) [0|0] "" HETC_L_ARM
 SG_ Saf_Estop m32 : 168|8@1+ (1,0) [0|0] "" HETC_L_ARM
 SG_ Saf_FatalLatched m32 : 176|16@1+ (1,0) [0|0] "" HETC_L_ARM
 SG_ Saf_ErrCode m32 : 192|32@1+ (1,0) [0|0] "" HETC_L_ARM

BO_ 2163329410 STATUS_HMDH_201_to_HETC_L_TACT: 48 HMDH_201
 SG_ SubCode M : 0|8@1+ (1,0) [0|0] "" HETC_L_TACT
 SG_ Ping_CanId m5 : 8|8@1+ (1,0) [0|0] "" HETC_L_TACT
 SG_ Ping_HostId m5 : 16|8@1+ (1,0) [0|0] "" HETC_L_TACT
 SG_ Ping_Pid m5 : 24|16@1+ (1,0) [0|0] "" HETC_L_TACT
 SG_ Ping_Bid m5 : 40|16@1+ (1,0) [0|0] "" HETC_L_TACT
 SG_ Ping_Mid m5 : 56|16@1+ (1,0) [0|0] "" HETC_L_TACT
 SG_ Ping_VerMajor m5 : 72|8@1+ (1,0) [0|0] "" HETC_L_TACT
 SG_ Ping_VerMinor m5 : 80|8@1+ (1,0) [0|0] "" HETC_L_TACT
 SG_ Ping_VerPatch m5 : 88|8@1+ (1,0) [0|0] "" HETC_L_TACT
 SG_ Ping_Name0 m5 : 96|8@1+ (1,0) [0|0] "" HETC_L_TACT
 SG_ Ping_Name1 m5 : 104|8@1+ (1,0) [0|0] "" HETC_L_TACT
 SG_ Ping_Name2 m5 : 112|8@1+ (1,0) [0|0] "" HETC_L_TACT
 SG_ Ping_Name3 m5 : 120|8@1+ (1,0) [0|0] "" HETC_L_TACT
 SG_ Ping_Name4 m5 : 128|8@1+ (1,0) [0|0] "" HETC_L_TACT
 SG_ Ping_Name5 m5 : 136|8@1+ (1,0) [0|0] "" HETC_L_TACT
 SG_ Ping_Name6 m5 : 144|8@1+ (1,0) [0|0] "" HETC_L_TACT
 SG_ Ping_Name7 m5 : 152|8@1+ (1,0) [0|0] "" HETC_L_TACT
 SG_ Ping_Name8 m5 : 160|8@1+ (1,0) [0|0] "" HETC_L_TACT
 SG_ Ping_Name9 m5 : 168|8@1+ (1,0) [0|0] "" HETC_L_TACT
 SG_ Ping_Name10 m5 : 176|8@1+ (1,0) [0|0] "" HETC_L_TACT
 SG_ Ping_Name11 m5 : 184|8@1+ (1,0) [0|0] "" HETC_L_TACT
 SG_ Ping_Name12 m5 : 192|8@1+ (1,0) [0|0] "" HETC_L_TACT
 SG_ Ping_Name13 m5 : 200|8@1+ (1,0) [0|0] "" HETC_L_TACT
 SG_ Ping_Name14 m5 : 208|8@1+ (1,0) [0|0] "" HETC_L_TACT
 SG_ Ping_Name15 m5 : 216|8@1+ (1,0) [0|0] "" HETC_L_TACT
 SG_ Ping_FmtVer m5 : 224|8@1+ (1,0) [0|0] "" HETC_L_TACT
 SG_ Ping_GitRev m5 : 232|32@1+ (1,0) [0|0] "" HETC_L_TACT
 SG_ Ping_FwCrc m5 : 264|16@1+ (1,0) [0|0] "" HETC_L_TACT
 SG_ Ping_UptimeS m5 : 280|16@1+ (1,0) [0|0] "s" HETC_L_TACT
 SG_ Ecat_CanId m31 : 8|8@1+ (1,0) [0|0] "" HETC_L_TACT
 SG_ Ecat_Name0 m31 : 16|8@1+ (1,0) [0|0] "" HETC_L_TACT
 SG_ Ecat_Name1 m31 : 24|8@1+ (1,0) [0|0] "" HETC_L_TACT
 SG_ Ecat_Name2 m31 : 32|8@1+ (1,0) [0|0] "" HETC_L_TACT
 SG_ Ecat_Name3 m31 : 40|8@1+ (1,0) [0|0] "" HETC_L_TACT
 SG_ Ecat_Name4 m31 : 48|8@1+ (1,0) [0|0] "" HETC_L_TACT
 SG_ Ecat_Name5 m31 : 56|8@1+ (1,0) [0|0] "" HETC_L_TACT
 SG_ Ecat_Name6 m31 : 64|8@1+ (1,0) [0|0] "" HETC_L_TACT
 SG_ Ecat_Name7 m31 : 72|8@1+ (1,0) [0|0] "" HETC_L_TACT
 SG_ Ecat_Name8 m31 : 80|8@1+ (1,0) [0|0] "" HETC_L_TACT
 SG_ Ecat_Name9 m31 : 88|8@1+ (1,0) [0|0] "" HETC_L_TACT
 SG_ Ecat_Name10 m31 : 96|8@1+ (1,0) [0|0] "" HETC_L_TACT
 SG_ Ecat_Name11 m31 : 104|8@1+ (1,0) [0|0] "" HETC_L_TACT
 SG_ Ecat_Name12 m31 : 112|8@1+ (1,0) [0|0] "" HETC_L_TACT
 SG_ Ecat_Name13 m31 : 120|8@1+ (1,0) [0|0] "" HETC_L_TACT
 SG_ Ecat_Name14 m31 : 128|8@1+ (1,0) [0|0] "" HETC_L_TACT
 SG_ Ecat_Name15 m31 : 136|8@1+ (1,0) [0|0] "" HETC_L_TACT
 SG_ Ecat_Link m31 : 144|8@1+ (1,0) [0|0] "" HETC_L_TACT
 SG_ Ecat_InvalidFrame0 m31 : 152|8@1+ (1,0) [0|0] "" HETC_L_TACT
 SG_ Ecat_InvalidFrame1 m31 : 160|8@1+ (1,0) [0|0] "" HETC_L_TACT
 SG_ Ecat_InvalidFrame2 m31 : 168|8@1+ (1,0) [0|0] "" HETC_L_TACT
 SG_ Ecat_InvalidFrame3 m31 : 176|8@1+ (1,0) [0|0] "" HETC_L_TACT
 SG_ Ecat_RxError0 m31 : 184|8@1+ (1,0) [0|0] "" HETC_L_TACT
 SG_ Ecat_RxError1 m31 : 192|8@1+ (1,0) [0|0] "" HETC_L_TACT
 SG_ Ecat_RxError2 m31 : 200|8@1+ (1,0) [0|0] "" HETC_L_TACT
 SG_ Ecat_RxError3 m31 : 208|8@1+ (1,0) [0|0] "" HETC_L_TACT
 SG_ Ecat_FwdRxError0 m31 : 216|8@1+ (1,0) [0|0] "" HETC_L_TACT
 SG_ Ecat_FwdRxError1 m31 : 224|8@1+ (1,0) [0|0] "" HETC_L_TACT
 SG_ Ecat_FwdRxError2 m31 : 232|8@1+ (1,0) [0|0] "" HETC_L_TACT
 SG_ Ecat_FwdRxError3 m31 : 240|8@1+ (1,0) [0|0] "" HETC_L_TACT
 SG_ Ecat_PuError m31 : 248|8@1+ (1,0) [0|0] "" HETC_L_TACT
 SG_ Ecat_PdiError m31 : 256|8@1+ (1,0) [0|0] "" HETC_L_TACT
 SG_ Ecat_LostLink0 m31 : 264|8@1+ (1,0) [0|0] "" HETC_L_TACT
 SG_ Ecat_LostLink1 m31 : 272|8@1+ (1,0) [0|0] "" HETC_L_TACT
 SG_ Ecat_LostLink2 m31 : 280|8@1+ (1,0) [0|0] "" HETC_L_TACT
 SG_ Ecat_LostLink3 m31 : 288|8@1+ (1,0) [0|0] "" HETC_L_TACT
 SG_ Saf_CanId m32 : 8|8@1+ (1,0) [0|0] "" HETC_L_TACT
 SG_ Saf_Name0 m32 : 16|8@1+ (1,0) [0|0] "" HETC_L_TACT
 SG_ Saf_Name1 m32 : 24|8@1+ (1,0) [0|0] "" HETC_L_TACT
 SG_ Saf_Name2 m32 : 32|8@1+ (1,0) [0|0] "" HETC_L_TACT
 SG_ Saf_Name3 m32 : 40|8@1+ (1,0) [0|0] "" HETC_L_TACT
 SG_ Saf_Name4 m32 : 48|8@1+ (1,0) [0|0] "" HETC_L_TACT
 SG_ Saf_Name5 m32 : 56|8@1+ (1,0) [0|0] "" HETC_L_TACT
 SG_ Saf_Name6 m32 : 64|8@1+ (1,0) [0|0] "" HETC_L_TACT
 SG_ Saf_Name7 m32 : 72|8@1+ (1,0) [0|0] "" HETC_L_TACT
 SG_ Saf_Name8 m32 : 80|8@1+ (1,0) [0|0] "" HETC_L_TACT
 SG_ Saf_Name9 m32 : 88|8@1+ (1,0) [0|0] "" HETC_L_TACT
 SG_ Saf_Name10 m32 : 96|8@1+ (1,0) [0|0] "" HETC_L_TACT
 SG_ Saf_Name11 m32 : 104|8@1+ (1,0) [0|0] "" HETC_L_TACT
 SG_ Saf_Name12 m32 : 112|8@1+ (1,0) [0|0] "" HETC_L_TACT
 SG_ Saf_Name13 m32 : 120|8@1+ (1,0) [0|0] "" HETC_L_TACT
 SG_ Saf_Name14 m32 : 128|8@1+ (1,0) [0|0] "" HETC_L_TACT
 SG_ Saf_Name15 m32 : 136|8@1+ (1,0) [0|0] "" HETC_L_TACT
 SG_ Saf_State m32 : 144|8@1+ (1,0) [0|0] "" HETC_L_TACT
 SG_ Saf_Bits m32 : 152|16@1+ (1,0) [0|0] "" HETC_L_TACT
 SG_ Saf_Estop m32 : 168|8@1+ (1,0) [0|0] "" HETC_L_TACT
 SG_ Saf_FatalLatched m32 : 176|16@1+ (1,0) [0|0] "" HETC_L_TACT
 SG_ Saf_ErrCode m32 : 192|32@1+ (1,0) [0|0] "" HETC_L_TACT

BO_ 2163329420 STATUS_HMDH_201_to_HETC_R_ARM: 48 HMDH_201
 SG_ SubCode M : 0|8@1+ (1,0) [0|0] "" HETC_R_ARM
 SG_ Ping_CanId m5 : 8|8@1+ (1,0) [0|0] "" HETC_R_ARM
 SG_ Ping_HostId m5 : 16|8@1+ (1,0) [0|0] "" HETC_R_ARM
 SG_ Ping_Pid m5 : 24|16@1+ (1,0) [0|0] "" HETC_R_ARM
 SG_ Ping_Bid m5 : 40|16@1+ (1,0) [0|0] "" HETC_R_ARM
 SG_ Ping_Mid m5 : 56|16@1+ (1,0) [0|0] "" HETC_R_ARM
 SG_ Ping_VerMajor m5 : 72|8@1+ (1,0) [0|0] "" HETC_R_ARM
 SG_ Ping_VerMinor m5 : 80|8@1+ (1,0) [0|0] "" HETC_R_ARM
 SG_ Ping_VerPatch m5 : 88|8@1+ (1,0) [0|0] "" HETC_R_ARM
 SG_ Ping_Name0 m5 : 96|8@1+ (1,0) [0|0] "" HETC_R_ARM
 SG_ Ping_Name1 m5 : 104|8@1+ (1,0) [0|0] "" HETC_R_ARM
 SG_ Ping_Name2 m5 : 112|8@1+ (1,0) [0|0] "" HETC_R_ARM
 SG_ Ping_Name3 m5 : 120|8@1+ (1,0) [0|0] "" HETC_R_ARM
 SG_ Ping_Name4 m5 : 128|8@1+ (1,0) [0|0] "" HETC_R_ARM
 SG_ Ping_Name5 m5 : 136|8@1+ (1,0) [0|0] "" HETC_R_ARM
 SG_ Ping_Name6 m5 : 144|8@1+ (1,0) [0|0] "" HETC_R_ARM
 SG_ Ping_Name7 m5 : 152|8@1+ (1,0) [0|0] "" HETC_R_ARM
 SG_ Ping_Name8 m5 : 160|8@1+ (1,0) [0|0] "" HETC_R_ARM
 SG_ Ping_Name9 m5 : 168|8@1+ (1,0) [0|0] "" HETC_R_ARM
 SG_ Ping_Name10 m5 : 176|8@1+ (1,0) [0|0] "" HETC_R_ARM
 SG_ Ping_Name11 m5 : 184|8@1+ (1,0) [0|0] "" HETC_R_ARM
 SG_ Ping_Name12 m5 : 192|8@1+ (1,0) [0|0] "" HETC_R_ARM
 SG_ Ping_Name13 m5 : 200|8@1+ (1,0) [0|0] "" HETC_R_ARM
 SG_ Ping_Name14 m5 : 208|8@1+ (1,0) [0|0] "" HETC_R_ARM
 SG_ Ping_Name15 m5 : 216|8@1+ (1,0) [0|0] "" HETC_R_ARM
 SG_ Ping_FmtVer m5 : 224|8@1+ (1,0) [0|0] "" HETC_R_ARM
 SG_ Ping_GitRev m5 : 232|32@1+ (1,0) [0|0] "" HETC_R_ARM
 SG_ Ping_FwCrc m5 : 264|16@1+ (1,0) [0|0] "" HETC_R_ARM
 SG_ Ping_UptimeS m5 : 280|16@1+ (1,0) [0|0] "s" HETC_R_ARM
 SG_ Ecat_CanId m31 : 8|8@1+ (1,0) [0|0] "" HETC_R_ARM
 SG_ Ecat_Name0 m31 : 16|8@1+ (1,0) [0|0] "" HETC_R_ARM
 SG_ Ecat_Name1 m31 : 24|8@1+ (1,0) [0|0] "" HETC_R_ARM
 SG_ Ecat_Name2 m31 : 32|8@1+ (1,0) [0|0] "" HETC_R_ARM
 SG_ Ecat_Name3 m31 : 40|8@1+ (1,0) [0|0] "" HETC_R_ARM
 SG_ Ecat_Name4 m31 : 48|8@1+ (1,0) [0|0] "" HETC_R_ARM
 SG_ Ecat_Name5 m31 : 56|8@1+ (1,0) [0|0] "" HETC_R_ARM
 SG_ Ecat_Name6 m31 : 64|8@1+ (1,0) [0|0] "" HETC_R_ARM
 SG_ Ecat_Name7 m31 : 72|8@1+ (1,0) [0|0] "" HETC_R_ARM
 SG_ Ecat_Name8 m31 : 80|8@1+ (1,0) [0|0] "" HETC_R_ARM
 SG_ Ecat_Name9 m31 : 88|8@1+ (1,0) [0|0] "" HETC_R_ARM
 SG_ Ecat_Name10 m31 : 96|8@1+ (1,0) [0|0] "" HETC_R_ARM
 SG_ Ecat_Name11 m31 : 104|8@1+ (1,0) [0|0] "" HETC_R_ARM
 SG_ Ecat_Name12 m31 : 112|8@1+ (1,0) [0|0] "" HETC_R_ARM
 SG_ Ecat_Name13 m31 : 120|8@1+ (1,0) [0|0] "" HETC_R_ARM
 SG_ Ecat_Name14 m31 : 128|8@1+ (1,0) [0|0] "" HETC_R_ARM
 SG_ Ecat_Name15 m31 : 136|8@1+ (1,0) [0|0] "" HETC_R_ARM
 SG_ Ecat_Link m31 : 144|8@1+ (1,0) [0|0] "" HETC_R_ARM
 SG_ Ecat_InvalidFrame0 m31 : 152|8@1+ (1,0) [0|0] "" HETC_R_ARM
 SG_ Ecat_InvalidFrame1 m31 : 160|8@1+ (1,0) [0|0] "" HETC_R_ARM
 SG_ Ecat_InvalidFrame2 m31 : 168|8@1+ (1,0) [0|0] "" HETC_R_ARM
 SG_ Ecat_InvalidFrame3 m31 : 176|8@1+ (1,0) [0|0] "" HETC_R_ARM
 SG_ Ecat_RxError0 m31 : 184|8@1+ (1,0) [0|0] "" HETC_R_ARM
 SG_ Ecat_RxError1 m31 : 192|8@1+ (1,0) [0|0] "" HETC_R_ARM
 SG_ Ecat_RxError2 m31 : 200|8@1+ (1,0) [0|0] "" HETC_R_ARM
 SG_ Ecat_RxError3 m31 : 208|8@1+ (1,0) [0|0] "" HETC_R_ARM
 SG_ Ecat_FwdRxError0 m31 : 216|8@1+ (1,0) [0|0] "" HETC_R_ARM
 SG_ Ecat_FwdRxError1 m31 : 224|8@1+ (1,0) [0|0] "" HETC_R_ARM
 SG_ Ecat_FwdRxError2 m31 : 232|8@1+ (1,0) [0|0] "" HETC_R_ARM
 SG_ Ecat_FwdRxError3 m31 : 240|8@1+ (1,0) [0|0] "" HETC_R_ARM
 SG_ Ecat_PuError m31 : 248|8@1+ (1,0) [0|0] "" HETC_R_ARM
 SG_ Ecat_PdiError m31 : 256|8@1+ (1,0) [0|0] "" HETC_R_ARM
 SG_ Ecat_LostLink0 m31 : 264|8@1+ (1,0) [0|0] "" HETC_R_ARM
 SG_ Ecat_LostLink1 m31 : 272|8@1+ (1,0) [0|0] "" HETC_R_ARM
 SG_ Ecat_LostLink2 m31 : 280|8@1+ (1,0) [0|0] "" HETC_R_ARM
 SG_ Ecat_LostLink3 m31 : 288|8@1+ (1,0) [0|0] "" HETC_R_ARM
 SG_ Saf_CanId m32 : 8|8@1+ (1,0) [0|0] "" HETC_R_ARM
 SG_ Saf_Name0 m32 : 16|8@1+ (1,0) [0|0] "" HETC_R_ARM
 SG_ Saf_Name1 m32 : 24|8@1+ (1,0) [0|0] "" HETC_R_ARM
 SG_ Saf_Name2 m32 : 32|8@1+ (1,0) [0|0] "" HETC_R_ARM
 SG_ Saf_Name3 m32 : 40|8@1+ (1,0) [0|0] "" HETC_R_ARM
 SG_ Saf_Name4 m32 : 48|8@1+ (1,0) [0|0] "" HETC_R_ARM
 SG_ Saf_Name5 m32 : 56|8@1+ (1,0) [0|0] "" HETC_R_ARM
 SG_ Saf_Name6 m32 : 64|8@1+ (1,0) [0|0] "" HETC_R_ARM
 SG_ Saf_Name7 m32 : 72|8@1+ (1,0) [0|0] "" HETC_R_ARM
 SG_ Saf_Name8 m32 : 80|8@1+ (1,0) [0|0] "" HETC_R_ARM
 SG_ Saf_Name9 m32 : 88|8@1+ (1,0) [0|0] "" HETC_R_ARM
 SG_ Saf_Name10 m32 : 96|8@1+ (1,0) [0|0] "" HETC_R_ARM
 SG_ Saf_Name11 m32 : 104|8@1+ (1,0) [0|0] "" HETC_R_ARM
 SG_ Saf_Name12 m32 : 112|8@1+ (1,0) [0|0] "" HETC_R_ARM
 SG_ Saf_Name13 m32 : 120|8@1+ (1,0) [0|0] "" HETC_R_ARM
 SG_ Saf_Name14 m32 : 128|8@1+ (1,0) [0|0] "" HETC_R_ARM
 SG_ Saf_Name15 m32 : 136|8@1+ (1,0) [0|0] "" HETC_R_ARM
 SG_ Saf_State m32 : 144|8@1+ (1,0) [0|0] "" HETC_R_ARM
 SG_ Saf_Bits m32 : 152|16@1+ (1,0) [0|0] "" HETC_R_ARM
 SG_ Saf_Estop m32 : 168|8@1+ (1,0) [0|0] "" HETC_R_ARM
 SG_ Saf_FatalLatched m32 : 176|16@1+ (1,0) [0|0] "" HETC_R_ARM
 SG_ Saf_ErrCode m32 : 192|32@1+ (1,0) [0|0] "" HETC_R_ARM

BO_ 2163329430 STATUS_HMDH_201_to_HETC_R_TACT: 48 HMDH_201
 SG_ SubCode M : 0|8@1+ (1,0) [0|0] "" HETC_R_TACT
 SG_ Ping_CanId m5 : 8|8@1+ (1,0) [0|0] "" HETC_R_TACT
 SG_ Ping_HostId m5 : 16|8@1+ (1,0) [0|0] "" HETC_R_TACT
 SG_ Ping_Pid m5 : 24|16@1+ (1,0) [0|0] "" HETC_R_TACT
 SG_ Ping_Bid m5 : 40|16@1+ (1,0) [0|0] "" HETC_R_TACT
 SG_ Ping_Mid m5 : 56|16@1+ (1,0) [0|0] "" HETC_R_TACT
 SG_ Ping_VerMajor m5 : 72|8@1+ (1,0) [0|0] "" HETC_R_TACT
 SG_ Ping_VerMinor m5 : 80|8@1+ (1,0) [0|0] "" HETC_R_TACT
 SG_ Ping_VerPatch m5 : 88|8@1+ (1,0) [0|0] "" HETC_R_TACT
 SG_ Ping_Name0 m5 : 96|8@1+ (1,0) [0|0] "" HETC_R_TACT
 SG_ Ping_Name1 m5 : 104|8@1+ (1,0) [0|0] "" HETC_R_TACT
 SG_ Ping_Name2 m5 : 112|8@1+ (1,0) [0|0] "" HETC_R_TACT
 SG_ Ping_Name3 m5 : 120|8@1+ (1,0) [0|0] "" HETC_R_TACT
 SG_ Ping_Name4 m5 : 128|8@1+ (1,0) [0|0] "" HETC_R_TACT
 SG_ Ping_Name5 m5 : 136|8@1+ (1,0) [0|0] "" HETC_R_TACT
 SG_ Ping_Name6 m5 : 144|8@1+ (1,0) [0|0] "" HETC_R_TACT
 SG_ Ping_Name7 m5 : 152|8@1+ (1,0) [0|0] "" HETC_R_TACT
 SG_ Ping_Name8 m5 : 160|8@1+ (1,0) [0|0] "" HETC_R_TACT
 SG_ Ping_Name9 m5 : 168|8@1+ (1,0) [0|0] "" HETC_R_TACT
 SG_ Ping_Name10 m5 : 176|8@1+ (1,0) [0|0] "" HETC_R_TACT
 SG_ Ping_Name11 m5 : 184|8@1+ (1,0) [0|0] "" HETC_R_TACT
 SG_ Ping_Name12 m5 : 192|8@1+ (1,0) [0|0] "" HETC_R_TACT
 SG_ Ping_Name13 m5 : 200|8@1+ (1,0) [0|0] "" HETC_R_TACT
 SG_ Ping_Name14 m5 : 208|8@1+ (1,0) [0|0] "" HETC_R_TACT
 SG_ Ping_Name15 m5 : 216|8@1+ (1,0) [0|0] "" HETC_R_TACT
 SG_ Ping_FmtVer m5 : 224|8@1+ (1,0) [0|0] "" HETC_R_TACT
 SG_ Ping_GitRev m5 : 232|32@1+ (1,0) [0|0] "" HETC_R_TACT
 SG_ Ping_FwCrc m5 : 264|16@1+ (1,0) [0|0] "" HETC_R_TACT
 SG_ Ping_UptimeS m5 : 280|16@1+ (1,0) [0|0] "s" HETC_R_TACT
 SG_ Ecat_CanId m31 : 8|8@1+ (1,0) [0|0] "" HETC_R_TACT
 SG_ Ecat_Name0 m31 : 16|8@1+ (1,0) [0|0] "" HETC_R_TACT
 SG_ Ecat_Name1 m31 : 24|8@1+ (1,0) [0|0] "" HETC_R_TACT
 SG_ Ecat_Name2 m31 : 32|8@1+ (1,0) [0|0] "" HETC_R_TACT
 SG_ Ecat_Name3 m31 : 40|8@1+ (1,0) [0|0] "" HETC_R_TACT
 SG_ Ecat_Name4 m31 : 48|8@1+ (1,0) [0|0] "" HETC_R_TACT
 SG_ Ecat_Name5 m31 : 56|8@1+ (1,0) [0|0] "" HETC_R_TACT
 SG_ Ecat_Name6 m31 : 64|8@1+ (1,0) [0|0] "" HETC_R_TACT
 SG_ Ecat_Name7 m31 : 72|8@1+ (1,0) [0|0] "" HETC_R_TACT
 SG_ Ecat_Name8 m31 : 80|8@1+ (1,0) [0|0] "" HETC_R_TACT
 SG_ Ecat_Name9 m31 : 88|8@1+ (1,0) [0|0] "" HETC_R_TACT
 SG_ Ecat_Name10 m31 : 96|8@1+ (1,0) [0|0] "" HETC_R_TACT
 SG_ Ecat_Name11 m31 : 104|8@1+ (1,0) [0|0] "" HETC_R_TACT
 SG_ Ecat_Name12 m31 : 112|8@1+ (1,0) [0|0] "" HETC_R_TACT
 SG_ Ecat_Name13 m31 : 120|8@1+ (1,0) [0|0] "" HETC_R_TACT
 SG_ Ecat_Name14 m31 : 128|8@1+ (1,0) [0|0] "" HETC_R_TACT
 SG_ Ecat_Name15 m31 : 136|8@1+ (1,0) [0|0] "" HETC_R_TACT
 SG_ Ecat_Link m31 : 144|8@1+ (1,0) [0|0] "" HETC_R_TACT
 SG_ Ecat_InvalidFrame0 m31 : 152|8@1+ (1,0) [0|0] "" HETC_R_TACT
 SG_ Ecat_InvalidFrame1 m31 : 160|8@1+ (1,0) [0|0] "" HETC_R_TACT
 SG_ Ecat_InvalidFrame2 m31 : 168|8@1+ (1,0) [0|0] "" HETC_R_TACT
 SG_ Ecat_InvalidFrame3 m31 : 176|8@1+ (1,0) [0|0] "" HETC_R_TACT
 SG_ Ecat_RxError0 m31 : 184|8@1+ (1,0) [0|0] "" HETC_R_TACT
 SG_ Ecat_RxError1 m31 : 192|8@1+ (1,0) [0|0] "" HETC_R_TACT
 SG_ Ecat_RxError2 m31 : 200|8@1+ (1,0) [0|0] "" HETC_R_TACT
 SG_ Ecat_RxError3 m31 : 208|8@1+ (1,0) [0|0] "" HETC_R_TACT
 SG_ Ecat_FwdRxError0 m31 : 216|8@1+ (1,0) [0|0] "" HETC_R_TACT
 SG_ Ecat_FwdRxError1 m31 : 224|8@1+ (1,0) [0|0] "" HETC_R_TACT
 SG_ Ecat_FwdRxError2 m31 : 232|8@1+ (1,0) [0|0] "" HETC_R_TACT
 SG_ Ecat_FwdRxError3 m31 : 240|8@1+ (1,0) [0|0] "" HETC_R_TACT
 SG_ Ecat_PuError m31 : 248|8@1+ (1,0) [0|0] "" HETC_R_TACT
 SG_ Ecat_PdiError m31 : 256|8@1+ (1,0) [0|0] "" HETC_R_TACT
 SG_ Ecat_LostLink0 m31 : 264|8@1+ (1,0) [0|0] "" HETC_R_TACT
 SG_ Ecat_LostLink1 m31 : 272|8@1+ (1,0) [0|0] "" HETC_R_TACT
 SG_ Ecat_LostLink2 m31 : 280|8@1+ (1,0) [0|0] "" HETC_R_TACT
 SG_ Ecat_LostLink3 m31 : 288|8@1+ (1,0) [0|0] "" HETC_R_TACT
 SG_ Saf_CanId m32 : 8|8@1+ (1,0) [0|0] "" HETC_R_TACT
 SG_ Saf_Name0 m32 : 16|8@1+ (1,0) [0|0] "" HETC_R_TACT
 SG_ Saf_Name1 m32 : 24|8@1+ (1,0) [0|0] "" HETC_R_TACT
 SG_ Saf_Name2 m32 : 32|8@1+ (1,0) [0|0] "" HETC_R_TACT
 SG_ Saf_Name3 m32 : 40|8@1+ (1,0) [0|0] "" HETC_R_TACT
 SG_ Saf_Name4 m32 : 48|8@1+ (1,0) [0|0] "" HETC_R_TACT
 SG_ Saf_Name5 m32 : 56|8@1+ (1,0) [0|0] "" HETC_R_TACT
 SG_ Saf_Name6 m32 : 64|8@1+ (1,0) [0|0] "" HETC_R_TACT
 SG_ Saf_Name7 m32 : 72|8@1+ (1,0) [0|0] "" HETC_R_TACT
 SG_ Saf_Name8 m32 : 80|8@1+ (1,0) [0|0] "" HETC_R_TACT
 SG_ Saf_Name9 m32 : 88|8@1+ (1,0) [0|0] "" HETC_R_TACT
 SG_ Saf_Name10 m32 : 96|8@1+ (1,0) [0|0] "" HETC_R_TACT
 SG_ Saf_Name11 m32 : 104|8@1+ (1,0) [0|0] "" HETC_R_TACT
 SG_ Saf_Name12 m32 : 112|8@1+ (1,0) [0|0] "" HETC_R_TACT
 SG_ Saf_Name13 m32 : 120|8@1+ (1,0) [0|0] "" HETC_R_TACT
 SG_ Saf_Name14 m32 : 128|8@1+ (1,0) [0|0] "" HETC_R_TACT
 SG_ Saf_Name15 m32 : 136|8@1+ (1,0) [0|0] "" HETC_R_TACT
 SG_ Saf_State m32 : 144|8@1+ (1,0) [0|0] "" HETC_R_TACT
 SG_ Saf_Bits m32 : 152|16@1+ (1,0) [0|0] "" HETC_R_TACT
 SG_ Saf_Estop m32 : 168|8@1+ (1,0) [0|0] "" HETC_R_TACT
 SG_ Saf_FatalLatched m32 : 176|16@1+ (1,0) [0|0] "" HETC_R_TACT
 SG_ Saf_ErrCode m32 : 192|32@1+ (1,0) [0|0] "" HETC_R_TACT

BO_ 2163329482 STATUS_HMDH_201_to_HMDH_202: 48 HMDH_201
 SG_ SubCode M : 0|8@1+ (1,0) [0|0] "" HMDH_202
 SG_ Ping_CanId m5 : 8|8@1+ (1,0) [0|0] "" HMDH_202
 SG_ Ping_HostId m5 : 16|8@1+ (1,0) [0|0] "" HMDH_202
 SG_ Ping_Pid m5 : 24|16@1+ (1,0) [0|0] "" HMDH_202
 SG_ Ping_Bid m5 : 40|16@1+ (1,0) [0|0] "" HMDH_202
 SG_ Ping_Mid m5 : 56|16@1+ (1,0) [0|0] "" HMDH_202
 SG_ Ping_VerMajor m5 : 72|8@1+ (1,0) [0|0] "" HMDH_202
 SG_ Ping_VerMinor m5 : 80|8@1+ (1,0) [0|0] "" HMDH_202
 SG_ Ping_VerPatch m5 : 88|8@1+ (1,0) [0|0] "" HMDH_202
 SG_ Ping_Name0 m5 : 96|8@1+ (1,0) [0|0] "" HMDH_202
 SG_ Ping_Name1 m5 : 104|8@1+ (1,0) [0|0] "" HMDH_202
 SG_ Ping_Name2 m5 : 112|8@1+ (1,0) [0|0] "" HMDH_202
 SG_ Ping_Name3 m5 : 120|8@1+ (1,0) [0|0] "" HMDH_202
 SG_ Ping_Name4 m5 : 128|8@1+ (1,0) [0|0] "" HMDH_202
 SG_ Ping_Name5 m5 : 136|8@1+ (1,0) [0|0] "" HMDH_202
 SG_ Ping_Name6 m5 : 144|8@1+ (1,0) [0|0] "" HMDH_202
 SG_ Ping_Name7 m5 : 152|8@1+ (1,0) [0|0] "" HMDH_202
 SG_ Ping_Name8 m5 : 160|8@1+ (1,0) [0|0] "" HMDH_202
 SG_ Ping_Name9 m5 : 168|8@1+ (1,0) [0|0] "" HMDH_202
 SG_ Ping_Name10 m5 : 176|8@1+ (1,0) [0|0] "" HMDH_202
 SG_ Ping_Name11 m5 : 184|8@1+ (1,0) [0|0] "" HMDH_202
 SG_ Ping_Name12 m5 : 192|8@1+ (1,0) [0|0] "" HMDH_202
 SG_ Ping_Name13 m5 : 200|8@1+ (1,0) [0|0] "" HMDH_202
 SG_ Ping_Name14 m5 : 208|8@1+ (1,0) [0|0] "" HMDH_202
 SG_ Ping_Name15 m5 : 216|8@1+ (1,0) [0|0] "" HMDH_202
 SG_ Ping_FmtVer m5 : 224|8@1+ (1,0) [0|0] "" HMDH_202
 SG_ Ping_GitRev m5 : 232|32@1+ (1,0) [0|0] "" HMDH_202
 SG_ Ping_FwCrc m5 : 264|16@1+ (1,0) [0|0] "" HMDH_202
 SG_ Ping_UptimeS m5 : 280|16@1+ (1,0) [0|0] "s" HMDH_202
 SG_ Ecat_CanId m31 : 8|8@1+ (1,0) [0|0] "" HMDH_202
 SG_ Ecat_Name0 m31 : 16|8@1+ (1,0) [0|0] "" HMDH_202
 SG_ Ecat_Name1 m31 : 24|8@1+ (1,0) [0|0] "" HMDH_202
 SG_ Ecat_Name2 m31 : 32|8@1+ (1,0) [0|0] "" HMDH_202
 SG_ Ecat_Name3 m31 : 40|8@1+ (1,0) [0|0] "" HMDH_202
 SG_ Ecat_Name4 m31 : 48|8@1+ (1,0) [0|0] "" HMDH_202
 SG_ Ecat_Name5 m31 : 56|8@1+ (1,0) [0|0] "" HMDH_202
 SG_ Ecat_Name6 m31 : 64|8@1+ (1,0) [0|0] "" HMDH_202
 SG_ Ecat_Name7 m31 : 72|8@1+ (1,0) [0|0] "" HMDH_202
 SG_ Ecat_Name8 m31 : 80|8@1+ (1,0) [0|0] "" HMDH_202
 SG_ Ecat_Name9 m31 : 88|8@1+ (1,0) [0|0] "" HMDH_202
 SG_ Ecat_Name10 m31 : 96|8@1+ (1,0) [0|0] "" HMDH_202
 SG_ Ecat_Name11 m31 : 104|8@1+ (1,0) [0|0] "" HMDH_202
 SG_ Ecat_Name12 m31 : 112|8@1+ (1,0) [0|0] "" HMDH_202
 SG_ Ecat_Name13 m31 : 120|8@1+ (1,0) [0|0] "" HMDH_202
 SG_ Ecat_Name14 m31 : 128|8@1+ (1,0) [0|0] "" HMDH_202
 SG_ Ecat_Name15 m31 : 136|8@1+ (1,0) [0|0] "" HMDH_202
 SG_ Ecat_Link m31 : 144|8@1+ (1,0) [0|0] "" HMDH_202
 SG_ Ecat_InvalidFrame0 m31 : 152|8@1+ (1,0) [0|0] "" HMDH_202
 SG_ Ecat_InvalidFrame1 m31 : 160|8@1+ (1,0) [0|0] "" HMDH_202
 SG_ Ecat_InvalidFrame2 m31 : 168|8@1+ (1,0) [0|0] "" HMDH_202
 SG_ Ecat_InvalidFrame3 m31 : 176|8@1+ (1,0) [0|0] "" HMDH_202
 SG_ Ecat_RxError0 m31 : 184|8@1+ (1,0) [0|0] "" HMDH_202
 SG_ Ecat_RxError1 m31 : 192|8@1+ (1,0) [0|0] "" HMDH_202
 SG_ Ecat_RxError2 m31 : 200|8@1+ (1,0) [0|0] "" HMDH_202
 SG_ Ecat_RxError3 m31 : 208|8@1+ (1,0) [0|0] "" HMDH_202
 SG_ Ecat_FwdRxError0 m31 : 216|8@1+ (1,0) [0|0] "" HMDH_202
 SG_ Ecat_FwdRxError1 m31 : 224|8@1+ (1,0) [0|0] "" HMDH_202
 SG_ Ecat_FwdRxError2 m31 : 232|8@1+ (1,0) [0|0] "" HMDH_202
 SG_ Ecat_FwdRxError3 m31 : 240|8@1+ (1,0) [0|0] "" HMDH_202
 SG_ Ecat_PuError m31 : 248|8@1+ (1,0) [0|0] "" HMDH_202
 SG_ Ecat_PdiError m31 : 256|8@1+ (1,0) [0|0] "" HMDH_202
 SG_ Ecat_LostLink0 m31 : 264|8@1+ (1,0) [0|0] "" HMDH_202
 SG_ Ecat_LostLink1 m31 : 272|8@1+ (1,0) [0|0] "" HMDH_202
 SG_ Ecat_LostLink2 m31 : 280|8@1+ (1,0) [0|0] "" HMDH_202
 SG_ Ecat_LostLink3 m31 : 288|8@1+ (1,0) [0|0] "" HMDH_202
 SG_ Saf_CanId m32 : 8|8@1+ (1,0) [0|0] "" HMDH_202
 SG_ Saf_Name0 m32 : 16|8@1+ (1,0) [0|0] "" HMDH_202
 SG_ Saf_Name1 m32 : 24|8@1+ (1,0) [0|0] "" HMDH_202
 SG_ Saf_Name2 m32 : 32|8@1+ (1,0) [0|0] "" HMDH_202
 SG_ Saf_Name3 m32 : 40|8@1+ (1,0) [0|0] "" HMDH_202
 SG_ Saf_Name4 m32 : 48|8@1+ (1,0) [0|0] "" HMDH_202
 SG_ Saf_Name5 m32 : 56|8@1+ (1,0) [0|0] "" HMDH_202
 SG_ Saf_Name6 m32 : 64|8@1+ (1,0) [0|0] "" HMDH_202
 SG_ Saf_Name7 m32 : 72|8@1+ (1,0) [0|0] "" HMDH_202
 SG_ Saf_Name8 m32 : 80|8@1+ (1,0) [0|0] "" HMDH_202
 SG_ Saf_Name9 m32 : 88|8@1+ (1,0) [0|0] "" HMDH_202
 SG_ Saf_Name10 m32 : 96|8@1+ (1,0) [0|0] "" HMDH_202
 SG_ Saf_Name11 m32 : 104|8@1+ (1,0) [0|0] "" HMDH_202
 SG_ Saf_Name12 m32 : 112|8@1+ (1,0) [0|0] "" HMDH_202
 SG_ Saf_Name13 m32 : 120|8@1+ (1,0) [0|0] "" HMDH_202
 SG_ Saf_Name14 m32 : 128|8@1+ (1,0) [0|0] "" HMDH_202
 SG_ Saf_Name15 m32 : 136|8@1+ (1,0) [0|0] "" HMDH_202
 SG_ Saf_State m32 : 144|8@1+ (1,0) [0|0] "" HMDH_202
 SG_ Saf_Bits m32 : 152|16@1+ (1,0) [0|0] "" HMDH_202
 SG_ Saf_Estop m32 : 168|8@1+ (1,0) [0|0] "" HMDH_202
 SG_ Saf_FatalLatched m32 : 176|16@1+ (1,0) [0|0] "" HMDH_202
 SG_ Saf_ErrCode m32 : 192|32@1+ (1,0) [0|0] "" HMDH_202

BO_ 2163329483 STATUS_HMDH_201_to_HMDH_203: 48 HMDH_201
 SG_ SubCode M : 0|8@1+ (1,0) [0|0] "" HMDH_203
 SG_ Ping_CanId m5 : 8|8@1+ (1,0) [0|0] "" HMDH_203
 SG_ Ping_HostId m5 : 16|8@1+ (1,0) [0|0] "" HMDH_203
 SG_ Ping_Pid m5 : 24|16@1+ (1,0) [0|0] "" HMDH_203
 SG_ Ping_Bid m5 : 40|16@1+ (1,0) [0|0] "" HMDH_203
 SG_ Ping_Mid m5 : 56|16@1+ (1,0) [0|0] "" HMDH_203
 SG_ Ping_VerMajor m5 : 72|8@1+ (1,0) [0|0] "" HMDH_203
 SG_ Ping_VerMinor m5 : 80|8@1+ (1,0) [0|0] "" HMDH_203
 SG_ Ping_VerPatch m5 : 88|8@1+ (1,0) [0|0] "" HMDH_203
 SG_ Ping_Name0 m5 : 96|8@1+ (1,0) [0|0] "" HMDH_203
 SG_ Ping_Name1 m5 : 104|8@1+ (1,0) [0|0] "" HMDH_203
 SG_ Ping_Name2 m5 : 112|8@1+ (1,0) [0|0] "" HMDH_203
 SG_ Ping_Name3 m5 : 120|8@1+ (1,0) [0|0] "" HMDH_203
 SG_ Ping_Name4 m5 : 128|8@1+ (1,0) [0|0] "" HMDH_203
 SG_ Ping_Name5 m5 : 136|8@1+ (1,0) [0|0] "" HMDH_203
 SG_ Ping_Name6 m5 : 144|8@1+ (1,0) [0|0] "" HMDH_203
 SG_ Ping_Name7 m5 : 152|8@1+ (1,0) [0|0] "" HMDH_203
 SG_ Ping_Name8 m5 : 160|8@1+ (1,0) [0|0] "" HMDH_203
 SG_ Ping_Name9 m5 : 168|8@1+ (1,0) [0|0] "" HMDH_203
 SG_ Ping_Name10 m5 : 176|8@1+ (1,0) [0|0] "" HMDH_203
 SG_ Ping_Name11 m5 : 184|8@1+ (1,0) [0|0] "" HMDH_203
 SG_ Ping_Name12 m5 : 192|8@1+ (1,0) [0|0] "" HMDH_203
 SG_ Ping_Name13 m5 : 200|8@1+ (1,0) [0|0] "" HMDH_203
 SG_ Ping_Name14 m5 : 208|8@1+ (1,0) [0|0] "" HMDH_203
 SG_ Ping_Name15 m5 : 216|8@1+ (1,0) [0|0] "" HMDH_203
 SG_ Ping_FmtVer m5 : 224|8@1+ (1,0) [0|0] "" HMDH_203
 SG_ Ping_GitRev m5 : 232|32@1+ (1,0) [0|0] "" HMDH_203
 SG_ Ping_FwCrc m5 : 264|16@1+ (1,0) [0|0] "" HMDH_203
 SG_ Ping_UptimeS m5 : 280|16@1+ (1,0) [0|0] "s" HMDH_203
 SG_ Ecat_CanId m31 : 8|8@1+ (1,0) [0|0] "" HMDH_203
 SG_ Ecat_Name0 m31 : 16|8@1+ (1,0) [0|0] "" HMDH_203
 SG_ Ecat_Name1 m31 : 24|8@1+ (1,0) [0|0] "" HMDH_203
 SG_ Ecat_Name2 m31 : 32|8@1+ (1,0) [0|0] "" HMDH_203
 SG_ Ecat_Name3 m31 : 40|8@1+ (1,0) [0|0] "" HMDH_203
 SG_ Ecat_Name4 m31 : 48|8@1+ (1,0) [0|0] "" HMDH_203
 SG_ Ecat_Name5 m31 : 56|8@1+ (1,0) [0|0] "" HMDH_203
 SG_ Ecat_Name6 m31 : 64|8@1+ (1,0) [0|0] "" HMDH_203
 SG_ Ecat_Name7 m31 : 72|8@1+ (1,0) [0|0] "" HMDH_203
 SG_ Ecat_Name8 m31 : 80|8@1+ (1,0) [0|0] "" HMDH_203
 SG_ Ecat_Name9 m31 : 88|8@1+ (1,0) [0|0] "" HMDH_203
 SG_ Ecat_Name10 m31 : 96|8@1+ (1,0) [0|0] "" HMDH_203
 SG_ Ecat_Name11 m31 : 104|8@1+ (1,0) [0|0] "" HMDH_203
 SG_ Ecat_Name12 m31 : 112|8@1+ (1,0) [0|0] "" HMDH_203
 SG_ Ecat_Name13 m31 : 120|8@1+ (1,0) [0|0] "" HMDH_203
 SG_ Ecat_Name14 m31 : 128|8@1+ (1,0) [0|0] "" HMDH_203
 SG_ Ecat_Name15 m31 : 136|8@1+ (1,0) [0|0] "" HMDH_203
 SG_ Ecat_Link m31 : 144|8@1+ (1,0) [0|0] "" HMDH_203
 SG_ Ecat_InvalidFrame0 m31 : 152|8@1+ (1,0) [0|0] "" HMDH_203
 SG_ Ecat_InvalidFrame1 m31 : 160|8@1+ (1,0) [0|0] "" HMDH_203
 SG_ Ecat_InvalidFrame2 m31 : 168|8@1+ (1,0) [0|0] "" HMDH_203
 SG_ Ecat_InvalidFrame3 m31 : 176|8@1+ (1,0) [0|0] "" HMDH_203
 SG_ Ecat_RxError0 m31 : 184|8@1+ (1,0) [0|0] "" HMDH_203
 SG_ Ecat_RxError1 m31 : 192|8@1+ (1,0) [0|0] "" HMDH_203
 SG_ Ecat_RxError2 m31 : 200|8@1+ (1,0) [0|0] "" HMDH_203
 SG_ Ecat_RxError3 m31 : 208|8@1+ (1,0) [0|0] "" HMDH_203
 SG_ Ecat_FwdRxError0 m31 : 216|8@1+ (1,0) [0|0] "" HMDH_203
 SG_ Ecat_FwdRxError1 m31 : 224|8@1+ (1,0) [0|0] "" HMDH_203
 SG_ Ecat_FwdRxError2 m31 : 232|8@1+ (1,0) [0|0] "" HMDH_203
 SG_ Ecat_FwdRxError3 m31 : 240|8@1+ (1,0) [0|0] "" HMDH_203
 SG_ Ecat_PuError m31 : 248|8@1+ (1,0) [0|0] "" HMDH_203
 SG_ Ecat_PdiError m31 : 256|8@1+ (1,0) [0|0] "" HMDH_203
 SG_ Ecat_LostLink0 m31 : 264|8@1+ (1,0) [0|0] "" HMDH_203
 SG_ Ecat_LostLink1 m31 : 272|8@1+ (1,0) [0|0] "" HMDH_203
 SG_ Ecat_LostLink2 m31 : 280|8@1+ (1,0) [0|0] "" HMDH_203
 SG_ Ecat_LostLink3 m31 : 288|8@1+ (1,0) [0|0] "" HMDH_203
 SG_ Saf_CanId m32 : 8|8@1+ (1,0) [0|0] "" HMDH_203
 SG_ Saf_Name0 m32 : 16|8@1+ (1,0) [0|0] "" HMDH_203
 SG_ Saf_Name1 m32 : 24|8@1+ (1,0) [0|0] "" HMDH_203
 SG_ Saf_Name2 m32 : 32|8@1+ (1,0) [0|0] "" HMDH_203
 SG_ Saf_Name3 m32 : 40|8@1+ (1,0) [0|0] "" HMDH_203
 SG_ Saf_Name4 m32 : 48|8@1+ (1,0) [0|0] "" HMDH_203
 SG_ Saf_Name5 m32 : 56|8@1+ (1,0) [0|0] "" HMDH_203
 SG_ Saf_Name6 m32 : 64|8@1+ (1,0) [0|0] "" HMDH_203
 SG_ Saf_Name7 m32 : 72|8@1+ (1,0) [0|0] "" HMDH_203
 SG_ Saf_Name8 m32 : 80|8@1+ (1,0) [0|0] "" HMDH_203
 SG_ Saf_Name9 m32 : 88|8@1+ (1,0) [0|0] "" HMDH_203
 SG_ Saf_Name10 m32 : 96|8@1+ (1,0) [0|0] "" HMDH_203
 SG_ Saf_Name11 m32 : 104|8@1+ (1,0) [0|0] "" HMDH_203
 SG_ Saf_Name12 m32 : 112|8@1+ (1,0) [0|0] "" HMDH_203
 SG_ Saf_Name13 m32 : 120|8@1+ (1,0) [0|0] "" HMDH_203
 SG_ Saf_Name14 m32 : 128|8@1+ (1,0) [0|0] "" HMDH_203
 SG_ Saf_Name15 m32 : 136|8@1+ (1,0) [0|0] "" HMDH_203
 SG_ Saf_State m32 : 144|8@1+ (1,0) [0|0] "" HMDH_203
 SG_ Saf_Bits m32 : 152|16@1+ (1,0) [0|0] "" HMDH_203
 SG_ Saf_Estop m32 : 168|8@1+ (1,0) [0|0] "" HMDH_203
 SG_ Saf_FatalLatched m32 : 176|16@1+ (1,0) [0|0] "" HMDH_203
 SG_ Saf_ErrCode m32 : 192|32@1+ (1,0) [0|0] "" HMDH_203

BO_ 2163329484 STATUS_HMDH_201_to_HMDH_204: 48 HMDH_201
 SG_ SubCode M : 0|8@1+ (1,0) [0|0] "" HMDH_204
 SG_ Ping_CanId m5 : 8|8@1+ (1,0) [0|0] "" HMDH_204
 SG_ Ping_HostId m5 : 16|8@1+ (1,0) [0|0] "" HMDH_204
 SG_ Ping_Pid m5 : 24|16@1+ (1,0) [0|0] "" HMDH_204
 SG_ Ping_Bid m5 : 40|16@1+ (1,0) [0|0] "" HMDH_204
 SG_ Ping_Mid m5 : 56|16@1+ (1,0) [0|0] "" HMDH_204
 SG_ Ping_VerMajor m5 : 72|8@1+ (1,0) [0|0] "" HMDH_204
 SG_ Ping_VerMinor m5 : 80|8@1+ (1,0) [0|0] "" HMDH_204
 SG_ Ping_VerPatch m5 : 88|8@1+ (1,0) [0|0] "" HMDH_204
 SG_ Ping_Name0 m5 : 96|8@1+ (1,0) [0|0] "" HMDH_204
 SG_ Ping_Name1 m5 : 104|8@1+ (1,0) [0|0] "" HMDH_204
 SG_ Ping_Name2 m5 : 112|8@1+ (1,0) [0|0] "" HMDH_204
 SG_ Ping_Name3 m5 : 120|8@1+ (1,0) [0|0] "" HMDH_204
 SG_ Ping_Name4 m5 : 128|8@1+ (1,0) [0|0] "" HMDH_204
 SG_ Ping_Name5 m5 : 136|8@1+ (1,0) [0|0] "" HMDH_204
 SG_ Ping_Name6 m5 : 144|8@1+ (1,0) [0|0] "" HMDH_204
 SG_ Ping_Name7 m5 : 152|8@1+ (1,0) [0|0] "" HMDH_204
 SG_ Ping_Name8 m5 : 160|8@1+ (1,0) [0|0] "" HMDH_204
 SG_ Ping_Name9 m5 : 168|8@1+ (1,0) [0|0] "" HMDH_204
 SG_ Ping_Name10 m5 : 176|8@1+ (1,0) [0|0] "" HMDH_204
 SG_ Ping_Name11 m5 : 184|8@1+ (1,0) [0|0] "" HMDH_204
 SG_ Ping_Name12 m5 : 192|8@1+ (1,0) [0|0] "" HMDH_204
 SG_ Ping_Name13 m5 : 200|8@1+ (1,0) [0|0] "" HMDH_204
 SG_ Ping_Name14 m5 : 208|8@1+ (1,0) [0|0] "" HMDH_204
 SG_ Ping_Name15 m5 : 216|8@1+ (1,0) [0|0] "" HMDH_204
 SG_ Ping_FmtVer m5 : 224|8@1+ (1,0) [0|0] "" HMDH_204
 SG_ Ping_GitRev m5 : 232|32@1+ (1,0) [0|0] "" HMDH_204
 SG_ Ping_FwCrc m5 : 264|16@1+ (1,0) [0|0] "" HMDH_204
 SG_ Ping_UptimeS m5 : 280|16@1+ (1,0) [0|0] "s" HMDH_204
 SG_ Ecat_CanId m31 : 8|8@1+ (1,0) [0|0] "" HMDH_204
 SG_ Ecat_Name0 m31 : 16|8@1+ (1,0) [0|0] "" HMDH_204
 SG_ Ecat_Name1 m31 : 24|8@1+ (1,0) [0|0] "" HMDH_204
 SG_ Ecat_Name2 m31 : 32|8@1+ (1,0) [0|0] "" HMDH_204
 SG_ Ecat_Name3 m31 : 40|8@1+ (1,0) [0|0] "" HMDH_204
 SG_ Ecat_Name4 m31 : 48|8@1+ (1,0) [0|0] "" HMDH_204
 SG_ Ecat_Name5 m31 : 56|8@1+ (1,0) [0|0] "" HMDH_204
 SG_ Ecat_Name6 m31 : 64|8@1+ (1,0) [0|0] "" HMDH_204
 SG_ Ecat_Name7 m31 : 72|8@1+ (1,0) [0|0] "" HMDH_204
 SG_ Ecat_Name8 m31 : 80|8@1+ (1,0) [0|0] "" HMDH_204
 SG_ Ecat_Name9 m31 : 88|8@1+ (1,0) [0|0] "" HMDH_204
 SG_ Ecat_Name10 m31 : 96|8@1+ (1,0) [0|0] "" HMDH_204
 SG_ Ecat_Name11 m31 : 104|8@1+ (1,0) [0|0] "" HMDH_204
 SG_ Ecat_Name12 m31 : 112|8@1+ (1,0) [0|0] "" HMDH_204
 SG_ Ecat_Name13 m31 : 120|8@1+ (1,0) [0|0] "" HMDH_204
 SG_ Ecat_Name14 m31 : 128|8@1+ (1,0) [0|0] "" HMDH_204
 SG_ Ecat_Name15 m31 : 136|8@1+ (1,0) [0|0] "" HMDH_204
 SG_ Ecat_Link m31 : 144|8@1+ (1,0) [0|0] "" HMDH_204
 SG_ Ecat_InvalidFrame0 m31 : 152|8@1+ (1,0) [0|0] "" HMDH_204
 SG_ Ecat_InvalidFrame1 m31 : 160|8@1+ (1,0) [0|0] "" HMDH_204
 SG_ Ecat_InvalidFrame2 m31 : 168|8@1+ (1,0) [0|0] "" HMDH_204
 SG_ Ecat_InvalidFrame3 m31 : 176|8@1+ (1,0) [0|0] "" HMDH_204
 SG_ Ecat_RxError0 m31 : 184|8@1+ (1,0) [0|0] "" HMDH_204
 SG_ Ecat_RxError1 m31 : 192|8@1+ (1,0) [0|0] "" HMDH_204
 SG_ Ecat_RxError2 m31 : 200|8@1+ (1,0) [0|0] "" HMDH_204
 SG_ Ecat_RxError3 m31 : 208|8@1+ (1,0) [0|0] "" HMDH_204
 SG_ Ecat_FwdRxError0 m31 : 216|8@1+ (1,0) [0|0] "" HMDH_204
 SG_ Ecat_FwdRxError1 m31 : 224|8@1+ (1,0) [0|0] "" HMDH_204
 SG_ Ecat_FwdRxError2 m31 : 232|8@1+ (1,0) [0|0] "" HMDH_204
 SG_ Ecat_FwdRxError3 m31 : 240|8@1+ (1,0) [0|0] "" HMDH_204
 SG_ Ecat_PuError m31 : 248|8@1+ (1,0) [0|0] "" HMDH_204
 SG_ Ecat_PdiError m31 : 256|8@1+ (1,0) [0|0] "" HMDH_204
 SG_ Ecat_LostLink0 m31 : 264|8@1+ (1,0) [0|0] "" HMDH_204
 SG_ Ecat_LostLink1 m31 : 272|8@1+ (1,0) [0|0] "" HMDH_204
 SG_ Ecat_LostLink2 m31 : 280|8@1+ (1,0) [0|0] "" HMDH_204
 SG_ Ecat_LostLink3 m31 : 288|8@1+ (1,0) [0|0] "" HMDH_204
 SG_ Saf_CanId m32 : 8|8@1+ (1,0) [0|0] "" HMDH_204
 SG_ Saf_Name0 m32 : 16|8@1+ (1,0) [0|0] "" HMDH_204
 SG_ Saf_Name1 m32 : 24|8@1+ (1,0) [0|0] "" HMDH_204
 SG_ Saf_Name2 m32 : 32|8@1+ (1,0) [0|0] "" HMDH_204
 SG_ Saf_Name3 m32 : 40|8@1+ (1,0) [0|0] "" HMDH_204
 SG_ Saf_Name4 m32 : 48|8@1+ (1,0) [0|0] "" HMDH_204
 SG_ Saf_Name5 m32 : 56|8@1+ (1,0) [0|0] "" HMDH_204
 SG_ Saf_Name6 m32 : 64|8@1+ (1,0) [0|0] "" HMDH_204
 SG_ Saf_Name7 m32 : 72|8@1+ (1,0) [0|0] "" HMDH_204
 SG_ Saf_Name8 m32 : 80|8@1+ (1,0) [0|0] "" HMDH_204
 SG_ Saf_Name9 m32 : 88|8@1+ (1,0) [0|0] "" HMDH_204
 SG_ Saf_Name10 m32 : 96|8@1+ (1,0) [0|0] "" HMDH_204
 SG_ Saf_Name11 m32 : 104|8@1+ (1,0) [0|0] "" HMDH_204
 SG_ Saf_Name12 m32 : 112|8@1+ (1,0) [0|0] "" HMDH_204
 SG_ Saf_Name13 m32 : 120|8@1+ (1,0) [0|0] "" HMDH_204
 SG_ Saf_Name14 m32 : 128|8@1+ (1,0) [0|0] "" HMDH_204
 SG_ Saf_Name15 m32 : 136|8@1+ (1,0) [0|0] "" HMDH_204
 SG_ Saf_State m32 : 144|8@1+ (1,0) [0|0] "" HMDH_204
 SG_ Saf_Bits m32 : 152|16@1+ (1,0) [0|0] "" HMDH_204
 SG_ Saf_Estop m32 : 168|8@1+ (1,0) [0|0] "" HMDH_204
 SG_ Saf_FatalLatched m32 : 176|16@1+ (1,0) [0|0] "" HMDH_204
 SG_ Saf_ErrCode m32 : 192|32@1+ (1,0) [0|0] "" HMDH_204

BO_ 2163329485 STATUS_HMDH_201_to_HMDH_205: 48 HMDH_201
 SG_ SubCode M : 0|8@1+ (1,0) [0|0] "" HMDH_205
 SG_ Ping_CanId m5 : 8|8@1+ (1,0) [0|0] "" HMDH_205
 SG_ Ping_HostId m5 : 16|8@1+ (1,0) [0|0] "" HMDH_205
 SG_ Ping_Pid m5 : 24|16@1+ (1,0) [0|0] "" HMDH_205
 SG_ Ping_Bid m5 : 40|16@1+ (1,0) [0|0] "" HMDH_205
 SG_ Ping_Mid m5 : 56|16@1+ (1,0) [0|0] "" HMDH_205
 SG_ Ping_VerMajor m5 : 72|8@1+ (1,0) [0|0] "" HMDH_205
 SG_ Ping_VerMinor m5 : 80|8@1+ (1,0) [0|0] "" HMDH_205
 SG_ Ping_VerPatch m5 : 88|8@1+ (1,0) [0|0] "" HMDH_205
 SG_ Ping_Name0 m5 : 96|8@1+ (1,0) [0|0] "" HMDH_205
 SG_ Ping_Name1 m5 : 104|8@1+ (1,0) [0|0] "" HMDH_205
 SG_ Ping_Name2 m5 : 112|8@1+ (1,0) [0|0] "" HMDH_205
 SG_ Ping_Name3 m5 : 120|8@1+ (1,0) [0|0] "" HMDH_205
 SG_ Ping_Name4 m5 : 128|8@1+ (1,0) [0|0] "" HMDH_205
 SG_ Ping_Name5 m5 : 136|8@1+ (1,0) [0|0] "" HMDH_205
 SG_ Ping_Name6 m5 : 144|8@1+ (1,0) [0|0] "" HMDH_205
 SG_ Ping_Name7 m5 : 152|8@1+ (1,0) [0|0] "" HMDH_205
 SG_ Ping_Name8 m5 : 160|8@1+ (1,0) [0|0] "" HMDH_205
 SG_ Ping_Name9 m5 : 168|8@1+ (1,0) [0|0] "" HMDH_205
 SG_ Ping_Name10 m5 : 176|8@1+ (1,0) [0|0] "" HMDH_205
 SG_ Ping_Name11 m5 : 184|8@1+ (1,0) [0|0] "" HMDH_205
 SG_ Ping_Name12 m5 : 192|8@1+ (1,0) [0|0] "" HMDH_205
 SG_ Ping_Name13 m5 : 200|8@1+ (1,0) [0|0] "" HMDH_205
 SG_ Ping_Name14 m5 : 208|8@1+ (1,0) [0|0] "" HMDH_205
 SG_ Ping_Name15 m5 : 216|8@1+ (1,0) [0|0] "" HMDH_205
 SG_ Ping_FmtVer m5 : 224|8@1+ (1,0) [0|0] "" HMDH_205
 SG_ Ping_GitRev m5 : 232|32@1+ (1,0) [0|0] "" HMDH_205
 SG_ Ping_FwCrc m5 : 264|16@1+ (1,0) [0|0] "" HMDH_205
 SG_ Ping_UptimeS m5 : 280|16@1+ (1,0) [0|0] "s" HMDH_205
 SG_ Ecat_CanId m31 : 8|8@1+ (1,0) [0|0] "" HMDH_205
 SG_ Ecat_Name0 m31 : 16|8@1+ (1,0) [0|0] "" HMDH_205
 SG_ Ecat_Name1 m31 : 24|8@1+ (1,0) [0|0] "" HMDH_205
 SG_ Ecat_Name2 m31 : 32|8@1+ (1,0) [0|0] "" HMDH_205
 SG_ Ecat_Name3 m31 : 40|8@1+ (1,0) [0|0] "" HMDH_205
 SG_ Ecat_Name4 m31 : 48|8@1+ (1,0) [0|0] "" HMDH_205
 SG_ Ecat_Name5 m31 : 56|8@1+ (1,0) [0|0] "" HMDH_205
 SG_ Ecat_Name6 m31 : 64|8@1+ (1,0) [0|0] "" HMDH_205
 SG_ Ecat_Name7 m31 : 72|8@1+ (1,0) [0|0] "" HMDH_205
 SG_ Ecat_Name8 m31 : 80|8@1+ (1,0) [0|0] "" HMDH_205
 SG_ Ecat_Name9 m31 : 88|8@1+ (1,0) [0|0] "" HMDH_205
 SG_ Ecat_Name10 m31 : 96|8@1+ (1,0) [0|0] "" HMDH_205
 SG_ Ecat_Name11 m31 : 104|8@1+ (1,0) [0|0] "" HMDH_205
 SG_ Ecat_Name12 m31 : 112|8@1+ (1,0) [0|0] "" HMDH_205
 SG_ Ecat_Name13 m31 : 120|8@1+ (1,0) [0|0] "" HMDH_205
 SG_ Ecat_Name14 m31 : 128|8@1+ (1,0) [0|0] "" HMDH_205
 SG_ Ecat_Name15 m31 : 136|8@1+ (1,0) [0|0] "" HMDH_205
 SG_ Ecat_Link m31 : 144|8@1+ (1,0) [0|0] "" HMDH_205
 SG_ Ecat_InvalidFrame0 m31 : 152|8@1+ (1,0) [0|0] "" HMDH_205
 SG_ Ecat_InvalidFrame1 m31 : 160|8@1+ (1,0) [0|0] "" HMDH_205
 SG_ Ecat_InvalidFrame2 m31 : 168|8@1+ (1,0) [0|0] "" HMDH_205
 SG_ Ecat_InvalidFrame3 m31 : 176|8@1+ (1,0) [0|0] "" HMDH_205
 SG_ Ecat_RxError0 m31 : 184|8@1+ (1,0) [0|0] "" HMDH_205
 SG_ Ecat_RxError1 m31 : 192|8@1+ (1,0) [0|0] "" HMDH_205
 SG_ Ecat_RxError2 m31 : 200|8@1+ (1,0) [0|0] "" HMDH_205
 SG_ Ecat_RxError3 m31 : 208|8@1+ (1,0) [0|0] "" HMDH_205
 SG_ Ecat_FwdRxError0 m31 : 216|8@1+ (1,0) [0|0] "" HMDH_205
 SG_ Ecat_FwdRxError1 m31 : 224|8@1+ (1,0) [0|0] "" HMDH_205
 SG_ Ecat_FwdRxError2 m31 : 232|8@1+ (1,0) [0|0] "" HMDH_205
 SG_ Ecat_FwdRxError3 m31 : 240|8@1+ (1,0) [0|0] "" HMDH_205
 SG_ Ecat_PuError m31 : 248|8@1+ (1,0) [0|0] "" HMDH_205
 SG_ Ecat_PdiError m31 : 256|8@1+ (1,0) [0|0] "" HMDH_205
 SG_ Ecat_LostLink0 m31 : 264|8@1+ (1,0) [0|0] "" HMDH_205
 SG_ Ecat_LostLink1 m31 : 272|8@1+ (1,0) [0|0] "" HMDH_205
 SG_ Ecat_LostLink2 m31 : 280|8@1+ (1,0) [0|0] "" HMDH_205
 SG_ Ecat_LostLink3 m31 : 288|8@1+ (1,0) [0|0] "" HMDH_205
 SG_ Saf_CanId m32 : 8|8@1+ (1,0) [0|0] "" HMDH_205
 SG_ Saf_Name0 m32 : 16|8@1+ (1,0) [0|0] "" HMDH_205
 SG_ Saf_Name1 m32 : 24|8@1+ (1,0) [0|0] "" HMDH_205
 SG_ Saf_Name2 m32 : 32|8@1+ (1,0) [0|0] "" HMDH_205
 SG_ Saf_Name3 m32 : 40|8@1+ (1,0) [0|0] "" HMDH_205
 SG_ Saf_Name4 m32 : 48|8@1+ (1,0) [0|0] "" HMDH_205
 SG_ Saf_Name5 m32 : 56|8@1+ (1,0) [0|0] "" HMDH_205
 SG_ Saf_Name6 m32 : 64|8@1+ (1,0) [0|0] "" HMDH_205
 SG_ Saf_Name7 m32 : 72|8@1+ (1,0) [0|0] "" HMDH_205
 SG_ Saf_Name8 m32 : 80|8@1+ (1,0) [0|0] "" HMDH_205
 SG_ Saf_Name9 m32 : 88|8@1+ (1,0) [0|0] "" HMDH_205
 SG_ Saf_Name10 m32 : 96|8@1+ (1,0) [0|0] "" HMDH_205
 SG_ Saf_Name11 m32 : 104|8@1+ (1,0) [0|0] "" HMDH_205
 SG_ Saf_Name12 m32 : 112|8@1+ (1,0) [0|0] "" HMDH_205
 SG_ Saf_Name13 m32 : 120|8@1+ (1,0) [0|0] "" HMDH_205
 SG_ Saf_Name14 m32 : 128|8@1+ (1,0) [0|0] "" HMDH_205
 SG_ Saf_Name15 m32 : 136|8@1+ (1,0) [0|0] "" HMDH_205
 SG_ Saf_State m32 : 144|8@1+ (1,0) [0|0] "" HMDH_205
 SG_ Saf_Bits m32 : 152|16@1+ (1,0) [0|0] "" HMDH_205
 SG_ Saf_Estop m32 : 168|8@1+ (1,0) [0|0] "" HMDH_205
 SG_ Saf_FatalLatched m32 : 176|16@1+ (1,0) [0|0] "" HMDH_205
 SG_ Saf_ErrCode m32 : 192|32@1+ (1,0) [0|0] "" HMDH_205

BO_ 2163329486 STATUS_HMDH_201_to_HMDH_206: 48 HMDH_201
 SG_ SubCode M : 0|8@1+ (1,0) [0|0] "" HMDH_206
 SG_ Ping_CanId m5 : 8|8@1+ (1,0) [0|0] "" HMDH_206
 SG_ Ping_HostId m5 : 16|8@1+ (1,0) [0|0] "" HMDH_206
 SG_ Ping_Pid m5 : 24|16@1+ (1,0) [0|0] "" HMDH_206
 SG_ Ping_Bid m5 : 40|16@1+ (1,0) [0|0] "" HMDH_206
 SG_ Ping_Mid m5 : 56|16@1+ (1,0) [0|0] "" HMDH_206
 SG_ Ping_VerMajor m5 : 72|8@1+ (1,0) [0|0] "" HMDH_206
 SG_ Ping_VerMinor m5 : 80|8@1+ (1,0) [0|0] "" HMDH_206
 SG_ Ping_VerPatch m5 : 88|8@1+ (1,0) [0|0] "" HMDH_206
 SG_ Ping_Name0 m5 : 96|8@1+ (1,0) [0|0] "" HMDH_206
 SG_ Ping_Name1 m5 : 104|8@1+ (1,0) [0|0] "" HMDH_206
 SG_ Ping_Name2 m5 : 112|8@1+ (1,0) [0|0] "" HMDH_206
 SG_ Ping_Name3 m5 : 120|8@1+ (1,0) [0|0] "" HMDH_206
 SG_ Ping_Name4 m5 : 128|8@1+ (1,0) [0|0] "" HMDH_206
 SG_ Ping_Name5 m5 : 136|8@1+ (1,0) [0|0] "" HMDH_206
 SG_ Ping_Name6 m5 : 144|8@1+ (1,0) [0|0] "" HMDH_206
 SG_ Ping_Name7 m5 : 152|8@1+ (1,0) [0|0] "" HMDH_206
 SG_ Ping_Name8 m5 : 160|8@1+ (1,0) [0|0] "" HMDH_206
 SG_ Ping_Name9 m5 : 168|8@1+ (1,0) [0|0] "" HMDH_206
 SG_ Ping_Name10 m5 : 176|8@1+ (1,0) [0|0] "" HMDH_206
 SG_ Ping_Name11 m5 : 184|8@1+ (1,0) [0|0] "" HMDH_206
 SG_ Ping_Name12 m5 : 192|8@1+ (1,0) [0|0] "" HMDH_206
 SG_ Ping_Name13 m5 : 200|8@1+ (1,0) [0|0] "" HMDH_206
 SG_ Ping_Name14 m5 : 208|8@1+ (1,0) [0|0] "" HMDH_206
 SG_ Ping_Name15 m5 : 216|8@1+ (1,0) [0|0] "" HMDH_206
 SG_ Ping_FmtVer m5 : 224|8@1+ (1,0) [0|0] "" HMDH_206
 SG_ Ping_GitRev m5 : 232|32@1+ (1,0) [0|0] "" HMDH_206
 SG_ Ping_FwCrc m5 : 264|16@1+ (1,0) [0|0] "" HMDH_206
 SG_ Ping_UptimeS m5 : 280|16@1+ (1,0) [0|0] "s" HMDH_206
 SG_ Ecat_CanId m31 : 8|8@1+ (1,0) [0|0] "" HMDH_206
 SG_ Ecat_Name0 m31 : 16|8@1+ (1,0) [0|0] "" HMDH_206
 SG_ Ecat_Name1 m31 : 24|8@1+ (1,0) [0|0] "" HMDH_206
 SG_ Ecat_Name2 m31 : 32|8@1+ (1,0) [0|0] "" HMDH_206
 SG_ Ecat_Name3 m31 : 40|8@1+ (1,0) [0|0] "" HMDH_206
 SG_ Ecat_Name4 m31 : 48|8@1+ (1,0) [0|0] "" HMDH_206
 SG_ Ecat_Name5 m31 : 56|8@1+ (1,0) [0|0] "" HMDH_206
 SG_ Ecat_Name6 m31 : 64|8@1+ (1,0) [0|0] "" HMDH_206
 SG_ Ecat_Name7 m31 : 72|8@1+ (1,0) [0|0] "" HMDH_206
 SG_ Ecat_Name8 m31 : 80|8@1+ (1,0) [0|0] "" HMDH_206
 SG_ Ecat_Name9 m31 : 88|8@1+ (1,0) [0|0] "" HMDH_206
 SG_ Ecat_Name10 m31 : 96|8@1+ (1,0) [0|0] "" HMDH_206
 SG_ Ecat_Name11 m31 : 104|8@1+ (1,0) [0|0] "" HMDH_206
 SG_ Ecat_Name12 m31 : 112|8@1+ (1,0) [0|0] "" HMDH_206
 SG_ Ecat_Name13 m31 : 120|8@1+ (1,0) [0|0] "" HMDH_206
 SG_ Ecat_Name14 m31 : 128|8@1+ (1,0) [0|0] "" HMDH_206
 SG_ Ecat_Name15 m31 : 136|8@1+ (1,0) [0|0] "" HMDH_206
 SG_ Ecat_Link m31 : 144|8@1+ (1,0) [0|0] "" HMDH_206
 SG_ Ecat_InvalidFrame0 m31 : 152|8@1+ (1,0) [0|0] "" HMDH_206
 SG_ Ecat_InvalidFrame1 m31 : 160|8@1+ (1,0) [0|0] "" HMDH_206
 SG_ Ecat_InvalidFrame2 m31 : 168|8@1+ (1,0) [0|0] "" HMDH_206
 SG_ Ecat_InvalidFrame3 m31 : 176|8@1+ (1,0) [0|0] "" HMDH_206
 SG_ Ecat_RxError0 m31 : 184|8@1+ (1,0) [0|0] "" HMDH_206
 SG_ Ecat_RxError1 m31 : 192|8@1+ (1,0) [0|0] "" HMDH_206
 SG_ Ecat_RxError2 m31 : 200|8@1+ (1,0) [0|0] "" HMDH_206
 SG_ Ecat_RxError3 m31 : 208|8@1+ (1,0) [0|0] "" HMDH_206
 SG_ Ecat_FwdRxError0 m31 : 216|8@1+ (1,0) [0|0] "" HMDH_206
 SG_ Ecat_FwdRxError1 m31 : 224|8@1+ (1,0) [0|0] "" HMDH_206
 SG_ Ecat_FwdRxError2 m31 : 232|8@1+ (1,0) [0|0] "" HMDH_206
 SG_ Ecat_FwdRxError3 m31 : 240|8@1+ (1,0) [0|0] "" HMDH_206
 SG_ Ecat_PuError m31 : 248|8@1+ (1,0) [0|0] "" HMDH_206
 SG_ Ecat_PdiError m31 : 256|8@1+ (1,0) [0|0] "" HMDH_206
 SG_ Ecat_LostLink0 m31 : 264|8@1+ (1,0) [0|0] "" HMDH_206
 SG_ Ecat_LostLink1 m31 : 272|8@1+ (1,0) [0|0] "" HMDH_206
 SG_ Ecat_LostLink2 m31 : 280|8@1+ (1,0) [0|0] "" HMDH_206
 SG_ Ecat_LostLink3 m31 : 288|8@1+ (1,0) [0|0] "" HMDH_206
 SG_ Saf_CanId m32 : 8|8@1+ (1,0) [0|0] "" HMDH_206
 SG_ Saf_Name0 m32 : 16|8@1+ (1,0) [0|0] "" HMDH_206
 SG_ Saf_Name1 m32 : 24|8@1+ (1,0) [0|0] "" HMDH_206
 SG_ Saf_Name2 m32 : 32|8@1+ (1,0) [0|0] "" HMDH_206
 SG_ Saf_Name3 m32 : 40|8@1+ (1,0) [0|0] "" HMDH_206
 SG_ Saf_Name4 m32 : 48|8@1+ (1,0) [0|0] "" HMDH_206
 SG_ Saf_Name5 m32 : 56|8@1+ (1,0) [0|0] "" HMDH_206
 SG_ Saf_Name6 m32 : 64|8@1+ (1,0) [0|0] "" HMDH_206
 SG_ Saf_Name7 m32 : 72|8@1+ (1,0) [0|0] "" HMDH_206
 SG_ Saf_Name8 m32 : 80|8@1+ (1,0) [0|0] "" HMDH_206
 SG_ Saf_Name9 m32 : 88|8@1+ (1,0) [0|0] "" HMDH_206
 SG_ Saf_Name10 m32 : 96|8@1+ (1,0) [0|0] "" HMDH_206
 SG_ Saf_Name11 m32 : 104|8@1+ (1,0) [0|0] "" HMDH_206
 SG_ Saf_Name12 m32 : 112|8@1+ (1,0) [0|0] "" HMDH_206
 SG_ Saf_Name13 m32 : 120|8@1+ (1,0) [0|0] "" HMDH_206
 SG_ Saf_Name14 m32 : 128|8@1+ (1,0) [0|0] "" HMDH_206
 SG_ Saf_Name15 m32 : 136|8@1+ (1,0) [0|0] "" HMDH_206
 SG_ Saf_State m32 : 144|8@1+ (1,0) [0|0] "" HMDH_206
 SG_ Saf_Bits m32 : 152|16@1+ (1,0) [0|0] "" HMDH_206
 SG_ Saf_Estop m32 : 168|8@1+ (1,0) [0|0] "" HMDH_206
 SG_ Saf_FatalLatched m32 : 176|16@1+ (1,0) [0|0] "" HMDH_206
 SG_ Saf_ErrCode m32 : 192|32@1+ (1,0) [0|0] "" HMDH_206

BO_ 2163329487 STATUS_HMDH_201_to_HMDH_207: 48 HMDH_201
 SG_ SubCode M : 0|8@1+ (1,0) [0|0] "" HMDH_207
 SG_ Ping_CanId m5 : 8|8@1+ (1,0) [0|0] "" HMDH_207
 SG_ Ping_HostId m5 : 16|8@1+ (1,0) [0|0] "" HMDH_207
 SG_ Ping_Pid m5 : 24|16@1+ (1,0) [0|0] "" HMDH_207
 SG_ Ping_Bid m5 : 40|16@1+ (1,0) [0|0] "" HMDH_207
 SG_ Ping_Mid m5 : 56|16@1+ (1,0) [0|0] "" HMDH_207
 SG_ Ping_VerMajor m5 : 72|8@1+ (1,0) [0|0] "" HMDH_207
 SG_ Ping_VerMinor m5 : 80|8@1+ (1,0) [0|0] "" HMDH_207
 SG_ Ping_VerPatch m5 : 88|8@1+ (1,0) [0|0] "" HMDH_207
 SG_ Ping_Name0 m5 : 96|8@1+ (1,0) [0|0] "" HMDH_207
 SG_ Ping_Name1 m5 : 104|8@1+ (1,0) [0|0] "" HMDH_207
 SG_ Ping_Name2 m5 : 112|8@1+ (1,0) [0|0] "" HMDH_207
 SG_ Ping_Name3 m5 : 120|8@1+ (1,0) [0|0] "" HMDH_207
 SG_ Ping_Name4 m5 : 128|8@1+ (1,0) [0|0] "" HMDH_207
 SG_ Ping_Name5 m5 : 136|8@1+ (1,0) [0|0] "" HMDH_207
 SG_ Ping_Name6 m5 : 144|8@1+ (1,0) [0|0] "" HMDH_207
 SG_ Ping_Name7 m5 : 152|8@1+ (1,0) [0|0] "" HMDH_207
 SG_ Ping_Name8 m5 : 160|8@1+ (1,0) [0|0] "" HMDH_207
 SG_ Ping_Name9 m5 : 168|8@1+ (1,0) [0|0] "" HMDH_207
 SG_ Ping_Name10 m5 : 176|8@1+ (1,0) [0|0] "" HMDH_207
 SG_ Ping_Name11 m5 : 184|8@1+ (1,0) [0|0] "" HMDH_207
 SG_ Ping_Name12 m5 : 192|8@1+ (1,0) [0|0] "" HMDH_207
 SG_ Ping_Name13 m5 : 200|8@1+ (1,0) [0|0] "" HMDH_207
 SG_ Ping_Name14 m5 : 208|8@1+ (1,0) [0|0] "" HMDH_207
 SG_ Ping_Name15 m5 : 216|8@1+ (1,0) [0|0] "" HMDH_207
 SG_ Ping_FmtVer m5 : 224|8@1+ (1,0) [0|0] "" HMDH_207
 SG_ Ping_GitRev m5 : 232|32@1+ (1,0) [0|0] "" HMDH_207
 SG_ Ping_FwCrc m5 : 264|16@1+ (1,0) [0|0] "" HMDH_207
 SG_ Ping_UptimeS m5 : 280|16@1+ (1,0) [0|0] "s" HMDH_207
 SG_ Ecat_CanId m31 : 8|8@1+ (1,0) [0|0] "" HMDH_207
 SG_ Ecat_Name0 m31 : 16|8@1+ (1,0) [0|0] "" HMDH_207
 SG_ Ecat_Name1 m31 : 24|8@1+ (1,0) [0|0] "" HMDH_207
 SG_ Ecat_Name2 m31 : 32|8@1+ (1,0) [0|0] "" HMDH_207
 SG_ Ecat_Name3 m31 : 40|8@1+ (1,0) [0|0] "" HMDH_207
 SG_ Ecat_Name4 m31 : 48|8@1+ (1,0) [0|0] "" HMDH_207
 SG_ Ecat_Name5 m31 : 56|8@1+ (1,0) [0|0] "" HMDH_207
 SG_ Ecat_Name6 m31 : 64|8@1+ (1,0) [0|0] "" HMDH_207
 SG_ Ecat_Name7 m31 : 72|8@1+ (1,0) [0|0] "" HMDH_207
 SG_ Ecat_Name8 m31 : 80|8@1+ (1,0) [0|0] "" HMDH_207
 SG_ Ecat_Name9 m31 : 88|8@1+ (1,0) [0|0] "" HMDH_207
 SG_ Ecat_Name10 m31 : 96|8@1+ (1,0) [0|0] "" HMDH_207
 SG_ Ecat_Name11 m31 : 104|8@1+ (1,0) [0|0] "" HMDH_207
 SG_ Ecat_Name12 m31 : 112|8@1+ (1,0) [0|0] "" HMDH_207
 SG_ Ecat_Name13 m31 : 120|8@1+ (1,0) [0|0] "" HMDH_207
 SG_ Ecat_Name14 m31 : 128|8@1+ (1,0) [0|0] "" HMDH_207
 SG_ Ecat_Name15 m31 : 136|8@1+ (1,0) [0|0] "" HMDH_207
 SG_ Ecat_Link m31 : 144|8@1+ (1,0) [0|0] "" HMDH_207
 SG_ Ecat_InvalidFrame0 m31 : 152|8@1+ (1,0) [0|0] "" HMDH_207
 SG_ Ecat_InvalidFrame1 m31 : 160|8@1+ (1,0) [0|0] "" HMDH_207
 SG_ Ecat_InvalidFrame2 m31 : 168|8@1+ (1,0) [0|0] "" HMDH_207
 SG_ Ecat_InvalidFrame3 m31 : 176|8@1+ (1,0) [0|0] "" HMDH_207
 SG_ Ecat_RxError0 m31 : 184|8@1+ (1,0) [0|0] "" HMDH_207
 SG_ Ecat_RxError1 m31 : 192|8@1+ (1,0) [0|0] "" HMDH_207
 SG_ Ecat_RxError2 m31 : 200|8@1+ (1,0) [0|0] "" HMDH_207
 SG_ Ecat_RxError3 m31 : 208|8@1+ (1,0) [0|0] "" HMDH_207
 SG_ Ecat_FwdRxError0 m31 : 216|8@1+ (1,0) [0|0] "" HMDH_207
 SG_ Ecat_FwdRxError1 m31 : 224|8@1+ (1,0) [0|0] "" HMDH_207
 SG_ Ecat_FwdRxError2 m31 : 232|8@1+ (1,0) [0|0] "" HMDH_207
 SG_ Ecat_FwdRxError3 m31 : 240|8@1+ (1,0) [0|0] "" HMDH_207
 SG_ Ecat_PuError m31 : 248|8@1+ (1,0) [0|0] "" HMDH_207
 SG_ Ecat_PdiError m31 : 256|8@1+ (1,0) [0|0] "" HMDH_207
 SG_ Ecat_LostLink0 m31 : 264|8@1+ (1,0) [0|0] "" HMDH_207
 SG_ Ecat_LostLink1 m31 : 272|8@1+ (1,0) [0|0] "" HMDH_207
 SG_ Ecat_LostLink2 m31 : 280|8@1+ (1,0) [0|0] "" HMDH_207
 SG_ Ecat_LostLink3 m31 : 288|8@1+ (1,0) [0|0] "" HMDH_207
 SG_ Saf_CanId m32 : 8|8@1+ (1,0) [0|0] "" HMDH_207
 SG_ Saf_Name0 m32 : 16|8@1+ (1,0) [0|0] "" HMDH_207
 SG_ Saf_Name1 m32 : 24|8@1+ (1,0) [0|0] "" HMDH_207
 SG_ Saf_Name2 m32 : 32|8@1+ (1,0) [0|0] "" HMDH_207
 SG_ Saf_Name3 m32 : 40|8@1+ (1,0) [0|0] "" HMDH_207
 SG_ Saf_Name4 m32 : 48|8@1+ (1,0) [0|0] "" HMDH_207
 SG_ Saf_Name5 m32 : 56|8@1+ (1,0) [0|0] "" HMDH_207
 SG_ Saf_Name6 m32 : 64|8@1+ (1,0) [0|0] "" HMDH_207
 SG_ Saf_Name7 m32 : 72|8@1+ (1,0) [0|0] "" HMDH_207
 SG_ Saf_Name8 m32 : 80|8@1+ (1,0) [0|0] "" HMDH_207
 SG_ Saf_Name9 m32 : 88|8@1+ (1,0) [0|0] "" HMDH_207
 SG_ Saf_Name10 m32 : 96|8@1+ (1,0) [0|0] "" HMDH_207
 SG_ Saf_Name11 m32 : 104|8@1+ (1,0) [0|0] "" HMDH_207
 SG_ Saf_Name12 m32 : 112|8@1+ (1,0) [0|0] "" HMDH_207
 SG_ Saf_Name13 m32 : 120|8@1+ (1,0) [0|0] "" HMDH_207
 SG_ Saf_Name14 m32 : 128|8@1+ (1,0) [0|0] "" HMDH_207
 SG_ Saf_Name15 m32 : 136|8@1+ (1,0) [0|0] "" HMDH_207
 SG_ Saf_State m32 : 144|8@1+ (1,0) [0|0] "" HMDH_207
 SG_ Saf_Bits m32 : 152|16@1+ (1,0) [0|0] "" HMDH_207
 SG_ Saf_Estop m32 : 168|8@1+ (1,0) [0|0] "" HMDH_207
 SG_ Saf_FatalLatched m32 : 176|16@1+ (1,0) [0|0] "" HMDH_207
 SG_ Saf_ErrCode m32 : 192|32@1+ (1,0) [0|0] "" HMDH_207

BO_ 2163329636 STATUS_HMDH_202_to_HETC_M_MOB: 48 HMDH_202
 SG_ SubCode M : 0|8@1+ (1,0) [0|0] "" HETC_M_MOB
 SG_ Ping_CanId m5 : 8|8@1+ (1,0) [0|0] "" HETC_M_MOB
 SG_ Ping_HostId m5 : 16|8@1+ (1,0) [0|0] "" HETC_M_MOB
 SG_ Ping_Pid m5 : 24|16@1+ (1,0) [0|0] "" HETC_M_MOB
 SG_ Ping_Bid m5 : 40|16@1+ (1,0) [0|0] "" HETC_M_MOB
 SG_ Ping_Mid m5 : 56|16@1+ (1,0) [0|0] "" HETC_M_MOB
 SG_ Ping_VerMajor m5 : 72|8@1+ (1,0) [0|0] "" HETC_M_MOB
 SG_ Ping_VerMinor m5 : 80|8@1+ (1,0) [0|0] "" HETC_M_MOB
 SG_ Ping_VerPatch m5 : 88|8@1+ (1,0) [0|0] "" HETC_M_MOB
 SG_ Ping_Name0 m5 : 96|8@1+ (1,0) [0|0] "" HETC_M_MOB
 SG_ Ping_Name1 m5 : 104|8@1+ (1,0) [0|0] "" HETC_M_MOB
 SG_ Ping_Name2 m5 : 112|8@1+ (1,0) [0|0] "" HETC_M_MOB
 SG_ Ping_Name3 m5 : 120|8@1+ (1,0) [0|0] "" HETC_M_MOB
 SG_ Ping_Name4 m5 : 128|8@1+ (1,0) [0|0] "" HETC_M_MOB
 SG_ Ping_Name5 m5 : 136|8@1+ (1,0) [0|0] "" HETC_M_MOB
 SG_ Ping_Name6 m5 : 144|8@1+ (1,0) [0|0] "" HETC_M_MOB
 SG_ Ping_Name7 m5 : 152|8@1+ (1,0) [0|0] "" HETC_M_MOB
 SG_ Ping_Name8 m5 : 160|8@1+ (1,0) [0|0] "" HETC_M_MOB
 SG_ Ping_Name9 m5 : 168|8@1+ (1,0) [0|0] "" HETC_M_MOB
 SG_ Ping_Name10 m5 : 176|8@1+ (1,0) [0|0] "" HETC_M_MOB
 SG_ Ping_Name11 m5 : 184|8@1+ (1,0) [0|0] "" HETC_M_MOB
 SG_ Ping_Name12 m5 : 192|8@1+ (1,0) [0|0] "" HETC_M_MOB
 SG_ Ping_Name13 m5 : 200|8@1+ (1,0) [0|0] "" HETC_M_MOB
 SG_ Ping_Name14 m5 : 208|8@1+ (1,0) [0|0] "" HETC_M_MOB
 SG_ Ping_Name15 m5 : 216|8@1+ (1,0) [0|0] "" HETC_M_MOB
 SG_ Ping_FmtVer m5 : 224|8@1+ (1,0) [0|0] "" HETC_M_MOB
 SG_ Ping_GitRev m5 : 232|32@1+ (1,0) [0|0] "" HETC_M_MOB
 SG_ Ping_FwCrc m5 : 264|16@1+ (1,0) [0|0] "" HETC_M_MOB
 SG_ Ping_UptimeS m5 : 280|16@1+ (1,0) [0|0] "s" HETC_M_MOB
 SG_ Ecat_CanId m31 : 8|8@1+ (1,0) [0|0] "" HETC_M_MOB
 SG_ Ecat_Name0 m31 : 16|8@1+ (1,0) [0|0] "" HETC_M_MOB
 SG_ Ecat_Name1 m31 : 24|8@1+ (1,0) [0|0] "" HETC_M_MOB
 SG_ Ecat_Name2 m31 : 32|8@1+ (1,0) [0|0] "" HETC_M_MOB
 SG_ Ecat_Name3 m31 : 40|8@1+ (1,0) [0|0] "" HETC_M_MOB
 SG_ Ecat_Name4 m31 : 48|8@1+ (1,0) [0|0] "" HETC_M_MOB
 SG_ Ecat_Name5 m31 : 56|8@1+ (1,0) [0|0] "" HETC_M_MOB
 SG_ Ecat_Name6 m31 : 64|8@1+ (1,0) [0|0] "" HETC_M_MOB
 SG_ Ecat_Name7 m31 : 72|8@1+ (1,0) [0|0] "" HETC_M_MOB
 SG_ Ecat_Name8 m31 : 80|8@1+ (1,0) [0|0] "" HETC_M_MOB
 SG_ Ecat_Name9 m31 : 88|8@1+ (1,0) [0|0] "" HETC_M_MOB
 SG_ Ecat_Name10 m31 : 96|8@1+ (1,0) [0|0] "" HETC_M_MOB
 SG_ Ecat_Name11 m31 : 104|8@1+ (1,0) [0|0] "" HETC_M_MOB
 SG_ Ecat_Name12 m31 : 112|8@1+ (1,0) [0|0] "" HETC_M_MOB
 SG_ Ecat_Name13 m31 : 120|8@1+ (1,0) [0|0] "" HETC_M_MOB
 SG_ Ecat_Name14 m31 : 128|8@1+ (1,0) [0|0] "" HETC_M_MOB
 SG_ Ecat_Name15 m31 : 136|8@1+ (1,0) [0|0] "" HETC_M_MOB
 SG_ Ecat_Link m31 : 144|8@1+ (1,0) [0|0] "" HETC_M_MOB
 SG_ Ecat_InvalidFrame0 m31 : 152|8@1+ (1,0) [0|0] "" HETC_M_MOB
 SG_ Ecat_InvalidFrame1 m31 : 160|8@1+ (1,0) [0|0] "" HETC_M_MOB
 SG_ Ecat_InvalidFrame2 m31 : 168|8@1+ (1,0) [0|0] "" HETC_M_MOB
 SG_ Ecat_InvalidFrame3 m31 : 176|8@1+ (1,0) [0|0] "" HETC_M_MOB
 SG_ Ecat_RxError0 m31 : 184|8@1+ (1,0) [0|0] "" HETC_M_MOB
 SG_ Ecat_RxError1 m31 : 192|8@1+ (1,0) [0|0] "" HETC_M_MOB
 SG_ Ecat_RxError2 m31 : 200|8@1+ (1,0) [0|0] "" HETC_M_MOB
 SG_ Ecat_RxError3 m31 : 208|8@1+ (1,0) [0|0] "" HETC_M_MOB
 SG_ Ecat_FwdRxError0 m31 : 216|8@1+ (1,0) [0|0] "" HETC_M_MOB
 SG_ Ecat_FwdRxError1 m31 : 224|8@1+ (1,0) [0|0] "" HETC_M_MOB
 SG_ Ecat_FwdRxError2 m31 : 232|8@1+ (1,0) [0|0] "" HETC_M_MOB
 SG_ Ecat_FwdRxError3 m31 : 240|8@1+ (1,0) [0|0] "" HETC_M_MOB
 SG_ Ecat_PuError m31 : 248|8@1+ (1,0) [0|0] "" HETC_M_MOB
 SG_ Ecat_PdiError m31 : 256|8@1+ (1,0) [0|0] "" HETC_M_MOB
 SG_ Ecat_LostLink0 m31 : 264|8@1+ (1,0) [0|0] "" HETC_M_MOB
 SG_ Ecat_LostLink1 m31 : 272|8@1+ (1,0) [0|0] "" HETC_M_MOB
 SG_ Ecat_LostLink2 m31 : 280|8@1+ (1,0) [0|0] "" HETC_M_MOB
 SG_ Ecat_LostLink3 m31 : 288|8@1+ (1,0) [0|0] "" HETC_M_MOB
 SG_ Saf_CanId m32 : 8|8@1+ (1,0) [0|0] "" HETC_M_MOB
 SG_ Saf_Name0 m32 : 16|8@1+ (1,0) [0|0] "" HETC_M_MOB
 SG_ Saf_Name1 m32 : 24|8@1+ (1,0) [0|0] "" HETC_M_MOB
 SG_ Saf_Name2 m32 : 32|8@1+ (1,0) [0|0] "" HETC_M_MOB
 SG_ Saf_Name3 m32 : 40|8@1+ (1,0) [0|0] "" HETC_M_MOB
 SG_ Saf_Name4 m32 : 48|8@1+ (1,0) [0|0] "" HETC_M_MOB
 SG_ Saf_Name5 m32 : 56|8@1+ (1,0) [0|0] "" HETC_M_MOB
 SG_ Saf_Name6 m32 : 64|8@1+ (1,0) [0|0] "" HETC_M_MOB
 SG_ Saf_Name7 m32 : 72|8@1+ (1,0) [0|0] "" HETC_M_MOB
 SG_ Saf_Name8 m32 : 80|8@1+ (1,0) [0|0] "" HETC_M_MOB
 SG_ Saf_Name9 m32 : 88|8@1+ (1,0) [0|0] "" HETC_M_MOB
 SG_ Saf_Name10 m32 : 96|8@1+ (1,0) [0|0] "" HETC_M_MOB
 SG_ Saf_Name11 m32 : 104|8@1+ (1,0) [0|0] "" HETC_M_MOB
 SG_ Saf_Name12 m32 : 112|8@1+ (1,0) [0|0] "" HETC_M_MOB
 SG_ Saf_Name13 m32 : 120|8@1+ (1,0) [0|0] "" HETC_M_MOB
 SG_ Saf_Name14 m32 : 128|8@1+ (1,0) [0|0] "" HETC_M_MOB
 SG_ Saf_Name15 m32 : 136|8@1+ (1,0) [0|0] "" HETC_M_MOB
 SG_ Saf_State m32 : 144|8@1+ (1,0) [0|0] "" HETC_M_MOB
 SG_ Saf_Bits m32 : 152|16@1+ (1,0) [0|0] "" HETC_M_MOB
 SG_ Saf_Estop m32 : 168|8@1+ (1,0) [0|0] "" HETC_M_MOB
 SG_ Saf_FatalLatched m32 : 176|16@1+ (1,0) [0|0] "" HETC_M_MOB
 SG_ Saf_ErrCode m32 : 192|32@1+ (1,0) [0|0] "" HETC_M_MOB

BO_ 2163329646 STATUS_HMDH_202_to_HETC_M_WST: 48 HMDH_202
 SG_ SubCode M : 0|8@1+ (1,0) [0|0] "" HETC_M_WST
 SG_ Ping_CanId m5 : 8|8@1+ (1,0) [0|0] "" HETC_M_WST
 SG_ Ping_HostId m5 : 16|8@1+ (1,0) [0|0] "" HETC_M_WST
 SG_ Ping_Pid m5 : 24|16@1+ (1,0) [0|0] "" HETC_M_WST
 SG_ Ping_Bid m5 : 40|16@1+ (1,0) [0|0] "" HETC_M_WST
 SG_ Ping_Mid m5 : 56|16@1+ (1,0) [0|0] "" HETC_M_WST
 SG_ Ping_VerMajor m5 : 72|8@1+ (1,0) [0|0] "" HETC_M_WST
 SG_ Ping_VerMinor m5 : 80|8@1+ (1,0) [0|0] "" HETC_M_WST
 SG_ Ping_VerPatch m5 : 88|8@1+ (1,0) [0|0] "" HETC_M_WST
 SG_ Ping_Name0 m5 : 96|8@1+ (1,0) [0|0] "" HETC_M_WST
 SG_ Ping_Name1 m5 : 104|8@1+ (1,0) [0|0] "" HETC_M_WST
 SG_ Ping_Name2 m5 : 112|8@1+ (1,0) [0|0] "" HETC_M_WST
 SG_ Ping_Name3 m5 : 120|8@1+ (1,0) [0|0] "" HETC_M_WST
 SG_ Ping_Name4 m5 : 128|8@1+ (1,0) [0|0] "" HETC_M_WST
 SG_ Ping_Name5 m5 : 136|8@1+ (1,0) [0|0] "" HETC_M_WST
 SG_ Ping_Name6 m5 : 144|8@1+ (1,0) [0|0] "" HETC_M_WST
 SG_ Ping_Name7 m5 : 152|8@1+ (1,0) [0|0] "" HETC_M_WST
 SG_ Ping_Name8 m5 : 160|8@1+ (1,0) [0|0] "" HETC_M_WST
 SG_ Ping_Name9 m5 : 168|8@1+ (1,0) [0|0] "" HETC_M_WST
 SG_ Ping_Name10 m5 : 176|8@1+ (1,0) [0|0] "" HETC_M_WST
 SG_ Ping_Name11 m5 : 184|8@1+ (1,0) [0|0] "" HETC_M_WST
 SG_ Ping_Name12 m5 : 192|8@1+ (1,0) [0|0] "" HETC_M_WST
 SG_ Ping_Name13 m5 : 200|8@1+ (1,0) [0|0] "" HETC_M_WST
 SG_ Ping_Name14 m5 : 208|8@1+ (1,0) [0|0] "" HETC_M_WST
 SG_ Ping_Name15 m5 : 216|8@1+ (1,0) [0|0] "" HETC_M_WST
 SG_ Ping_FmtVer m5 : 224|8@1+ (1,0) [0|0] "" HETC_M_WST
 SG_ Ping_GitRev m5 : 232|32@1+ (1,0) [0|0] "" HETC_M_WST
 SG_ Ping_FwCrc m5 : 264|16@1+ (1,0) [0|0] "" HETC_M_WST
 SG_ Ping_UptimeS m5 : 280|16@1+ (1,0) [0|0] "s" HETC_M_WST
 SG_ Ecat_CanId m31 : 8|8@1+ (1,0) [0|0] "" HETC_M_WST
 SG_ Ecat_Name0 m31 : 16|8@1+ (1,0) [0|0] "" HETC_M_WST
 SG_ Ecat_Name1 m31 : 24|8@1+ (1,0) [0|0] "" HETC_M_WST
 SG_ Ecat_Name2 m31 : 32|8@1+ (1,0) [0|0] "" HETC_M_WST
 SG_ Ecat_Name3 m31 : 40|8@1+ (1,0) [0|0] "" HETC_M_WST
 SG_ Ecat_Name4 m31 : 48|8@1+ (1,0) [0|0] "" HETC_M_WST
 SG_ Ecat_Name5 m31 : 56|8@1+ (1,0) [0|0] "" HETC_M_WST
 SG_ Ecat_Name6 m31 : 64|8@1+ (1,0) [0|0] "" HETC_M_WST
 SG_ Ecat_Name7 m31 : 72|8@1+ (1,0) [0|0] "" HETC_M_WST
 SG_ Ecat_Name8 m31 : 80|8@1+ (1,0) [0|0] "" HETC_M_WST
 SG_ Ecat_Name9 m31 : 88|8@1+ (1,0) [0|0] "" HETC_M_WST
 SG_ Ecat_Name10 m31 : 96|8@1+ (1,0) [0|0] "" HETC_M_WST
 SG_ Ecat_Name11 m31 : 104|8@1+ (1,0) [0|0] "" HETC_M_WST
 SG_ Ecat_Name12 m31 : 112|8@1+ (1,0) [0|0] "" HETC_M_WST
 SG_ Ecat_Name13 m31 : 120|8@1+ (1,0) [0|0] "" HETC_M_WST
 SG_ Ecat_Name14 m31 : 128|8@1+ (1,0) [0|0] "" HETC_M_WST
 SG_ Ecat_Name15 m31 : 136|8@1+ (1,0) [0|0] "" HETC_M_WST
 SG_ Ecat_Link m31 : 144|8@1+ (1,0) [0|0] "" HETC_M_WST
 SG_ Ecat_InvalidFrame0 m31 : 152|8@1+ (1,0) [0|0] "" HETC_M_WST
 SG_ Ecat_InvalidFrame1 m31 : 160|8@1+ (1,0) [0|0] "" HETC_M_WST
 SG_ Ecat_InvalidFrame2 m31 : 168|8@1+ (1,0) [0|0] "" HETC_M_WST
 SG_ Ecat_InvalidFrame3 m31 : 176|8@1+ (1,0) [0|0] "" HETC_M_WST
 SG_ Ecat_RxError0 m31 : 184|8@1+ (1,0) [0|0] "" HETC_M_WST
 SG_ Ecat_RxError1 m31 : 192|8@1+ (1,0) [0|0] "" HETC_M_WST
 SG_ Ecat_RxError2 m31 : 200|8@1+ (1,0) [0|0] "" HETC_M_WST
 SG_ Ecat_RxError3 m31 : 208|8@1+ (1,0) [0|0] "" HETC_M_WST
 SG_ Ecat_FwdRxError0 m31 : 216|8@1+ (1,0) [0|0] "" HETC_M_WST
 SG_ Ecat_FwdRxError1 m31 : 224|8@1+ (1,0) [0|0] "" HETC_M_WST
 SG_ Ecat_FwdRxError2 m31 : 232|8@1+ (1,0) [0|0] "" HETC_M_WST
 SG_ Ecat_FwdRxError3 m31 : 240|8@1+ (1,0) [0|0] "" HETC_M_WST
 SG_ Ecat_PuError m31 : 248|8@1+ (1,0) [0|0] "" HETC_M_WST
 SG_ Ecat_PdiError m31 : 256|8@1+ (1,0) [0|0] "" HETC_M_WST
 SG_ Ecat_LostLink0 m31 : 264|8@1+ (1,0) [0|0] "" HETC_M_WST
 SG_ Ecat_LostLink1 m31 : 272|8@1+ (1,0) [0|0] "" HETC_M_WST
 SG_ Ecat_LostLink2 m31 : 280|8@1+ (1,0) [0|0] "" HETC_M_WST
 SG_ Ecat_LostLink3 m31 : 288|8@1+ (1,0) [0|0] "" HETC_M_WST
 SG_ Saf_CanId m32 : 8|8@1+ (1,0) [0|0] "" HETC_M_WST
 SG_ Saf_Name0 m32 : 16|8@1+ (1,0) [0|0] "" HETC_M_WST
 SG_ Saf_Name1 m32 : 24|8@1+ (1,0) [0|0] "" HETC_M_WST
 SG_ Saf_Name2 m32 : 32|8@1+ (1,0) [0|0] "" HETC_M_WST
 SG_ Saf_Name3 m32 : 40|8@1+ (1,0) [0|0] "" HETC_M_WST
 SG_ Saf_Name4 m32 : 48|8@1+ (1,0) [0|0] "" HETC_M_WST
 SG_ Saf_Name5 m32 : 56|8@1+ (1,0) [0|0] "" HETC_M_WST
 SG_ Saf_Name6 m32 : 64|8@1+ (1,0) [0|0] "" HETC_M_WST
 SG_ Saf_Name7 m32 : 72|8@1+ (1,0) [0|0] "" HETC_M_WST
 SG_ Saf_Name8 m32 : 80|8@1+ (1,0) [0|0] "" HETC_M_WST
 SG_ Saf_Name9 m32 : 88|8@1+ (1,0) [0|0] "" HETC_M_WST
 SG_ Saf_Name10 m32 : 96|8@1+ (1,0) [0|0] "" HETC_M_WST
 SG_ Saf_Name11 m32 : 104|8@1+ (1,0) [0|0] "" HETC_M_WST
 SG_ Saf_Name12 m32 : 112|8@1+ (1,0) [0|0] "" HETC_M_WST
 SG_ Saf_Name13 m32 : 120|8@1+ (1,0) [0|0] "" HETC_M_WST
 SG_ Saf_Name14 m32 : 128|8@1+ (1,0) [0|0] "" HETC_M_WST
 SG_ Saf_Name15 m32 : 136|8@1+ (1,0) [0|0] "" HETC_M_WST
 SG_ Saf_State m32 : 144|8@1+ (1,0) [0|0] "" HETC_M_WST
 SG_ Saf_Bits m32 : 152|16@1+ (1,0) [0|0] "" HETC_M_WST
 SG_ Saf_Estop m32 : 168|8@1+ (1,0) [0|0] "" HETC_M_WST
 SG_ Saf_FatalLatched m32 : 176|16@1+ (1,0) [0|0] "" HETC_M_WST
 SG_ Saf_ErrCode m32 : 192|32@1+ (1,0) [0|0] "" HETC_M_WST

BO_ 2163329656 STATUS_HMDH_202_to_HETC_L_ARM: 48 HMDH_202
 SG_ SubCode M : 0|8@1+ (1,0) [0|0] "" HETC_L_ARM
 SG_ Ping_CanId m5 : 8|8@1+ (1,0) [0|0] "" HETC_L_ARM
 SG_ Ping_HostId m5 : 16|8@1+ (1,0) [0|0] "" HETC_L_ARM
 SG_ Ping_Pid m5 : 24|16@1+ (1,0) [0|0] "" HETC_L_ARM
 SG_ Ping_Bid m5 : 40|16@1+ (1,0) [0|0] "" HETC_L_ARM
 SG_ Ping_Mid m5 : 56|16@1+ (1,0) [0|0] "" HETC_L_ARM
 SG_ Ping_VerMajor m5 : 72|8@1+ (1,0) [0|0] "" HETC_L_ARM
 SG_ Ping_VerMinor m5 : 80|8@1+ (1,0) [0|0] "" HETC_L_ARM
 SG_ Ping_VerPatch m5 : 88|8@1+ (1,0) [0|0] "" HETC_L_ARM
 SG_ Ping_Name0 m5 : 96|8@1+ (1,0) [0|0] "" HETC_L_ARM
 SG_ Ping_Name1 m5 : 104|8@1+ (1,0) [0|0] "" HETC_L_ARM
 SG_ Ping_Name2 m5 : 112|8@1+ (1,0) [0|0] "" HETC_L_ARM
 SG_ Ping_Name3 m5 : 120|8@1+ (1,0) [0|0] "" HETC_L_ARM
 SG_ Ping_Name4 m5 : 128|8@1+ (1,0) [0|0] "" HETC_L_ARM
 SG_ Ping_Name5 m5 : 136|8@1+ (1,0) [0|0] "" HETC_L_ARM
 SG_ Ping_Name6 m5 : 144|8@1+ (1,0) [0|0] "" HETC_L_ARM
 SG_ Ping_Name7 m5 : 152|8@1+ (1,0) [0|0] "" HETC_L_ARM
 SG_ Ping_Name8 m5 : 160|8@1+ (1,0) [0|0] "" HETC_L_ARM
 SG_ Ping_Name9 m5 : 168|8@1+ (1,0) [0|0] "" HETC_L_ARM
 SG_ Ping_Name10 m5 : 176|8@1+ (1,0) [0|0] "" HETC_L_ARM
 SG_ Ping_Name11 m5 : 184|8@1+ (1,0) [0|0] "" HETC_L_ARM
 SG_ Ping_Name12 m5 : 192|8@1+ (1,0) [0|0] "" HETC_L_ARM
 SG_ Ping_Name13 m5 : 200|8@1+ (1,0) [0|0] "" HETC_L_ARM
 SG_ Ping_Name14 m5 : 208|8@1+ (1,0) [0|0] "" HETC_L_ARM
 SG_ Ping_Name15 m5 : 216|8@1+ (1,0) [0|0] "" HETC_L_ARM
 SG_ Ping_FmtVer m5 : 224|8@1+ (1,0) [0|0] "" HETC_L_ARM
 SG_ Ping_GitRev m5 : 232|32@1+ (1,0) [0|0] "" HETC_L_ARM
 SG_ Ping_FwCrc m5 : 264|16@1+ (1,0) [0|0] "" HETC_L_ARM
 SG_ Ping_UptimeS m5 : 280|16@1+ (1,0) [0|0] "s" HETC_L_ARM
 SG_ Ecat_CanId m31 : 8|8@1+ (1,0) [0|0] "" HETC_L_ARM
 SG_ Ecat_Name0 m31 : 16|8@1+ (1,0) [0|0] "" HETC_L_ARM
 SG_ Ecat_Name1 m31 : 24|8@1+ (1,0) [0|0] "" HETC_L_ARM
 SG_ Ecat_Name2 m31 : 32|8@1+ (1,0) [0|0] "" HETC_L_ARM
 SG_ Ecat_Name3 m31 : 40|8@1+ (1,0) [0|0] "" HETC_L_ARM
 SG_ Ecat_Name4 m31 : 48|8@1+ (1,0) [0|0] "" HETC_L_ARM
 SG_ Ecat_Name5 m31 : 56|8@1+ (1,0) [0|0] "" HETC_L_ARM
 SG_ Ecat_Name6 m31 : 64|8@1+ (1,0) [0|0] "" HETC_L_ARM
 SG_ Ecat_Name7 m31 : 72|8@1+ (1,0) [0|0] "" HETC_L_ARM
 SG_ Ecat_Name8 m31 : 80|8@1+ (1,0) [0|0] "" HETC_L_ARM
 SG_ Ecat_Name9 m31 : 88|8@1+ (1,0) [0|0] "" HETC_L_ARM
 SG_ Ecat_Name10 m31 : 96|8@1+ (1,0) [0|0] "" HETC_L_ARM
 SG_ Ecat_Name11 m31 : 104|8@1+ (1,0) [0|0] "" HETC_L_ARM
 SG_ Ecat_Name12 m31 : 112|8@1+ (1,0) [0|0] "" HETC_L_ARM
 SG_ Ecat_Name13 m31 : 120|8@1+ (1,0) [0|0] "" HETC_L_ARM
 SG_ Ecat_Name14 m31 : 128|8@1+ (1,0) [0|0] "" HETC_L_ARM
 SG_ Ecat_Name15 m31 : 136|8@1+ (1,0) [0|0] "" HETC_L_ARM
 SG_ Ecat_Link m31 : 144|8@1+ (1,0) [0|0] "" HETC_L_ARM
 SG_ Ecat_InvalidFrame0 m31 : 152|8@1+ (1,0) [0|0] "" HETC_L_ARM
 SG_ Ecat_InvalidFrame1 m31 : 160|8@1+ (1,0) [0|0] "" HETC_L_ARM
 SG_ Ecat_InvalidFrame2 m31 : 168|8@1+ (1,0) [0|0] "" HETC_L_ARM
 SG_ Ecat_InvalidFrame3 m31 : 176|8@1+ (1,0) [0|0] "" HETC_L_ARM
 SG_ Ecat_RxError0 m31 : 184|8@1+ (1,0) [0|0] "" HETC_L_ARM
 SG_ Ecat_RxError1 m31 : 192|8@1+ (1,0) [0|0] "" HETC_L_ARM
 SG_ Ecat_RxError2 m31 : 200|8@1+ (1,0) [0|0] "" HETC_L_ARM
 SG_ Ecat_RxError3 m31 : 208|8@1+ (1,0) [0|0] "" HETC_L_ARM
 SG_ Ecat_FwdRxError0 m31 : 216|8@1+ (1,0) [0|0] "" HETC_L_ARM
 SG_ Ecat_FwdRxError1 m31 : 224|8@1+ (1,0) [0|0] "" HETC_L_ARM
 SG_ Ecat_FwdRxError2 m31 : 232|8@1+ (1,0) [0|0] "" HETC_L_ARM
 SG_ Ecat_FwdRxError3 m31 : 240|8@1+ (1,0) [0|0] "" HETC_L_ARM
 SG_ Ecat_PuError m31 : 248|8@1+ (1,0) [0|0] "" HETC_L_ARM
 SG_ Ecat_PdiError m31 : 256|8@1+ (1,0) [0|0] "" HETC_L_ARM
 SG_ Ecat_LostLink0 m31 : 264|8@1+ (1,0) [0|0] "" HETC_L_ARM
 SG_ Ecat_LostLink1 m31 : 272|8@1+ (1,0) [0|0] "" HETC_L_ARM
 SG_ Ecat_LostLink2 m31 : 280|8@1+ (1,0) [0|0] "" HETC_L_ARM
 SG_ Ecat_LostLink3 m31 : 288|8@1+ (1,0) [0|0] "" HETC_L_ARM
 SG_ Saf_CanId m32 : 8|8@1+ (1,0) [0|0] "" HETC_L_ARM
 SG_ Saf_Name0 m32 : 16|8@1+ (1,0) [0|0] "" HETC_L_ARM
 SG_ Saf_Name1 m32 : 24|8@1+ (1,0) [0|0] "" HETC_L_ARM
 SG_ Saf_Name2 m32 : 32|8@1+ (1,0) [0|0] "" HETC_L_ARM
 SG_ Saf_Name3 m32 : 40|8@1+ (1,0) [0|0] "" HETC_L_ARM
 SG_ Saf_Name4 m32 : 48|8@1+ (1,0) [0|0] "" HETC_L_ARM
 SG_ Saf_Name5 m32 : 56|8@1+ (1,0) [0|0] "" HETC_L_ARM
 SG_ Saf_Name6 m32 : 64|8@1+ (1,0) [0|0] "" HETC_L_ARM
 SG_ Saf_Name7 m32 : 72|8@1+ (1,0) [0|0] "" HETC_L_ARM
 SG_ Saf_Name8 m32 : 80|8@1+ (1,0) [0|0] "" HETC_L_ARM
 SG_ Saf_Name9 m32 : 88|8@1+ (1,0) [0|0] "" HETC_L_ARM
 SG_ Saf_Name10 m32 : 96|8@1+ (1,0) [0|0] "" HETC_L_ARM
 SG_ Saf_Name11 m32 : 104|8@1+ (1,0) [0|0] "" HETC_L_ARM
 SG_ Saf_Name12 m32 : 112|8@1+ (1,0) [0|0] "" HETC_L_ARM
 SG_ Saf_Name13 m32 : 120|8@1+ (1,0) [0|0] "" HETC_L_ARM
 SG_ Saf_Name14 m32 : 128|8@1+ (1,0) [0|0] "" HETC_L_ARM
 SG_ Saf_Name15 m32 : 136|8@1+ (1,0) [0|0] "" HETC_L_ARM
 SG_ Saf_State m32 : 144|8@1+ (1,0) [0|0] "" HETC_L_ARM
 SG_ Saf_Bits m32 : 152|16@1+ (1,0) [0|0] "" HETC_L_ARM
 SG_ Saf_Estop m32 : 168|8@1+ (1,0) [0|0] "" HETC_L_ARM
 SG_ Saf_FatalLatched m32 : 176|16@1+ (1,0) [0|0] "" HETC_L_ARM
 SG_ Saf_ErrCode m32 : 192|32@1+ (1,0) [0|0] "" HETC_L_ARM

BO_ 2163329666 STATUS_HMDH_202_to_HETC_L_TACT: 48 HMDH_202
 SG_ SubCode M : 0|8@1+ (1,0) [0|0] "" HETC_L_TACT
 SG_ Ping_CanId m5 : 8|8@1+ (1,0) [0|0] "" HETC_L_TACT
 SG_ Ping_HostId m5 : 16|8@1+ (1,0) [0|0] "" HETC_L_TACT
 SG_ Ping_Pid m5 : 24|16@1+ (1,0) [0|0] "" HETC_L_TACT
 SG_ Ping_Bid m5 : 40|16@1+ (1,0) [0|0] "" HETC_L_TACT
 SG_ Ping_Mid m5 : 56|16@1+ (1,0) [0|0] "" HETC_L_TACT
 SG_ Ping_VerMajor m5 : 72|8@1+ (1,0) [0|0] "" HETC_L_TACT
 SG_ Ping_VerMinor m5 : 80|8@1+ (1,0) [0|0] "" HETC_L_TACT
 SG_ Ping_VerPatch m5 : 88|8@1+ (1,0) [0|0] "" HETC_L_TACT
 SG_ Ping_Name0 m5 : 96|8@1+ (1,0) [0|0] "" HETC_L_TACT
 SG_ Ping_Name1 m5 : 104|8@1+ (1,0) [0|0] "" HETC_L_TACT
 SG_ Ping_Name2 m5 : 112|8@1+ (1,0) [0|0] "" HETC_L_TACT
 SG_ Ping_Name3 m5 : 120|8@1+ (1,0) [0|0] "" HETC_L_TACT
 SG_ Ping_Name4 m5 : 128|8@1+ (1,0) [0|0] "" HETC_L_TACT
 SG_ Ping_Name5 m5 : 136|8@1+ (1,0) [0|0] "" HETC_L_TACT
 SG_ Ping_Name6 m5 : 144|8@1+ (1,0) [0|0] "" HETC_L_TACT
 SG_ Ping_Name7 m5 : 152|8@1+ (1,0) [0|0] "" HETC_L_TACT
 SG_ Ping_Name8 m5 : 160|8@1+ (1,0) [0|0] "" HETC_L_TACT
 SG_ Ping_Name9 m5 : 168|8@1+ (1,0) [0|0] "" HETC_L_TACT
 SG_ Ping_Name10 m5 : 176|8@1+ (1,0) [0|0] "" HETC_L_TACT
 SG_ Ping_Name11 m5 : 184|8@1+ (1,0) [0|0] "" HETC_L_TACT
 SG_ Ping_Name12 m5 : 192|8@1+ (1,0) [0|0] "" HETC_L_TACT
 SG_ Ping_Name13 m5 : 200|8@1+ (1,0) [0|0] "" HETC_L_TACT
 SG_ Ping_Name14 m5 : 208|8@1+ (1,0) [0|0] "" HETC_L_TACT
 SG_ Ping_Name15 m5 : 216|8@1+ (1,0) [0|0] "" HETC_L_TACT
 SG_ Ping_FmtVer m5 : 224|8@1+ (1,0) [0|0] "" HETC_L_TACT
 SG_ Ping_GitRev m5 : 232|32@1+ (1,0) [0|0] "" HETC_L_TACT
 SG_ Ping_FwCrc m5 : 264|16@1+ (1,0) [0|0] "" HETC_L_TACT
 SG_ Ping_UptimeS m5 : 280|16@1+ (1,0) [0|0] "s" HETC_L_TACT
 SG_ Ecat_CanId m31 : 8|8@1+ (1,0) [0|0] "" HETC_L_TACT
 SG_ Ecat_Name0 m31 : 16|8@1+ (1,0) [0|0] "" HETC_L_TACT
 SG_ Ecat_Name1 m31 : 24|8@1+ (1,0) [0|0] "" HETC_L_TACT
 SG_ Ecat_Name2 m31 : 32|8@1+ (1,0) [0|0] "" HETC_L_TACT
 SG_ Ecat_Name3 m31 : 40|8@1+ (1,0) [0|0] "" HETC_L_TACT
 SG_ Ecat_Name4 m31 : 48|8@1+ (1,0) [0|0] "" HETC_L_TACT
 SG_ Ecat_Name5 m31 : 56|8@1+ (1,0) [0|0] "" HETC_L_TACT
 SG_ Ecat_Name6 m31 : 64|8@1+ (1,0) [0|0] "" HETC_L_TACT
 SG_ Ecat_Name7 m31 : 72|8@1+ (1,0) [0|0] "" HETC_L_TACT
 SG_ Ecat_Name8 m31 : 80|8@1+ (1,0) [0|0] "" HETC_L_TACT
 SG_ Ecat_Name9 m31 : 88|8@1+ (1,0) [0|0] "" HETC_L_TACT
 SG_ Ecat_Name10 m31 : 96|8@1+ (1,0) [0|0] "" HETC_L_TACT
 SG_ Ecat_Name11 m31 : 104|8@1+ (1,0) [0|0] "" HETC_L_TACT
 SG_ Ecat_Name12 m31 : 112|8@1+ (1,0) [0|0] "" HETC_L_TACT
 SG_ Ecat_Name13 m31 : 120|8@1+ (1,0) [0|0] "" HETC_L_TACT
 SG_ Ecat_Name14 m31 : 128|8@1+ (1,0) [0|0] "" HETC_L_TACT
 SG_ Ecat_Name15 m31 : 136|8@1+ (1,0) [0|0] "" HETC_L_TACT
 SG_ Ecat_Link m31 : 144|8@1+ (1,0) [0|0] "" HETC_L_TACT
 SG_ Ecat_InvalidFrame0 m31 : 152|8@1+ (1,0) [0|0] "" HETC_L_TACT
 SG_ Ecat_InvalidFrame1 m31 : 160|8@1+ (1,0) [0|0] "" HETC_L_TACT
 SG_ Ecat_InvalidFrame2 m31 : 168|8@1+ (1,0) [0|0] "" HETC_L_TACT
 SG_ Ecat_InvalidFrame3 m31 : 176|8@1+ (1,0) [0|0] "" HETC_L_TACT
 SG_ Ecat_RxError0 m31 : 184|8@1+ (1,0) [0|0] "" HETC_L_TACT
 SG_ Ecat_RxError1 m31 : 192|8@1+ (1,0) [0|0] "" HETC_L_TACT
 SG_ Ecat_RxError2 m31 : 200|8@1+ (1,0) [0|0] "" HETC_L_TACT
 SG_ Ecat_RxError3 m31 : 208|8@1+ (1,0) [0|0] "" HETC_L_TACT
 SG_ Ecat_FwdRxError0 m31 : 216|8@1+ (1,0) [0|0] "" HETC_L_TACT
 SG_ Ecat_FwdRxError1 m31 : 224|8@1+ (1,0) [0|0] "" HETC_L_TACT
 SG_ Ecat_FwdRxError2 m31 : 232|8@1+ (1,0) [0|0] "" HETC_L_TACT
 SG_ Ecat_FwdRxError3 m31 : 240|8@1+ (1,0) [0|0] "" HETC_L_TACT
 SG_ Ecat_PuError m31 : 248|8@1+ (1,0) [0|0] "" HETC_L_TACT
 SG_ Ecat_PdiError m31 : 256|8@1+ (1,0) [0|0] "" HETC_L_TACT
 SG_ Ecat_LostLink0 m31 : 264|8@1+ (1,0) [0|0] "" HETC_L_TACT
 SG_ Ecat_LostLink1 m31 : 272|8@1+ (1,0) [0|0] "" HETC_L_TACT
 SG_ Ecat_LostLink2 m31 : 280|8@1+ (1,0) [0|0] "" HETC_L_TACT
 SG_ Ecat_LostLink3 m31 : 288|8@1+ (1,0) [0|0] "" HETC_L_TACT
 SG_ Saf_CanId m32 : 8|8@1+ (1,0) [0|0] "" HETC_L_TACT
 SG_ Saf_Name0 m32 : 16|8@1+ (1,0) [0|0] "" HETC_L_TACT
 SG_ Saf_Name1 m32 : 24|8@1+ (1,0) [0|0] "" HETC_L_TACT
 SG_ Saf_Name2 m32 : 32|8@1+ (1,0) [0|0] "" HETC_L_TACT
 SG_ Saf_Name3 m32 : 40|8@1+ (1,0) [0|0] "" HETC_L_TACT
 SG_ Saf_Name4 m32 : 48|8@1+ (1,0) [0|0] "" HETC_L_TACT
 SG_ Saf_Name5 m32 : 56|8@1+ (1,0) [0|0] "" HETC_L_TACT
 SG_ Saf_Name6 m32 : 64|8@1+ (1,0) [0|0] "" HETC_L_TACT
 SG_ Saf_Name7 m32 : 72|8@1+ (1,0) [0|0] "" HETC_L_TACT
 SG_ Saf_Name8 m32 : 80|8@1+ (1,0) [0|0] "" HETC_L_TACT
 SG_ Saf_Name9 m32 : 88|8@1+ (1,0) [0|0] "" HETC_L_TACT
 SG_ Saf_Name10 m32 : 96|8@1+ (1,0) [0|0] "" HETC_L_TACT
 SG_ Saf_Name11 m32 : 104|8@1+ (1,0) [0|0] "" HETC_L_TACT
 SG_ Saf_Name12 m32 : 112|8@1+ (1,0) [0|0] "" HETC_L_TACT
 SG_ Saf_Name13 m32 : 120|8@1+ (1,0) [0|0] "" HETC_L_TACT
 SG_ Saf_Name14 m32 : 128|8@1+ (1,0) [0|0] "" HETC_L_TACT
 SG_ Saf_Name15 m32 : 136|8@1+ (1,0) [0|0] "" HETC_L_TACT
 SG_ Saf_State m32 : 144|8@1+ (1,0) [0|0] "" HETC_L_TACT
 SG_ Saf_Bits m32 : 152|16@1+ (1,0) [0|0] "" HETC_L_TACT
 SG_ Saf_Estop m32 : 168|8@1+ (1,0) [0|0] "" HETC_L_TACT
 SG_ Saf_FatalLatched m32 : 176|16@1+ (1,0) [0|0] "" HETC_L_TACT
 SG_ Saf_ErrCode m32 : 192|32@1+ (1,0) [0|0] "" HETC_L_TACT

BO_ 2163329676 STATUS_HMDH_202_to_HETC_R_ARM: 48 HMDH_202
 SG_ SubCode M : 0|8@1+ (1,0) [0|0] "" HETC_R_ARM
 SG_ Ping_CanId m5 : 8|8@1+ (1,0) [0|0] "" HETC_R_ARM
 SG_ Ping_HostId m5 : 16|8@1+ (1,0) [0|0] "" HETC_R_ARM
 SG_ Ping_Pid m5 : 24|16@1+ (1,0) [0|0] "" HETC_R_ARM
 SG_ Ping_Bid m5 : 40|16@1+ (1,0) [0|0] "" HETC_R_ARM
 SG_ Ping_Mid m5 : 56|16@1+ (1,0) [0|0] "" HETC_R_ARM
 SG_ Ping_VerMajor m5 : 72|8@1+ (1,0) [0|0] "" HETC_R_ARM
 SG_ Ping_VerMinor m5 : 80|8@1+ (1,0) [0|0] "" HETC_R_ARM
 SG_ Ping_VerPatch m5 : 88|8@1+ (1,0) [0|0] "" HETC_R_ARM
 SG_ Ping_Name0 m5 : 96|8@1+ (1,0) [0|0] "" HETC_R_ARM
 SG_ Ping_Name1 m5 : 104|8@1+ (1,0) [0|0] "" HETC_R_ARM
 SG_ Ping_Name2 m5 : 112|8@1+ (1,0) [0|0] "" HETC_R_ARM
 SG_ Ping_Name3 m5 : 120|8@1+ (1,0) [0|0] "" HETC_R_ARM
 SG_ Ping_Name4 m5 : 128|8@1+ (1,0) [0|0] "" HETC_R_ARM
 SG_ Ping_Name5 m5 : 136|8@1+ (1,0) [0|0] "" HETC_R_ARM
 SG_ Ping_Name6 m5 : 144|8@1+ (1,0) [0|0] "" HETC_R_ARM
 SG_ Ping_Name7 m5 : 152|8@1+ (1,0) [0|0] "" HETC_R_ARM
 SG_ Ping_Name8 m5 : 160|8@1+ (1,0) [0|0] "" HETC_R_ARM
 SG_ Ping_Name9 m5 : 168|8@1+ (1,0) [0|0] "" HETC_R_ARM
 SG_ Ping_Name10 m5 : 176|8@1+ (1,0) [0|0] "" HETC_R_ARM
 SG_ Ping_Name11 m5 : 184|8@1+ (1,0) [0|0] "" HETC_R_ARM
 SG_ Ping_Name12 m5 : 192|8@1+ (1,0) [0|0] "" HETC_R_ARM
 SG_ Ping_Name13 m5 : 200|8@1+ (1,0) [0|0] "" HETC_R_ARM
 SG_ Ping_Name14 m5 : 208|8@1+ (1,0) [0|0] "" HETC_R_ARM
 SG_ Ping_Name15 m5 : 216|8@1+ (1,0) [0|0] "" HETC_R_ARM
 SG_ Ping_FmtVer m5 : 224|8@1+ (1,0) [0|0] "" HETC_R_ARM
 SG_ Ping_GitRev m5 : 232|32@1+ (1,0) [0|0] "" HETC_R_ARM
 SG_ Ping_FwCrc m5 : 264|16@1+ (1,0) [0|0] "" HETC_R_ARM
 SG_ Ping_UptimeS m5 : 280|16@1+ (1,0) [0|0] "s" HETC_R_ARM
 SG_ Ecat_CanId m31 : 8|8@1+ (1,0) [0|0] "" HETC_R_ARM
 SG_ Ecat_Name0 m31 : 16|8@1+ (1,0) [0|0] "" HETC_R_ARM
 SG_ Ecat_Name1 m31 : 24|8@1+ (1,0) [0|0] "" HETC_R_ARM
 SG_ Ecat_Name2 m31 : 32|8@1+ (1,0) [0|0] "" HETC_R_ARM
 SG_ Ecat_Name3 m31 : 40|8@1+ (1,0) [0|0] "" HETC_R_ARM
 SG_ Ecat_Name4 m31 : 48|8@1+ (1,0) [0|0] "" HETC_R_ARM
 SG_ Ecat_Name5 m31 : 56|8@1+ (1,0) [0|0] "" HETC_R_ARM
 SG_ Ecat_Name6 m31 : 64|8@1+ (1,0) [0|0] "" HETC_R_ARM
 SG_ Ecat_Name7 m31 : 72|8@1+ (1,0) [0|0] "" HETC_R_ARM
 SG_ Ecat_Name8 m31 : 80|8@1+ (1,0) [0|0] "" HETC_R_ARM
 SG_ Ecat_Name9 m31 : 88|8@1+ (1,0) [0|0] "" HETC_R_ARM
 SG_ Ecat_Name10 m31 : 96|8@1+ (1,0) [0|0] "" HETC_R_ARM
 SG_ Ecat_Name11 m31 : 104|8@1+ (1,0) [0|0] "" HETC_R_ARM
 SG_ Ecat_Name12 m31 : 112|8@1+ (1,0) [0|0] "" HETC_R_ARM
 SG_ Ecat_Name13 m31 : 120|8@1+ (1,0) [0|0] "" HETC_R_ARM
 SG_ Ecat_Name14 m31 : 128|8@1+ (1,0) [0|0] "" HETC_R_ARM
 SG_ Ecat_Name15 m31 : 136|8@1+ (1,0) [0|0] "" HETC_R_ARM
 SG_ Ecat_Link m31 : 144|8@1+ (1,0) [0|0] "" HETC_R_ARM
 SG_ Ecat_InvalidFrame0 m31 : 152|8@1+ (1,0) [0|0] "" HETC_R_ARM
 SG_ Ecat_InvalidFrame1 m31 : 160|8@1+ (1,0) [0|0] "" HETC_R_ARM
 SG_ Ecat_InvalidFrame2 m31 : 168|8@1+ (1,0) [0|0] "" HETC_R_ARM
 SG_ Ecat_InvalidFrame3 m31 : 176|8@1+ (1,0) [0|0] "" HETC_R_ARM
 SG_ Ecat_RxError0 m31 : 184|8@1+ (1,0) [0|0] "" HETC_R_ARM
 SG_ Ecat_RxError1 m31 : 192|8@1+ (1,0) [0|0] "" HETC_R_ARM
 SG_ Ecat_RxError2 m31 : 200|8@1+ (1,0) [0|0] "" HETC_R_ARM
 SG_ Ecat_RxError3 m31 : 208|8@1+ (1,0) [0|0] "" HETC_R_ARM
 SG_ Ecat_FwdRxError0 m31 : 216|8@1+ (1,0) [0|0] "" HETC_R_ARM
 SG_ Ecat_FwdRxError1 m31 : 224|8@1+ (1,0) [0|0] "" HETC_R_ARM
 SG_ Ecat_FwdRxError2 m31 : 232|8@1+ (1,0) [0|0] "" HETC_R_ARM
 SG_ Ecat_FwdRxError3 m31 : 240|8@1+ (1,0) [0|0] "" HETC_R_ARM
 SG_ Ecat_PuError m31 : 248|8@1+ (1,0) [0|0] "" HETC_R_ARM
 SG_ Ecat_PdiError m31 : 256|8@1+ (1,0) [0|0] "" HETC_R_ARM
 SG_ Ecat_LostLink0 m31 : 264|8@1+ (1,0) [0|0] "" HETC_R_ARM
 SG_ Ecat_LostLink1 m31 : 272|8@1+ (1,0) [0|0] "" HETC_R_ARM
 SG_ Ecat_LostLink2 m31 : 280|8@1+ (1,0) [0|0] "" HETC_R_ARM
 SG_ Ecat_LostLink3 m31 : 288|8@1+ (1,0) [0|0] "" HETC_R_ARM
 SG_ Saf_CanId m32 : 8|8@1+ (1,0) [0|0] "" HETC_R_ARM
 SG_ Saf_Name0 m32 : 16|8@1+ (1,0) [0|0] "" HETC_R_ARM
 SG_ Saf_Name1 m32 : 24|8@1+ (1,0) [0|0] "" HETC_R_ARM
 SG_ Saf_Name2 m32 : 32|8@1+ (1,0) [0|0] "" HETC_R_ARM
 SG_ Saf_Name3 m32 : 40|8@1+ (1,0) [0|0] "" HETC_R_ARM
 SG_ Saf_Name4 m32 : 48|8@1+ (1,0) [0|0] "" HETC_R_ARM
 SG_ Saf_Name5 m32 : 56|8@1+ (1,0) [0|0] "" HETC_R_ARM
 SG_ Saf_Name6 m32 : 64|8@1+ (1,0) [0|0] "" HETC_R_ARM
 SG_ Saf_Name7 m32 : 72|8@1+ (1,0) [0|0] "" HETC_R_ARM
 SG_ Saf_Name8 m32 : 80|8@1+ (1,0) [0|0] "" HETC_R_ARM
 SG_ Saf_Name9 m32 : 88|8@1+ (1,0) [0|0] "" HETC_R_ARM
 SG_ Saf_Name10 m32 : 96|8@1+ (1,0) [0|0] "" HETC_R_ARM
 SG_ Saf_Name11 m32 : 104|8@1+ (1,0) [0|0] "" HETC_R_ARM
 SG_ Saf_Name12 m32 : 112|8@1+ (1,0) [0|0] "" HETC_R_ARM
 SG_ Saf_Name13 m32 : 120|8@1+ (1,0) [0|0] "" HETC_R_ARM
 SG_ Saf_Name14 m32 : 128|8@1+ (1,0) [0|0] "" HETC_R_ARM
 SG_ Saf_Name15 m32 : 136|8@1+ (1,0) [0|0] "" HETC_R_ARM
 SG_ Saf_State m32 : 144|8@1+ (1,0) [0|0] "" HETC_R_ARM
 SG_ Saf_Bits m32 : 152|16@1+ (1,0) [0|0] "" HETC_R_ARM
 SG_ Saf_Estop m32 : 168|8@1+ (1,0) [0|0] "" HETC_R_ARM
 SG_ Saf_FatalLatched m32 : 176|16@1+ (1,0) [0|0] "" HETC_R_ARM
 SG_ Saf_ErrCode m32 : 192|32@1+ (1,0) [0|0] "" HETC_R_ARM

BO_ 2163329686 STATUS_HMDH_202_to_HETC_R_TACT: 48 HMDH_202
 SG_ SubCode M : 0|8@1+ (1,0) [0|0] "" HETC_R_TACT
 SG_ Ping_CanId m5 : 8|8@1+ (1,0) [0|0] "" HETC_R_TACT
 SG_ Ping_HostId m5 : 16|8@1+ (1,0) [0|0] "" HETC_R_TACT
 SG_ Ping_Pid m5 : 24|16@1+ (1,0) [0|0] "" HETC_R_TACT
 SG_ Ping_Bid m5 : 40|16@1+ (1,0) [0|0] "" HETC_R_TACT
 SG_ Ping_Mid m5 : 56|16@1+ (1,0) [0|0] "" HETC_R_TACT
 SG_ Ping_VerMajor m5 : 72|8@1+ (1,0) [0|0] "" HETC_R_TACT
 SG_ Ping_VerMinor m5 : 80|8@1+ (1,0) [0|0] "" HETC_R_TACT
 SG_ Ping_VerPatch m5 : 88|8@1+ (1,0) [0|0] "" HETC_R_TACT
 SG_ Ping_Name0 m5 : 96|8@1+ (1,0) [0|0] "" HETC_R_TACT
 SG_ Ping_Name1 m5 : 104|8@1+ (1,0) [0|0] "" HETC_R_TACT
 SG_ Ping_Name2 m5 : 112|8@1+ (1,0) [0|0] "" HETC_R_TACT
 SG_ Ping_Name3 m5 : 120|8@1+ (1,0) [0|0] "" HETC_R_TACT
 SG_ Ping_Name4 m5 : 128|8@1+ (1,0) [0|0] "" HETC_R_TACT
 SG_ Ping_Name5 m5 : 136|8@1+ (1,0) [0|0] "" HETC_R_TACT
 SG_ Ping_Name6 m5 : 144|8@1+ (1,0) [0|0] "" HETC_R_TACT
 SG_ Ping_Name7 m5 : 152|8@1+ (1,0) [0|0] "" HETC_R_TACT
 SG_ Ping_Name8 m5 : 160|8@1+ (1,0) [0|0] "" HETC_R_TACT
 SG_ Ping_Name9 m5 : 168|8@1+ (1,0) [0|0] "" HETC_R_TACT
 SG_ Ping_Name10 m5 : 176|8@1+ (1,0) [0|0] "" HETC_R_TACT
 SG_ Ping_Name11 m5 : 184|8@1+ (1,0) [0|0] "" HETC_R_TACT
 SG_ Ping_Name12 m5 : 192|8@1+ (1,0) [0|0] "" HETC_R_TACT
 SG_ Ping_Name13 m5 : 200|8@1+ (1,0) [0|0] "" HETC_R_TACT
 SG_ Ping_Name14 m5 : 208|8@1+ (1,0) [0|0] "" HETC_R_TACT
 SG_ Ping_Name15 m5 : 216|8@1+ (1,0) [0|0] "" HETC_R_TACT
 SG_ Ping_FmtVer m5 : 224|8@1+ (1,0) [0|0] "" HETC_R_TACT
 SG_ Ping_GitRev m5 : 232|32@1+ (1,0) [0|0] "" HETC_R_TACT
 SG_ Ping_FwCrc m5 : 264|16@1+ (1,0) [0|0] "" HETC_R_TACT
 SG_ Ping_UptimeS m5 : 280|16@1+ (1,0) [0|0] "s" HETC_R_TACT
 SG_ Ecat_CanId m31 : 8|8@1+ (1,0) [0|0] "" HETC_R_TACT
 SG_ Ecat_Name0 m31 : 16|8@1+ (1,0) [0|0] "" HETC_R_TACT
 SG_ Ecat_Name1 m31 : 24|8@1+ (1,0) [0|0] "" HETC_R_TACT
 SG_ Ecat_Name2 m31 : 32|8@1+ (1,0) [0|0] "" HETC_R_TACT
 SG_ Ecat_Name3 m31 : 40|8@1+ (1,0) [0|0] "" HETC_R_TACT
 SG_ Ecat_Name4 m31 : 48|8@1+ (1,0) [0|0] "" HETC_R_TACT
 SG_ Ecat_Name5 m31 : 56|8@1+ (1,0) [0|0] "" HETC_R_TACT
 SG_ Ecat_Name6 m31 : 64|8@1+ (1,0) [0|0] "" HETC_R_TACT
 SG_ Ecat_Name7 m31 : 72|8@1+ (1,0) [0|0] "" HETC_R_TACT
 SG_ Ecat_Name8 m31 : 80|8@1+ (1,0) [0|0] "" HETC_R_TACT
 SG_ Ecat_Name9 m31 : 88|8@1+ (1,0) [0|0] "" HETC_R_TACT
 SG_ Ecat_Name10 m31 : 96|8@1+ (1,0) [0|0] "" HETC_R_TACT
 SG_ Ecat_Name11 m31 : 104|8@1+ (1,0) [0|0] "" HETC_R_TACT
 SG_ Ecat_Name12 m31 : 112|8@1+ (1,0) [0|0] "" HETC_R_TACT
 SG_ Ecat_Name13 m31 : 120|8@1+ (1,0) [0|0] "" HETC_R_TACT
 SG_ Ecat_Name14 m31 : 128|8@1+ (1,0) [0|0] "" HETC_R_TACT
 SG_ Ecat_Name15 m31 : 136|8@1+ (1,0) [0|0] "" HETC_R_TACT
 SG_ Ecat_Link m31 : 144|8@1+ (1,0) [0|0] "" HETC_R_TACT
 SG_ Ecat_InvalidFrame0 m31 : 152|8@1+ (1,0) [0|0] "" HETC_R_TACT
 SG_ Ecat_InvalidFrame1 m31 : 160|8@1+ (1,0) [0|0] "" HETC_R_TACT
 SG_ Ecat_InvalidFrame2 m31 : 168|8@1+ (1,0) [0|0] "" HETC_R_TACT
 SG_ Ecat_InvalidFrame3 m31 : 176|8@1+ (1,0) [0|0] "" HETC_R_TACT
 SG_ Ecat_RxError0 m31 : 184|8@1+ (1,0) [0|0] "" HETC_R_TACT
 SG_ Ecat_RxError1 m31 : 192|8@1+ (1,0) [0|0] "" HETC_R_TACT
 SG_ Ecat_RxError2 m31 : 200|8@1+ (1,0) [0|0] "" HETC_R_TACT
 SG_ Ecat_RxError3 m31 : 208|8@1+ (1,0) [0|0] "" HETC_R_TACT
 SG_ Ecat_FwdRxError0 m31 : 216|8@1+ (1,0) [0|0] "" HETC_R_TACT
 SG_ Ecat_FwdRxError1 m31 : 224|8@1+ (1,0) [0|0] "" HETC_R_TACT
 SG_ Ecat_FwdRxError2 m31 : 232|8@1+ (1,0) [0|0] "" HETC_R_TACT
 SG_ Ecat_FwdRxError3 m31 : 240|8@1+ (1,0) [0|0] "" HETC_R_TACT
 SG_ Ecat_PuError m31 : 248|8@1+ (1,0) [0|0] "" HETC_R_TACT
 SG_ Ecat_PdiError m31 : 256|8@1+ (1,0) [0|0] "" HETC_R_TACT
 SG_ Ecat_LostLink0 m31 : 264|8@1+ (1,0) [0|0] "" HETC_R_TACT
 SG_ Ecat_LostLink1 m31 : 272|8@1+ (1,0) [0|0] "" HETC_R_TACT
 SG_ Ecat_LostLink2 m31 : 280|8@1+ (1,0) [0|0] "" HETC_R_TACT
 SG_ Ecat_LostLink3 m31 : 288|8@1+ (1,0) [0|0] "" HETC_R_TACT
 SG_ Saf_CanId m32 : 8|8@1+ (1,0) [0|0] "" HETC_R_TACT
 SG_ Saf_Name0 m32 : 16|8@1+ (1,0) [0|0] "" HETC_R_TACT
 SG_ Saf_Name1 m32 : 24|8@1+ (1,0) [0|0] "" HETC_R_TACT
 SG_ Saf_Name2 m32 : 32|8@1+ (1,0) [0|0] "" HETC_R_TACT
 SG_ Saf_Name3 m32 : 40|8@1+ (1,0) [0|0] "" HETC_R_TACT
 SG_ Saf_Name4 m32 : 48|8@1+ (1,0) [0|0] "" HETC_R_TACT
 SG_ Saf_Name5 m32 : 56|8@1+ (1,0) [0|0] "" HETC_R_TACT
 SG_ Saf_Name6 m32 : 64|8@1+ (1,0) [0|0] "" HETC_R_TACT
 SG_ Saf_Name7 m32 : 72|8@1+ (1,0) [0|0] "" HETC_R_TACT
 SG_ Saf_Name8 m32 : 80|8@1+ (1,0) [0|0] "" HETC_R_TACT
 SG_ Saf_Name9 m32 : 88|8@1+ (1,0) [0|0] "" HETC_R_TACT
 SG_ Saf_Name10 m32 : 96|8@1+ (1,0) [0|0] "" HETC_R_TACT
 SG_ Saf_Name11 m32 : 104|8@1+ (1,0) [0|0] "" HETC_R_TACT
 SG_ Saf_Name12 m32 : 112|8@1+ (1,0) [0|0] "" HETC_R_TACT
 SG_ Saf_Name13 m32 : 120|8@1+ (1,0) [0|0] "" HETC_R_TACT
 SG_ Saf_Name14 m32 : 128|8@1+ (1,0) [0|0] "" HETC_R_TACT
 SG_ Saf_Name15 m32 : 136|8@1+ (1,0) [0|0] "" HETC_R_TACT
 SG_ Saf_State m32 : 144|8@1+ (1,0) [0|0] "" HETC_R_TACT
 SG_ Saf_Bits m32 : 152|16@1+ (1,0) [0|0] "" HETC_R_TACT
 SG_ Saf_Estop m32 : 168|8@1+ (1,0) [0|0] "" HETC_R_TACT
 SG_ Saf_FatalLatched m32 : 176|16@1+ (1,0) [0|0] "" HETC_R_TACT
 SG_ Saf_ErrCode m32 : 192|32@1+ (1,0) [0|0] "" HETC_R_TACT

BO_ 2163329737 STATUS_HMDH_202_to_HMDH_201: 48 HMDH_202
 SG_ SubCode M : 0|8@1+ (1,0) [0|0] "" HMDH_201
 SG_ Ping_CanId m5 : 8|8@1+ (1,0) [0|0] "" HMDH_201
 SG_ Ping_HostId m5 : 16|8@1+ (1,0) [0|0] "" HMDH_201
 SG_ Ping_Pid m5 : 24|16@1+ (1,0) [0|0] "" HMDH_201
 SG_ Ping_Bid m5 : 40|16@1+ (1,0) [0|0] "" HMDH_201
 SG_ Ping_Mid m5 : 56|16@1+ (1,0) [0|0] "" HMDH_201
 SG_ Ping_VerMajor m5 : 72|8@1+ (1,0) [0|0] "" HMDH_201
 SG_ Ping_VerMinor m5 : 80|8@1+ (1,0) [0|0] "" HMDH_201
 SG_ Ping_VerPatch m5 : 88|8@1+ (1,0) [0|0] "" HMDH_201
 SG_ Ping_Name0 m5 : 96|8@1+ (1,0) [0|0] "" HMDH_201
 SG_ Ping_Name1 m5 : 104|8@1+ (1,0) [0|0] "" HMDH_201
 SG_ Ping_Name2 m5 : 112|8@1+ (1,0) [0|0] "" HMDH_201
 SG_ Ping_Name3 m5 : 120|8@1+ (1,0) [0|0] "" HMDH_201
 SG_ Ping_Name4 m5 : 128|8@1+ (1,0) [0|0] "" HMDH_201
 SG_ Ping_Name5 m5 : 136|8@1+ (1,0) [0|0] "" HMDH_201
 SG_ Ping_Name6 m5 : 144|8@1+ (1,0) [0|0] "" HMDH_201
 SG_ Ping_Name7 m5 : 152|8@1+ (1,0) [0|0] "" HMDH_201
 SG_ Ping_Name8 m5 : 160|8@1+ (1,0) [0|0] "" HMDH_201
 SG_ Ping_Name9 m5 : 168|8@1+ (1,0) [0|0] "" HMDH_201
 SG_ Ping_Name10 m5 : 176|8@1+ (1,0) [0|0] "" HMDH_201
 SG_ Ping_Name11 m5 : 184|8@1+ (1,0) [0|0] "" HMDH_201
 SG_ Ping_Name12 m5 : 192|8@1+ (1,0) [0|0] "" HMDH_201
 SG_ Ping_Name13 m5 : 200|8@1+ (1,0) [0|0] "" HMDH_201
 SG_ Ping_Name14 m5 : 208|8@1+ (1,0) [0|0] "" HMDH_201
 SG_ Ping_Name15 m5 : 216|8@1+ (1,0) [0|0] "" HMDH_201
 SG_ Ping_FmtVer m5 : 224|8@1+ (1,0) [0|0] "" HMDH_201
 SG_ Ping_GitRev m5 : 232|32@1+ (1,0) [0|0] "" HMDH_201
 SG_ Ping_FwCrc m5 : 264|16@1+ (1,0) [0|0] "" HMDH_201
 SG_ Ping_UptimeS m5 : 280|16@1+ (1,0) [0|0] "s" HMDH_201
 SG_ Ecat_CanId m31 : 8|8@1+ (1,0) [0|0] "" HMDH_201
 SG_ Ecat_Name0 m31 : 16|8@1+ (1,0) [0|0] "" HMDH_201
 SG_ Ecat_Name1 m31 : 24|8@1+ (1,0) [0|0] "" HMDH_201
 SG_ Ecat_Name2 m31 : 32|8@1+ (1,0) [0|0] "" HMDH_201
 SG_ Ecat_Name3 m31 : 40|8@1+ (1,0) [0|0] "" HMDH_201
 SG_ Ecat_Name4 m31 : 48|8@1+ (1,0) [0|0] "" HMDH_201
 SG_ Ecat_Name5 m31 : 56|8@1+ (1,0) [0|0] "" HMDH_201
 SG_ Ecat_Name6 m31 : 64|8@1+ (1,0) [0|0] "" HMDH_201
 SG_ Ecat_Name7 m31 : 72|8@1+ (1,0) [0|0] "" HMDH_201
 SG_ Ecat_Name8 m31 : 80|8@1+ (1,0) [0|0] "" HMDH_201
 SG_ Ecat_Name9 m31 : 88|8@1+ (1,0) [0|0] "" HMDH_201
 SG_ Ecat_Name10 m31 : 96|8@1+ (1,0) [0|0] "" HMDH_201
 SG_ Ecat_Name11 m31 : 104|8@1+ (1,0) [0|0] "" HMDH_201
 SG_ Ecat_Name12 m31 : 112|8@1+ (1,0) [0|0] "" HMDH_201
 SG_ Ecat_Name13 m31 : 120|8@1+ (1,0) [0|0] "" HMDH_201
 SG_ Ecat_Name14 m31 : 128|8@1+ (1,0) [0|0] "" HMDH_201
 SG_ Ecat_Name15 m31 : 136|8@1+ (1,0) [0|0] "" HMDH_201
 SG_ Ecat_Link m31 : 144|8@1+ (1,0) [0|0] "" HMDH_201
 SG_ Ecat_InvalidFrame0 m31 : 152|8@1+ (1,0) [0|0] "" HMDH_201
 SG_ Ecat_InvalidFrame1 m31 : 160|8@1+ (1,0) [0|0] "" HMDH_201
 SG_ Ecat_InvalidFrame2 m31 : 168|8@1+ (1,0) [0|0] "" HMDH_201
 SG_ Ecat_InvalidFrame3 m31 : 176|8@1+ (1,0) [0|0] "" HMDH_201
 SG_ Ecat_RxError0 m31 : 184|8@1+ (1,0) [0|0] "" HMDH_201
 SG_ Ecat_RxError1 m31 : 192|8@1+ (1,0) [0|0] "" HMDH_201
 SG_ Ecat_RxError2 m31 : 200|8@1+ (1,0) [0|0] "" HMDH_201
 SG_ Ecat_RxError3 m31 : 208|8@1+ (1,0) [0|0] "" HMDH_201
 SG_ Ecat_FwdRxError0 m31 : 216|8@1+ (1,0) [0|0] "" HMDH_201
 SG_ Ecat_FwdRxError1 m31 : 224|8@1+ (1,0) [0|0] "" HMDH_201
 SG_ Ecat_FwdRxError2 m31 : 232|8@1+ (1,0) [0|0] "" HMDH_201
 SG_ Ecat_FwdRxError3 m31 : 240|8@1+ (1,0) [0|0] "" HMDH_201
 SG_ Ecat_PuError m31 : 248|8@1+ (1,0) [0|0] "" HMDH_201
 SG_ Ecat_PdiError m31 : 256|8@1+ (1,0) [0|0] "" HMDH_201
 SG_ Ecat_LostLink0 m31 : 264|8@1+ (1,0) [0|0] "" HMDH_201
 SG_ Ecat_LostLink1 m31 : 272|8@1+ (1,0) [0|0] "" HMDH_201
 SG_ Ecat_LostLink2 m31 : 280|8@1+ (1,0) [0|0] "" HMDH_201
 SG_ Ecat_LostLink3 m31 : 288|8@1+ (1,0) [0|0] "" HMDH_201
 SG_ Saf_CanId m32 : 8|8@1+ (1,0) [0|0] "" HMDH_201
 SG_ Saf_Name0 m32 : 16|8@1+ (1,0) [0|0] "" HMDH_201
 SG_ Saf_Name1 m32 : 24|8@1+ (1,0) [0|0] "" HMDH_201
 SG_ Saf_Name2 m32 : 32|8@1+ (1,0) [0|0] "" HMDH_201
 SG_ Saf_Name3 m32 : 40|8@1+ (1,0) [0|0] "" HMDH_201
 SG_ Saf_Name4 m32 : 48|8@1+ (1,0) [0|0] "" HMDH_201
 SG_ Saf_Name5 m32 : 56|8@1+ (1,0) [0|0] "" HMDH_201
 SG_ Saf_Name6 m32 : 64|8@1+ (1,0) [0|0] "" HMDH_201
 SG_ Saf_Name7 m32 : 72|8@1+ (1,0) [0|0] "" HMDH_201
 SG_ Saf_Name8 m32 : 80|8@1+ (1,0) [0|0] "" HMDH_201
 SG_ Saf_Name9 m32 : 88|8@1+ (1,0) [0|0] "" HMDH_201
 SG_ Saf_Name10 m32 : 96|8@1+ (1,0) [0|0] "" HMDH_201
 SG_ Saf_Name11 m32 : 104|8@1+ (1,0) [0|0] "" HMDH_201
 SG_ Saf_Name12 m32 : 112|8@1+ (1,0) [0|0] "" HMDH_201
 SG_ Saf_Name13 m32 : 120|8@1+ (1,0) [0|0] "" HMDH_201
 SG_ Saf_Name14 m32 : 128|8@1+ (1,0) [0|0] "" HMDH_201
 SG_ Saf_Name15 m32 : 136|8@1+ (1,0) [0|0] "" HMDH_201
 SG_ Saf_State m32 : 144|8@1+ (1,0) [0|0] "" HMDH_201
 SG_ Saf_Bits m32 : 152|16@1+ (1,0) [0|0] "" HMDH_201
 SG_ Saf_Estop m32 : 168|8@1+ (1,0) [0|0] "" HMDH_201
 SG_ Saf_FatalLatched m32 : 176|16@1+ (1,0) [0|0] "" HMDH_201
 SG_ Saf_ErrCode m32 : 192|32@1+ (1,0) [0|0] "" HMDH_201

BO_ 2163329739 STATUS_HMDH_202_to_HMDH_203: 48 HMDH_202
 SG_ SubCode M : 0|8@1+ (1,0) [0|0] "" HMDH_203
 SG_ Ping_CanId m5 : 8|8@1+ (1,0) [0|0] "" HMDH_203
 SG_ Ping_HostId m5 : 16|8@1+ (1,0) [0|0] "" HMDH_203
 SG_ Ping_Pid m5 : 24|16@1+ (1,0) [0|0] "" HMDH_203
 SG_ Ping_Bid m5 : 40|16@1+ (1,0) [0|0] "" HMDH_203
 SG_ Ping_Mid m5 : 56|16@1+ (1,0) [0|0] "" HMDH_203
 SG_ Ping_VerMajor m5 : 72|8@1+ (1,0) [0|0] "" HMDH_203
 SG_ Ping_VerMinor m5 : 80|8@1+ (1,0) [0|0] "" HMDH_203
 SG_ Ping_VerPatch m5 : 88|8@1+ (1,0) [0|0] "" HMDH_203
 SG_ Ping_Name0 m5 : 96|8@1+ (1,0) [0|0] "" HMDH_203
 SG_ Ping_Name1 m5 : 104|8@1+ (1,0) [0|0] "" HMDH_203
 SG_ Ping_Name2 m5 : 112|8@1+ (1,0) [0|0] "" HMDH_203
 SG_ Ping_Name3 m5 : 120|8@1+ (1,0) [0|0] "" HMDH_203
 SG_ Ping_Name4 m5 : 128|8@1+ (1,0) [0|0] "" HMDH_203
 SG_ Ping_Name5 m5 : 136|8@1+ (1,0) [0|0] "" HMDH_203
 SG_ Ping_Name6 m5 : 144|8@1+ (1,0) [0|0] "" HMDH_203
 SG_ Ping_Name7 m5 : 152|8@1+ (1,0) [0|0] "" HMDH_203
 SG_ Ping_Name8 m5 : 160|8@1+ (1,0) [0|0] "" HMDH_203
 SG_ Ping_Name9 m5 : 168|8@1+ (1,0) [0|0] "" HMDH_203
 SG_ Ping_Name10 m5 : 176|8@1+ (1,0) [0|0] "" HMDH_203
 SG_ Ping_Name11 m5 : 184|8@1+ (1,0) [0|0] "" HMDH_203
 SG_ Ping_Name12 m5 : 192|8@1+ (1,0) [0|0] "" HMDH_203
 SG_ Ping_Name13 m5 : 200|8@1+ (1,0) [0|0] "" HMDH_203
 SG_ Ping_Name14 m5 : 208|8@1+ (1,0) [0|0] "" HMDH_203
 SG_ Ping_Name15 m5 : 216|8@1+ (1,0) [0|0] "" HMDH_203
 SG_ Ping_FmtVer m5 : 224|8@1+ (1,0) [0|0] "" HMDH_203
 SG_ Ping_GitRev m5 : 232|32@1+ (1,0) [0|0] "" HMDH_203
 SG_ Ping_FwCrc m5 : 264|16@1+ (1,0) [0|0] "" HMDH_203
 SG_ Ping_UptimeS m5 : 280|16@1+ (1,0) [0|0] "s" HMDH_203
 SG_ Ecat_CanId m31 : 8|8@1+ (1,0) [0|0] "" HMDH_203
 SG_ Ecat_Name0 m31 : 16|8@1+ (1,0) [0|0] "" HMDH_203
 SG_ Ecat_Name1 m31 : 24|8@1+ (1,0) [0|0] "" HMDH_203
 SG_ Ecat_Name2 m31 : 32|8@1+ (1,0) [0|0] "" HMDH_203
 SG_ Ecat_Name3 m31 : 40|8@1+ (1,0) [0|0] "" HMDH_203
 SG_ Ecat_Name4 m31 : 48|8@1+ (1,0) [0|0] "" HMDH_203
 SG_ Ecat_Name5 m31 : 56|8@1+ (1,0) [0|0] "" HMDH_203
 SG_ Ecat_Name6 m31 : 64|8@1+ (1,0) [0|0] "" HMDH_203
 SG_ Ecat_Name7 m31 : 72|8@1+ (1,0) [0|0] "" HMDH_203
 SG_ Ecat_Name8 m31 : 80|8@1+ (1,0) [0|0] "" HMDH_203
 SG_ Ecat_Name9 m31 : 88|8@1+ (1,0) [0|0] "" HMDH_203
 SG_ Ecat_Name10 m31 : 96|8@1+ (1,0) [0|0] "" HMDH_203
 SG_ Ecat_Name11 m31 : 104|8@1+ (1,0) [0|0] "" HMDH_203
 SG_ Ecat_Name12 m31 : 112|8@1+ (1,0) [0|0] "" HMDH_203
 SG_ Ecat_Name13 m31 : 120|8@1+ (1,0) [0|0] "" HMDH_203
 SG_ Ecat_Name14 m31 : 128|8@1+ (1,0) [0|0] "" HMDH_203
 SG_ Ecat_Name15 m31 : 136|8@1+ (1,0) [0|0] "" HMDH_203
 SG_ Ecat_Link m31 : 144|8@1+ (1,0) [0|0] "" HMDH_203
 SG_ Ecat_InvalidFrame0 m31 : 152|8@1+ (1,0) [0|0] "" HMDH_203
 SG_ Ecat_InvalidFrame1 m31 : 160|8@1+ (1,0) [0|0] "" HMDH_203
 SG_ Ecat_InvalidFrame2 m31 : 168|8@1+ (1,0) [0|0] "" HMDH_203
 SG_ Ecat_InvalidFrame3 m31 : 176|8@1+ (1,0) [0|0] "" HMDH_203
 SG_ Ecat_RxError0 m31 : 184|8@1+ (1,0) [0|0] "" HMDH_203
 SG_ Ecat_RxError1 m31 : 192|8@1+ (1,0) [0|0] "" HMDH_203
 SG_ Ecat_RxError2 m31 : 200|8@1+ (1,0) [0|0] "" HMDH_203
 SG_ Ecat_RxError3 m31 : 208|8@1+ (1,0) [0|0] "" HMDH_203
 SG_ Ecat_FwdRxError0 m31 : 216|8@1+ (1,0) [0|0] "" HMDH_203
 SG_ Ecat_FwdRxError1 m31 : 224|8@1+ (1,0) [0|0] "" HMDH_203
 SG_ Ecat_FwdRxError2 m31 : 232|8@1+ (1,0) [0|0] "" HMDH_203
 SG_ Ecat_FwdRxError3 m31 : 240|8@1+ (1,0) [0|0] "" HMDH_203
 SG_ Ecat_PuError m31 : 248|8@1+ (1,0) [0|0] "" HMDH_203
 SG_ Ecat_PdiError m31 : 256|8@1+ (1,0) [0|0] "" HMDH_203
 SG_ Ecat_LostLink0 m31 : 264|8@1+ (1,0) [0|0] "" HMDH_203
 SG_ Ecat_LostLink1 m31 : 272|8@1+ (1,0) [0|0] "" HMDH_203
 SG_ Ecat_LostLink2 m31 : 280|8@1+ (1,0) [0|0] "" HMDH_203
 SG_ Ecat_LostLink3 m31 : 288|8@1+ (1,0) [0|0] "" HMDH_203
 SG_ Saf_CanId m32 : 8|8@1+ (1,0) [0|0] "" HMDH_203
 SG_ Saf_Name0 m32 : 16|8@1+ (1,0) [0|0] "" HMDH_203
 SG_ Saf_Name1 m32 : 24|8@1+ (1,0) [0|0] "" HMDH_203
 SG_ Saf_Name2 m32 : 32|8@1+ (1,0) [0|0] "" HMDH_203
 SG_ Saf_Name3 m32 : 40|8@1+ (1,0) [0|0] "" HMDH_203
 SG_ Saf_Name4 m32 : 48|8@1+ (1,0) [0|0] "" HMDH_203
 SG_ Saf_Name5 m32 : 56|8@1+ (1,0) [0|0] "" HMDH_203
 SG_ Saf_Name6 m32 : 64|8@1+ (1,0) [0|0] "" HMDH_203
 SG_ Saf_Name7 m32 : 72|8@1+ (1,0) [0|0] "" HMDH_203
 SG_ Saf_Name8 m32 : 80|8@1+ (1,0) [0|0] "" HMDH_203
 SG_ Saf_Name9 m32 : 88|8@1+ (1,0) [0|0] "" HMDH_203
 SG_ Saf_Name10 m32 : 96|8@1+ (1,0) [0|0] "" HMDH_203
 SG_ Saf_Name11 m32 : 104|8@1+ (1,0) [0|0] "" HMDH_203
 SG_ Saf_Name12 m32 : 112|8@1+ (1,0) [0|0] "" HMDH_203
 SG_ Saf_Name13 m32 : 120|8@1+ (1,0) [0|0] "" HMDH_203
 SG_ Saf_Name14 m32 : 128|8@1+ (1,0) [0|0] "" HMDH_203
 SG_ Saf_Name15 m32 : 136|8@1+ (1,0) [0|0] "" HMDH_203
 SG_ Saf_State m32 : 144|8@1+ (1,0) [0|0] "" HMDH_203
 SG_ Saf_Bits m32 : 152|16@1+ (1,0) [0|0] "" HMDH_203
 SG_ Saf_Estop m32 : 168|8@1+ (1,0) [0|0] "" HMDH_203
 SG_ Saf_FatalLatched m32 : 176|16@1+ (1,0) [0|0] "" HMDH_203
 SG_ Saf_ErrCode m32 : 192|32@1+ (1,0) [0|0] "" HMDH_203

CM_ BO_ 2163313871 "diagnostic response";
CM_ BO_ 2163316324 "diagnostic response";
CM_ BO_ 2163316334 "diagnostic response";
CM_ BO_ 2163316344 "diagnostic response";
CM_ BO_ 2163316354 "diagnostic response";
CM_ BO_ 2163316364 "diagnostic response";
CM_ BO_ 2163316425 "diagnostic response";
CM_ BO_ 2163316426 "diagnostic response";
CM_ BO_ 2163316427 "diagnostic response";
CM_ BO_ 2163316428 "diagnostic response";
CM_ BO_ 2163316429 "diagnostic response";
CM_ BO_ 2163316430 "diagnostic response";
CM_ BO_ 2163316431 "diagnostic response";
CM_ BO_ 2163329380 "diagnostic response";
CM_ BO_ 2163329390 "diagnostic response";
CM_ BO_ 2163329400 "diagnostic response";
CM_ BO_ 2163329410 "diagnostic response";
CM_ BO_ 2163329420 "diagnostic response";
CM_ BO_ 2163329430 "diagnostic response";
CM_ BO_ 2163329482 "diagnostic response";
CM_ BO_ 2163329483 "diagnostic response";
CM_ BO_ 2163329484 "diagnostic response";
CM_ BO_ 2163329485 "diagnostic response";
CM_ BO_ 2163329486 "diagnostic response";
CM_ BO_ 2163329487 "diagnostic response";
CM_ BO_ 2163329636 "diagnostic response";
CM_ BO_ 2163329646 "diagnostic response";
CM_ BO_ 2163329656 "diagnostic response";
CM_ BO_ 2163329666 "diagnostic response";
CM_ BO_ 2163329676 "diagnostic response";
CM_ BO_ 2163329686 "diagnostic response";
CM_ BO_ 2163329737 "diagnostic response";
CM_ BO_ 2163329739 "diagnostic response";
BA_DEF_ BO_ "GenMsgCycleTime" INT 0 65535;
BA_DEF_ BO_ "VFrameFormat" ENUM "StandardCAN","ExtendedCAN","reserved","reserved","reserved","reserved","reserved","reserved","reserved","reserved","reserved","reserved","reserved","reserved","StandardCAN_FD","ExtendedCAN_FD";
BA_DEF_ BO_ "CANFD_BRS" ENUM "0","1";
BA_DEF_ BO_ "SubCodeCycles" STRING ;
BA_DEF_ BO_ "SubCodeLengths" STRING ;
BA_DEF_DEF_ "GenMsgCycleTime" 0;
BA_DEF_DEF_ "VFrameFormat" "ExtendedCAN_FD";
BA_DEF_DEF_ "CANFD_BRS" "1";
BA_DEF_DEF_ "SubCodeCycles" "";
BA_DEF_DEF_ "SubCodeLengths" "";
BA_ "SubCodeLengths" BO_ 2163313871 "5:37;31:37;32:28";
BA_ "SubCodeLengths" BO_ 2163316324 "5:37;31:37;32:28";
BA_ "SubCodeLengths" BO_ 2163316334 "5:37;31:37;32:28";
BA_ "SubCodeLengths" BO_ 2163316344 "5:37;31:37;32:28";
BA_ "SubCodeLengths" BO_ 2163316354 "5:37;31:37;32:28";
BA_ "SubCodeLengths" BO_ 2163316364 "5:37;31:37;32:28";
BA_ "SubCodeLengths" BO_ 2163316425 "5:37;31:37;32:28";
BA_ "SubCodeLengths" BO_ 2163316426 "5:37;31:37;32:28";
BA_ "SubCodeLengths" BO_ 2163316427 "5:37;31:37;32:28";
BA_ "SubCodeLengths" BO_ 2163316428 "5:37;31:37;32:28";
BA_ "SubCodeLengths" BO_ 2163316429 "5:37;31:37;32:28";
BA_ "SubCodeLengths" BO_ 2163316430 "5:37;31:37;32:28";
BA_ "SubCodeLengths" BO_ 2163316431 "5:37;31:37;32:28";
BA_ "SubCodeLengths" BO_ 2163329380 "5:37;31:37;32:28";
BA_ "SubCodeLengths" BO_ 2163329390 "5:37;31:37;32:28";
BA_ "SubCodeLengths" BO_ 2163329400 "5:37;31:37;32:28";
BA_ "SubCodeLengths" BO_ 2163329410 "5:37;31:37;32:28";
BA_ "SubCodeLengths" BO_ 2163329420 "5:37;31:37;32:28";
BA_ "SubCodeLengths" BO_ 2163329430 "5:37;31:37;32:28";
BA_ "SubCodeLengths" BO_ 2163329482 "5:37;31:37;32:28";
BA_ "SubCodeLengths" BO_ 2163329483 "5:37;31:37;32:28";
BA_ "SubCodeLengths" BO_ 2163329484 "5:37;31:37;32:28";
BA_ "SubCodeLengths" BO_ 2163329485 "5:37;31:37;32:28";
BA_ "SubCodeLengths" BO_ 2163329486 "5:37;31:37;32:28";
BA_ "SubCodeLengths" BO_ 2163329487 "5:37;31:37;32:28";
BA_ "SubCodeLengths" BO_ 2163329636 "5:37;31:37;32:28";
BA_ "SubCodeLengths" BO_ 2163329646 "5:37;31:37;32:28";
BA_ "SubCodeLengths" BO_ 2163329656 "5:37;31:37;32:28";
BA_ "SubCodeLengths" BO_ 2163329666 "5:37;31:37;32:28";
BA_ "SubCodeLengths" BO_ 2163329676 "5:37;31:37;32:28";
BA_ "SubCodeLengths" BO_ 2163329686 "5:37;31:37;32:28";
BA_ "SubCodeLengths" BO_ 2163329737 "5:37;31:37;32:28";
BA_ "SubCodeLengths" BO_ 2163329739 "5:37;31:37;32:28";
VAL_ 2163313871 SubCode 34 "POWER" 33 "THOR" 32 "SAFETY" 31 "ECAT_ERR" 30 "BUZZER_CFG" 27 "ANGLE_MULTI" 26 "BAT_LATCH" 25 "SAFETY_SENSOR" 22 "HRMC" 19 "TOF" 18 "USS" 17 "ANGLE" 9 "TACTILE_G2" 5 "PING" ;
VAL_ 2163313871 Saf_State 4 "RESETTING" 3 "FAULT" 2 "STOPPED" 1 "STOPPING" 0 "NORMAL" ;
VAL_ 2163316324 SubCode 34 "POWER" 33 "THOR" 32 "SAFETY" 31 "ECAT_ERR" 30 "BUZZER_CFG" 27 "ANGLE_MULTI" 26 "BAT_LATCH" 25 "SAFETY_SENSOR" 22 "HRMC" 19 "TOF" 18 "USS" 17 "ANGLE" 9 "TACTILE_G2" 5 "PING" ;
VAL_ 2163316324 Saf_State 4 "RESETTING" 3 "FAULT" 2 "STOPPED" 1 "STOPPING" 0 "NORMAL" ;
VAL_ 2163316334 SubCode 34 "POWER" 33 "THOR" 32 "SAFETY" 31 "ECAT_ERR" 30 "BUZZER_CFG" 27 "ANGLE_MULTI" 26 "BAT_LATCH" 25 "SAFETY_SENSOR" 22 "HRMC" 19 "TOF" 18 "USS" 17 "ANGLE" 9 "TACTILE_G2" 5 "PING" ;
VAL_ 2163316334 Saf_State 4 "RESETTING" 3 "FAULT" 2 "STOPPED" 1 "STOPPING" 0 "NORMAL" ;
VAL_ 2163316344 SubCode 34 "POWER" 33 "THOR" 32 "SAFETY" 31 "ECAT_ERR" 30 "BUZZER_CFG" 27 "ANGLE_MULTI" 26 "BAT_LATCH" 25 "SAFETY_SENSOR" 22 "HRMC" 19 "TOF" 18 "USS" 17 "ANGLE" 9 "TACTILE_G2" 5 "PING" ;
VAL_ 2163316344 Saf_State 4 "RESETTING" 3 "FAULT" 2 "STOPPED" 1 "STOPPING" 0 "NORMAL" ;
VAL_ 2163316354 SubCode 34 "POWER" 33 "THOR" 32 "SAFETY" 31 "ECAT_ERR" 30 "BUZZER_CFG" 27 "ANGLE_MULTI" 26 "BAT_LATCH" 25 "SAFETY_SENSOR" 22 "HRMC" 19 "TOF" 18 "USS" 17 "ANGLE" 9 "TACTILE_G2" 5 "PING" ;
VAL_ 2163316354 Saf_State 4 "RESETTING" 3 "FAULT" 2 "STOPPED" 1 "STOPPING" 0 "NORMAL" ;
VAL_ 2163316364 SubCode 34 "POWER" 33 "THOR" 32 "SAFETY" 31 "ECAT_ERR" 30 "BUZZER_CFG" 27 "ANGLE_MULTI" 26 "BAT_LATCH" 25 "SAFETY_SENSOR" 22 "HRMC" 19 "TOF" 18 "USS" 17 "ANGLE" 9 "TACTILE_G2" 5 "PING" ;
VAL_ 2163316364 Saf_State 4 "RESETTING" 3 "FAULT" 2 "STOPPED" 1 "STOPPING" 0 "NORMAL" ;
VAL_ 2163316425 SubCode 34 "POWER" 33 "THOR" 32 "SAFETY" 31 "ECAT_ERR" 30 "BUZZER_CFG" 27 "ANGLE_MULTI" 26 "BAT_LATCH" 25 "SAFETY_SENSOR" 22 "HRMC" 19 "TOF" 18 "USS" 17 "ANGLE" 9 "TACTILE_G2" 5 "PING" ;
VAL_ 2163316425 Saf_State 4 "RESETTING" 3 "FAULT" 2 "STOPPED" 1 "STOPPING" 0 "NORMAL" ;
VAL_ 2163316426 SubCode 34 "POWER" 33 "THOR" 32 "SAFETY" 31 "ECAT_ERR" 30 "BUZZER_CFG" 27 "ANGLE_MULTI" 26 "BAT_LATCH" 25 "SAFETY_SENSOR" 22 "HRMC" 19 "TOF" 18 "USS" 17 "ANGLE" 9 "TACTILE_G2" 5 "PING" ;
VAL_ 2163316426 Saf_State 4 "RESETTING" 3 "FAULT" 2 "STOPPED" 1 "STOPPING" 0 "NORMAL" ;
VAL_ 2163316427 SubCode 34 "POWER" 33 "THOR" 32 "SAFETY" 31 "ECAT_ERR" 30 "BUZZER_CFG" 27 "ANGLE_MULTI" 26 "BAT_LATCH" 25 "SAFETY_SENSOR" 22 "HRMC" 19 "TOF" 18 "USS" 17 "ANGLE" 9 "TACTILE_G2" 5 "PING" ;
VAL_ 2163316427 Saf_State 4 "RESETTING" 3 "FAULT" 2 "STOPPED" 1 "STOPPING" 0 "NORMAL" ;
VAL_ 2163316428 SubCode 34 "POWER" 33 "THOR" 32 "SAFETY" 31 "ECAT_ERR" 30 "BUZZER_CFG" 27 "ANGLE_MULTI" 26 "BAT_LATCH" 25 "SAFETY_SENSOR" 22 "HRMC" 19 "TOF" 18 "USS" 17 "ANGLE" 9 "TACTILE_G2" 5 "PING" ;
VAL_ 2163316428 Saf_State 4 "RESETTING" 3 "FAULT" 2 "STOPPED" 1 "STOPPING" 0 "NORMAL" ;
VAL_ 2163316429 SubCode 34 "POWER" 33 "THOR" 32 "SAFETY" 31 "ECAT_ERR" 30 "BUZZER_CFG" 27 "ANGLE_MULTI" 26 "BAT_LATCH" 25 "SAFETY_SENSOR" 22 "HRMC" 19 "TOF" 18 "USS" 17 "ANGLE" 9 "TACTILE_G2" 5 "PING" ;
VAL_ 2163316429 Saf_State 4 "RESETTING" 3 "FAULT" 2 "STOPPED" 1 "STOPPING" 0 "NORMAL" ;
VAL_ 2163316430 SubCode 34 "POWER" 33 "THOR" 32 "SAFETY" 31 "ECAT_ERR" 30 "BUZZER_CFG" 27 "ANGLE_MULTI" 26 "BAT_LATCH" 25 "SAFETY_SENSOR" 22 "HRMC" 19 "TOF" 18 "USS" 17 "ANGLE" 9 "TACTILE_G2" 5 "PING" ;
VAL_ 2163316430 Saf_State 4 "RESETTING" 3 "FAULT" 2 "STOPPED" 1 "STOPPING" 0 "NORMAL" ;
VAL_ 2163316431 SubCode 34 "POWER" 33 "THOR" 32 "SAFETY" 31 "ECAT_ERR" 30 "BUZZER_CFG" 27 "ANGLE_MULTI" 26 "BAT_LATCH" 25 "SAFETY_SENSOR" 22 "HRMC" 19 "TOF" 18 "USS" 17 "ANGLE" 9 "TACTILE_G2" 5 "PING" ;
VAL_ 2163316431 Saf_State 4 "RESETTING" 3 "FAULT" 2 "STOPPED" 1 "STOPPING" 0 "NORMAL" ;
VAL_ 2163329380 SubCode 34 "POWER" 33 "THOR" 32 "SAFETY" 31 "ECAT_ERR" 30 "BUZZER_CFG" 27 "ANGLE_MULTI" 26 "BAT_LATCH" 25 "SAFETY_SENSOR" 22 "HRMC" 19 "TOF" 18 "USS" 17 "ANGLE" 9 "TACTILE_G2" 5 "PING" ;
VAL_ 2163329380 Saf_State 4 "RESETTING" 3 "FAULT" 2 "STOPPED" 1 "STOPPING" 0 "NORMAL" ;
VAL_ 2163329390 SubCode 34 "POWER" 33 "THOR" 32 "SAFETY" 31 "ECAT_ERR" 30 "BUZZER_CFG" 27 "ANGLE_MULTI" 26 "BAT_LATCH" 25 "SAFETY_SENSOR" 22 "HRMC" 19 "TOF" 18 "USS" 17 "ANGLE" 9 "TACTILE_G2" 5 "PING" ;
VAL_ 2163329390 Saf_State 4 "RESETTING" 3 "FAULT" 2 "STOPPED" 1 "STOPPING" 0 "NORMAL" ;
VAL_ 2163329400 SubCode 34 "POWER" 33 "THOR" 32 "SAFETY" 31 "ECAT_ERR" 30 "BUZZER_CFG" 27 "ANGLE_MULTI" 26 "BAT_LATCH" 25 "SAFETY_SENSOR" 22 "HRMC" 19 "TOF" 18 "USS" 17 "ANGLE" 9 "TACTILE_G2" 5 "PING" ;
VAL_ 2163329400 Saf_State 4 "RESETTING" 3 "FAULT" 2 "STOPPED" 1 "STOPPING" 0 "NORMAL" ;
VAL_ 2163329410 SubCode 34 "POWER" 33 "THOR" 32 "SAFETY" 31 "ECAT_ERR" 30 "BUZZER_CFG" 27 "ANGLE_MULTI" 26 "BAT_LATCH" 25 "SAFETY_SENSOR" 22 "HRMC" 19 "TOF" 18 "USS" 17 "ANGLE" 9 "TACTILE_G2" 5 "PING" ;
VAL_ 2163329410 Saf_State 4 "RESETTING" 3 "FAULT" 2 "STOPPED" 1 "STOPPING" 0 "NORMAL" ;
VAL_ 2163329420 SubCode 34 "POWER" 33 "THOR" 32 "SAFETY" 31 "ECAT_ERR" 30 "BUZZER_CFG" 27 "ANGLE_MULTI" 26 "BAT_LATCH" 25 "SAFETY_SENSOR" 22 "HRMC" 19 "TOF" 18 "USS" 17 "ANGLE" 9 "TACTILE_G2" 5 "PING" ;
VAL_ 2163329420 Saf_State 4 "RESETTING" 3 "FAULT" 2 "STOPPED" 1 "STOPPING" 0 "NORMAL" ;
VAL_ 2163329430 SubCode 34 "POWER" 33 "THOR" 32 "SAFETY" 31 "ECAT_ERR" 30 "BUZZER_CFG" 27 "ANGLE_MULTI" 26 "BAT_LATCH" 25 "SAFETY_SENSOR" 22 "HRMC" 19 "TOF" 18 "USS" 17 "ANGLE" 9 "TACTILE_G2" 5 "PING" ;
VAL_ 2163329430 Saf_State 4 "RESETTING" 3 "FAULT" 2 "STOPPED" 1 "STOPPING" 0 "NORMAL" ;
VAL_ 2163329482 SubCode 34 "POWER" 33 "THOR" 32 "SAFETY" 31 "ECAT_ERR" 30 "BUZZER_CFG" 27 "ANGLE_MULTI" 26 "BAT_LATCH" 25 "SAFETY_SENSOR" 22 "HRMC" 19 "TOF" 18 "USS" 17 "ANGLE" 9 "TACTILE_G2" 5 "PING" ;
VAL_ 2163329482 Saf_State 4 "RESETTING" 3 "FAULT" 2 "STOPPED" 1 "STOPPING" 0 "NORMAL" ;
VAL_ 2163329483 SubCode 34 "POWER" 33 "THOR" 32 "SAFETY" 31 "ECAT_ERR" 30 "BUZZER_CFG" 27 "ANGLE_MULTI" 26 "BAT_LATCH" 25 "SAFETY_SENSOR" 22 "HRMC" 19 "TOF" 18 "USS" 17 "ANGLE" 9 "TACTILE_G2" 5 "PING" ;
VAL_ 2163329483 Saf_State 4 "RESETTING" 3 "FAULT" 2 "STOPPED" 1 "STOPPING" 0 "NORMAL" ;
VAL_ 2163329484 SubCode 34 "POWER" 33 "THOR" 32 "SAFETY" 31 "ECAT_ERR" 30 "BUZZER_CFG" 27 "ANGLE_MULTI" 26 "BAT_LATCH" 25 "SAFETY_SENSOR" 22 "HRMC" 19 "TOF" 18 "USS" 17 "ANGLE" 9 "TACTILE_G2" 5 "PING" ;
VAL_ 2163329484 Saf_State 4 "RESETTING" 3 "FAULT" 2 "STOPPED" 1 "STOPPING" 0 "NORMAL" ;
VAL_ 2163329485 SubCode 34 "POWER" 33 "THOR" 32 "SAFETY" 31 "ECAT_ERR" 30 "BUZZER_CFG" 27 "ANGLE_MULTI" 26 "BAT_LATCH" 25 "SAFETY_SENSOR" 22 "HRMC" 19 "TOF" 18 "USS" 17 "ANGLE" 9 "TACTILE_G2" 5 "PING" ;
VAL_ 2163329485 Saf_State 4 "RESETTING" 3 "FAULT" 2 "STOPPED" 1 "STOPPING" 0 "NORMAL" ;
VAL_ 2163329486 SubCode 34 "POWER" 33 "THOR" 32 "SAFETY" 31 "ECAT_ERR" 30 "BUZZER_CFG" 27 "ANGLE_MULTI" 26 "BAT_LATCH" 25 "SAFETY_SENSOR" 22 "HRMC" 19 "TOF" 18 "USS" 17 "ANGLE" 9 "TACTILE_G2" 5 "PING" ;
VAL_ 2163329486 Saf_State 4 "RESETTING" 3 "FAULT" 2 "STOPPED" 1 "STOPPING" 0 "NORMAL" ;
VAL_ 2163329487 SubCode 34 "POWER" 33 "THOR" 32 "SAFETY" 31 "ECAT_ERR" 30 "BUZZER_CFG" 27 "ANGLE_MULTI" 26 "BAT_LATCH" 25 "SAFETY_SENSOR" 22 "HRMC" 19 "TOF" 18 "USS" 17 "ANGLE" 9 "TACTILE_G2" 5 "PING" ;
VAL_ 2163329487 Saf_State 4 "RESETTING" 3 "FAULT" 2 "STOPPED" 1 "STOPPING" 0 "NORMAL" ;
VAL_ 2163329636 SubCode 34 "POWER" 33 "THOR" 32 "SAFETY" 31 "ECAT_ERR" 30 "BUZZER_CFG" 27 "ANGLE_MULTI" 26 "BAT_LATCH" 25 "SAFETY_SENSOR" 22 "HRMC" 19 "TOF" 18 "USS" 17 "ANGLE" 9 "TACTILE_G2" 5 "PING" ;
VAL_ 2163329636 Saf_State 4 "RESETTING" 3 "FAULT" 2 "STOPPED" 1 "STOPPING" 0 "NORMAL" ;
VAL_ 2163329646 SubCode 34 "POWER" 33 "THOR" 32 "SAFETY" 31 "ECAT_ERR" 30 "BUZZER_CFG" 27 "ANGLE_MULTI" 26 "BAT_LATCH" 25 "SAFETY_SENSOR" 22 "HRMC" 19 "TOF" 18 "USS" 17 "ANGLE" 9 "TACTILE_G2" 5 "PING" ;
VAL_ 2163329646 Saf_State 4 "RESETTING" 3 "FAULT" 2 "STOPPED" 1 "STOPPING" 0 "NORMAL" ;
VAL_ 2163329656 SubCode 34 "POWER" 33 "THOR" 32 "SAFETY" 31 "ECAT_ERR" 30 "BUZZER_CFG" 27 "ANGLE_MULTI" 26 "BAT_LATCH" 25 "SAFETY_SENSOR" 22 "HRMC" 19 "TOF" 18 "USS" 17 "ANGLE" 9 "TACTILE_G2" 5 "PING" ;
VAL_ 2163329656 Saf_State 4 "RESETTING" 3 "FAULT" 2 "STOPPED" 1 "STOPPING" 0 "NORMAL" ;
VAL_ 2163329666 SubCode 34 "POWER" 33 "THOR" 32 "SAFETY" 31 "ECAT_ERR" 30 "BUZZER_CFG" 27 "ANGLE_MULTI" 26 "BAT_LATCH" 25 "SAFETY_SENSOR" 22 "HRMC" 19 "TOF" 18 "USS" 17 "ANGLE" 9 "TACTILE_G2" 5 "PING" ;
VAL_ 2163329666 Saf_State 4 "RESETTING" 3 "FAULT" 2 "STOPPED" 1 "STOPPING" 0 "NORMAL" ;
VAL_ 2163329676 SubCode 34 "POWER" 33 "THOR" 32 "SAFETY" 31 "ECAT_ERR" 30 "BUZZER_CFG" 27 "ANGLE_MULTI" 26 "BAT_LATCH" 25 "SAFETY_SENSOR" 22 "HRMC" 19 "TOF" 18 "USS" 17 "ANGLE" 9 "TACTILE_G2" 5 "PING" ;
VAL_ 2163329676 Saf_State 4 "RESETTING" 3 "FAULT" 2 "STOPPED" 1 "STOPPING" 0 "NORMAL" ;
VAL_ 2163329686 SubCode 34 "POWER" 33 "THOR" 32 "SAFETY" 31 "ECAT_ERR" 30 "BUZZER_CFG" 27 "ANGLE_MULTI" 26 "BAT_LATCH" 25 "SAFETY_SENSOR" 22 "HRMC" 19 "TOF" 18 "USS" 17 "ANGLE" 9 "TACTILE_G2" 5 "PING" ;
VAL_ 2163329686 Saf_State 4 "RESETTING" 3 "FAULT" 2 "STOPPED" 1 "STOPPING" 0 "NORMAL" ;
VAL_ 2163329737 SubCode 34 "POWER" 33 "THOR" 32 "SAFETY" 31 "ECAT_ERR" 30 "BUZZER_CFG" 27 "ANGLE_MULTI" 26 "BAT_LATCH" 25 "SAFETY_SENSOR" 22 "HRMC" 19 "TOF" 18 "USS" 17 "ANGLE" 9 "TACTILE_G2" 5 "PING" ;
VAL_ 2163329737 Saf_State 4 "RESETTING" 3 "FAULT" 2 "STOPPED" 1 "STOPPING" 0 "NORMAL" ;
VAL_ 2163329739 SubCode 34 "POWER" 33 "THOR" 32 "SAFETY" 31 "ECAT_ERR" 30 "BUZZER_CFG" 27 "ANGLE_MULTI" 26 "BAT_LATCH" 25 "SAFETY_SENSOR" 22 "HRMC" 19 "TOF" 18 "USS" 17 "ANGLE" 9 "TACTILE_G2" 5 "PING" ;
VAL_ 2163329739 Saf_State 4 "RESETTING" 3 "FAULT" 2 "STOPPED" 1 "STOPPING" 0 "NORMAL" ;
