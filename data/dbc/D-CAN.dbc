VERSION ""

NS_ :

BS_:

BU_: HETC_M_MOB HETC_M_WST HETC_L_ARM HETC_L_TACT HETC_R_ARM HETC_R_TACT HMDH_201 HMDH_202 HMDH_203 HMDH_204 HMDH_205 HMDH_206 HMDH_207

BO_ 2163308674 STATUS_HETC_L_ARM_to_HETC_L_TACT: 48 HETC_L_ARM
 SG_ SubCode M : 0|8@1+ (1,0) [0|0] "" HETC_L_TACT
 SG_ Ping_CanId m5 : 8|8@1+ (1,0) [0|0] "" HETC_L_TACT
 SG_ Ping_HostId m5 : 16|8@1+ (1,0) [0|0] "" HETC_L_TACT
 SG_ Ping_Pid m5 : 24|16@1+ (1,0) [0|0] "" HETC_L_TACT
 SG_ Ping_Bid m5 : 40|16@1+ (1,0) [0|0] "" HETC_L_TACT
 SG_ Ping_Mid m5 : 56|16@1+ (1,0) [0|0] "" HETC_L_TACT
 SG_ Ping_VerMajor m5 : 72|8@1+ (1,0) [0|0] "" HETC_L_TACT
 SG_ Ping_VerMinor m5 : 80|8@1+ (1,0) [0|0] "" HETC_L_TACT
 SG_ Ping_VerPatch m5 : 88|8@1+ (1,0) [0|0] "" HETC_L_TACT
 SG_ Ping_Name0 m5 : 96|8@1+ (1,0) [0|0] "" HETC_L_TACT
 SG_ Ping_Name1 m5 : 104|8@1+ (1,0) [0|0] "" HETC_L_TACT
 SG_ Ping_Name2 m5 : 112|8@1+ (1,0) [0|0] "" HETC_L_TACT
 SG_ Ping_Name3 m5 : 120|8@1+ (1,0) [0|0] "" HETC_L_TACT
 SG_ Ping_Name4 m5 : 128|8@1+ (1,0) [0|0] "" HETC_L_TACT
 SG_ Ping_Name5 m5 : 136|8@1+ (1,0) [0|0] "" HETC_L_TACT
 SG_ Ping_Name6 m5 : 144|8@1+ (1,0) [0|0] "" HETC_L_TACT
 SG_ Ping_Name7 m5 : 152|8@1+ (1,0) [0|0] "" HETC_L_TACT
 SG_ Ping_Name8 m5 : 160|8@1+ (1,0) [0|0] "" HETC_L_TACT
 SG_ Ping_Name9 m5 : 168|8@1+ (1,0) [0|0] "" HETC_L_TACT
 SG_ Ping_Name10 m5 : 176|8@1+ (1,0) [0|0] "" HETC_L_TACT
 SG_ Ping_Name11 m5 : 184|8@1+ (1,0) [0|0] "" HETC_L_TACT
 SG_ Ping_Name12 m5 : 192|8@1+ (1,0) [0|0] "" HETC_L_TACT
 SG_ Ping_Name13 m5 : 200|8@1+ (1,0) [0|0] "" HETC_L_TACT
 SG_ Ping_Name14 m5 : 208|8@1+ (1,0) [0|0] "" HETC_L_TACT
 SG_ Ping_Name15 m5 : 216|8@1+ (1,0) [0|0] "" HETC_L_TACT
 SG_ Ping_FmtVer m5 : 224|8@1+ (1,0) [0|0] "" HETC_L_TACT
 SG_ Ping_GitRev m5 : 232|32@1+ (1,0) [0|0] "" HETC_L_TACT
 SG_ Ping_FwCrc m5 : 264|16@1+ (1,0) [0|0] "" HETC_L_TACT
 SG_ Ping_UptimeS m5 : 280|16@1+ (1,0) [0|0] "s" HETC_L_TACT
 SG_ Ecat_CanId m31 : 8|8@1+ (1,0) [0|0] "" HETC_L_TACT
 SG_ Ecat_Name0 m31 : 16|8@1+ (1,0) [0|0] "" HETC_L_TACT
 SG_ Ecat_Name1 m31 : 24|8@1+ (1,0) [0|0] "" HETC_L_TACT
 SG_ Ecat_Name2 m31 : 32|8@1+ (1,0) [0|0] "" HETC_L_TACT
 SG_ Ecat_Name3 m31 : 40|8@1+ (1,0) [0|0] "" HETC_L_TACT
 SG_ Ecat_Name4 m31 : 48|8@1+ (1,0) [0|0] "" HETC_L_TACT
 SG_ Ecat_Name5 m31 : 56|8@1+ (1,0) [0|0] "" HETC_L_TACT
 SG_ Ecat_Name6 m31 : 64|8@1+ (1,0) [0|0] "" HETC_L_TACT
 SG_ Ecat_Name7 m31 : 72|8@1+ (1,0) [0|0] "" HETC_L_TACT
 SG_ Ecat_Name8 m31 : 80|8@1+ (1,0) [0|0] "" HETC_L_TACT
 SG_ Ecat_Name9 m31 : 88|8@1+ (1,0) [0|0] "" HETC_L_TACT
 SG_ Ecat_Name10 m31 : 96|8@1+ (1,0) [0|0] "" HETC_L_TACT
 SG_ Ecat_Name11 m31 : 104|8@1+ (1,0) [0|0] "" HETC_L_TACT
 SG_ Ecat_Name12 m31 : 112|8@1+ (1,0) [0|0] "" HETC_L_TACT
 SG_ Ecat_Name13 m31 : 120|8@1+ (1,0) [0|0] "" HETC_L_TACT
 SG_ Ecat_Name14 m31 : 128|8@1+ (1,0) [0|0] "" HETC_L_TACT
 SG_ Ecat_Name15 m31 : 136|8@1+ (1,0) [0|0] "" HETC_L_TACT
 SG_ Ecat_Link m31 : 144|8@1+ (1,0) [0|0] "" HETC_L_TACT
 SG_ Ecat_InvalidFrame0 m31 : 152|8@1+ (1,0) [0|0] "" HETC_L_TACT
 SG_ Ecat_InvalidFrame1 m31 : 160|8@1+ (1,0) [0|0] "" HETC_L_TACT
 SG_ Ecat_InvalidFrame2 m31 : 168|8@1+ (1,0) [0|0] "" HETC_L_TACT
 SG_ Ecat_InvalidFrame3 m31 : 176|8@1+ (1,0) [0|0] "" HETC_L_TACT
 SG_ Ecat_RxError0 m31 : 184|8@1+ (1,0) [0|0] "" HETC_L_TACT
 SG_ Ecat_RxError1 m31 : 192|8@1+ (1,0) [0|0] "" HETC_L_TACT
 SG_ Ecat_RxError2 m31 : 200|8@1+ (1,0) [0|0] "" HETC_L_TACT
 SG_ Ecat_RxError3 m31 : 208|8@1+ (1,0) [0|0] "" HETC_L_TACT
 SG_ Ecat_FwdRxError0 m31 : 216|8@1+ (1,0) [0|0] "" HETC_L_TACT
 SG_ Ecat_FwdRxError1 m31 : 224|8@1+ (1,0) [0|0] "" HETC_L_TACT
 SG_ Ecat_FwdRxError2 m31 : 232|8@1+ (1,0) [0|0] "" HETC_L_TACT
 SG_ Ecat_FwdRxError3 m31 : 240|8@1+ (1,0) [0|0] "" HETC_L_TACT
 SG_ Ecat_PuError m31 : 248|8@1+ (1,0) [0|0] "" HETC_L_TACT
 SG_ Ecat_PdiError m31 : 256|8@1+ (1,0) [0|0] "" HETC_L_TACT
 SG_ Ecat_LostLink0 m31 : 264|8@1+ (1,0) [0|0] "" HETC_L_TACT
 SG_ Ecat_LostLink1 m31 : 272|8@1+ (1,0) [0|0] "" HETC_L_TACT
 SG_ Ecat_LostLink2 m31 : 280|8@1+ (1,0) [0|0] "" HETC_L_TACT
 SG_ Ecat_LostLink3 m31 : 288|8@1+ (1,0) [0|0] "" HETC_L_TACT
 SG_ Saf_CanId m32 : 8|8@1+ (1,0) [0|0] "" HETC_L_TACT
 SG_ Saf_Name0 m32 : 16|8@1+ (1,0) [0|0] "" HETC_L_TACT
 SG_ Saf_Name1 m32 : 24|8@1+ (1,0) [0|0] "" HETC_L_TACT
 SG_ Saf_Name2 m32 : 32|8@1+ (1,0) [0|0] "" HETC_L_TACT
 SG_ Saf_Name3 m32 : 40|8@1+ (1,0) [0|0] "" HETC_L_TACT
 SG_ Saf_Name4 m32 : 48|8@1+ (1,0) [0|0] "" HETC_L_TACT
 SG_ Saf_Name5 m32 : 56|8@1+ (1,0) [0|0] "" HETC_L_TACT
 SG_ Saf_Name6 m32 : 64|8@1+ (1,0) [0|0] "" HETC_L_TACT
 SG_ Saf_Name7 m32 : 72|8@1+ (1,0) [0|0] "" HETC_L_TACT
 SG_ Saf_Name8 m32 : 80|8@1+ (1,0) [0|0] "" HETC_L_TACT
 SG_ Saf_Name9 m32 : 88|8@1+ (1,0) [0|0] "" HETC_L_TACT
 SG_ Saf_Name10 m32 : 96|8@1+ (1,0) [0|0] "" HETC_L_TACT
 SG_ Saf_Name11 m32 : 104|8@1+ (1,0) [0|0] "" HETC_L_TACT
 SG_ Saf_Name12 m32 : 112|8@1+ (1,0) [0|0] "" HETC_L_TACT
 SG_ Saf_Name13 m32 : 120|8@1+ (1,0) [0|0] "" HETC_L_TACT
 SG_ Saf_Name14 m32 : 128|8@1+ (1,0) [0|0] "" HETC_L_TACT
 SG_ Saf_Name15 m32 : 136|8@1+ (1,0) [0|0] "" HETC_L_TACT
 SG_ Saf_State m32 : 144|8@1+ (1,0) [0|0] "" HETC_L_TACT
 SG_ Saf_Bits m32 : 152|16@1+ (1,0) [0|0] "" HETC_L_TACT
 SG_ Saf_Estop m32 : 168|8@1+ (1,0) [0|0] "" HETC_L_TACT
 SG_ Saf_FatalLatched m32 : 176|16@1+ (1,0) [0|0] "" HETC_L_TACT
 SG_ Saf_ErrCode m32 : 192|32@1+ (1,0) [0|0] "" HETC_L_TACT

BO_ 2163308684 STATUS_HETC_L_ARM_to_HETC_R_ARM: 48 HETC_L_ARM
 SG_ SubCode M : 0|8@1+ (1,0) [0|0] "" HETC_R_ARM
 SG_ Ping_CanId m5 : 8|8@1+ (1,0) [0|0] "" HETC_R_ARM
 SG_ Ping_HostId m5 : 16|8@1+ (1,0) [0|0] "" HETC_R_ARM
 SG_ Ping_Pid m5 : 24|16@1+ (1,0) [0|0] "" HETC_R_ARM
 SG_ Ping_Bid m5 : 40|16@1+ (1,0) [0|0] "" HETC_R_ARM
 SG_ Ping_Mid m5 : 56|16@1+ (1,0) [0|0] "" HETC_R_ARM
 SG_ Ping_VerMajor m5 : 72|8@1+ (1,0) [0|0] "" HETC_R_ARM
 SG_ Ping_VerMinor m5 : 80|8@1+ (1,0) [0|0] "" HETC_R_ARM
 SG_ Ping_VerPatch m5 : 88|8@1+ (1,0) [0|0] "" HETC_R_ARM
 SG_ Ping_Name0 m5 : 96|8@1+ (1,0) [0|0] "" HETC_R_ARM
 SG_ Ping_Name1 m5 : 104|8@1+ (1,0) [0|0] "" HETC_R_ARM
 SG_ Ping_Name2 m5 : 112|8@1+ (1,0) [0|0] "" HETC_R_ARM
 SG_ Ping_Name3 m5 : 120|8@1+ (1,0) [0|0] "" HETC_R_ARM
 SG_ Ping_Name4 m5 : 128|8@1+ (1,0) [0|0] "" HETC_R_ARM
 SG_ Ping_Name5 m5 : 136|8@1+ (1,0) [0|0] "" HETC_R_ARM
 SG_ Ping_Name6 m5 : 144|8@1+ (1,0) [0|0] "" HETC_R_ARM
 SG_ Ping_Name7 m5 : 152|8@1+ (1,0) [0|0] "" HETC_R_ARM
 SG_ Ping_Name8 m5 : 160|8@1+ (1,0) [0|0] "" HETC_R_ARM
 SG_ Ping_Name9 m5 : 168|8@1+ (1,0) [0|0] "" HETC_R_ARM
 SG_ Ping_Name10 m5 : 176|8@1+ (1,0) [0|0] "" HETC_R_ARM
 SG_ Ping_Name11 m5 : 184|8@1+ (1,0) [0|0] "" HETC_R_ARM
 SG_ Ping_Name12 m5 : 192|8@1+ (1,0) [0|0] "" HETC_R_ARM
 SG_ Ping_Name13 m5 : 200|8@1+ (1,0) [0|0] "" HETC_R_ARM
 SG_ Ping_Name14 m5 : 208|8@1+ (1,0) [0|0] "" HETC_R_ARM
 SG_ Ping_Name15 m5 : 216|8@1+ (1,0) [0|0] "" HETC_R_ARM
 SG_ Ping_FmtVer m5 : 224|8@1+ (1,0) [0|0] "" HETC_R_ARM
 SG_ Ping_GitRev m5 : 232|32@1+ (1,0) [0|0] "" HETC_R_ARM
 SG_ Ping_FwCrc m5 : 264|16@1+ (1,0) [0|0] "" HETC_R_ARM
 SG_ Ping_UptimeS m5 : 280|16@1+ (1,0) [0|0] "s" HETC_R_ARM
 SG_ Ecat_CanId m31 : 8|8@1+ (1,0) [0|0] "" HETC_R_ARM
 SG_ Ecat_Name0 m31 : 16|8@1+ (1,0) [0|0] "" HETC_R_ARM
 SG_ Ecat_Name1 m31 : 24|8@1+ (1,0) [0|0] "" HETC_R_ARM
 SG_ Ecat_Name2 m31 : 32|8@1+ (1,0) [0|0] "" HETC_R_ARM
 SG_ Ecat_Name3 m31 : 40|8@1+ (1,0) [0|0] "" HETC_R_ARM
 SG_ Ecat_Name4 m31 : 48|8@1+ (1,0) [0|0] "" HETC_R_ARM
 SG_ Ecat_Name5 m31 : 56|8@1+ (1,0) [0|0] "" HETC_R_ARM
 SG_ Ecat_Name6 m31 : 64|8@1+ (1,0) [0|0] "" HETC_R_ARM
 SG_ Ecat_Name7 m31 : 72|8@1+ (1,0) [0|0] "" HETC_R_ARM
 SG_ Ecat_Name8 m31 : 80|8@1+ (1,0) [0|0] "" HETC_R_ARM
 SG_ Ecat_Name9 m31 : 88|8@1+ (1,0) [0|0] "" HETC_R_ARM
 SG_ Ecat_Name10 m31 : 96|8@1+ (1,0) [0|0] "" HETC_R_ARM
 SG_ Ecat_Name11 m31 : 104|8@1+ (1,0) [0|0] "" HETC_R_ARM
 SG_ Ecat_Name12 m31 : 112|8@1+ (1,0) [0|0] "" HETC_R_ARM
 SG_ Ecat_Name13 m31 : 120|8@1+ (1,0) [0|0] "" HETC_R_ARM
 SG_ Ecat_Name14 m31 : 128|8@1+ (1,0) [0|0] "" HETC_R_ARM
 SG_ Ecat_Name15 m31 : 136|8@1+ (1,0) [0|0] "" HETC_R_ARM
 SG_ Ecat_Link m31 : 144|8@1+ (1,0) [0|0] "" HETC_R_ARM
 SG_ Ecat_InvalidFrame0 m31 : 152|8@1+ (1,0) [0|0] "" HETC_R_ARM
 SG_ Ecat_InvalidFrame1 m31 : 160|8@1+ (1,0) [0|0] "" HETC_R_ARM
 SG_ Ecat_InvalidFrame2 m31 : 168|8@1+ (1,0) [0|0] "" HETC_R_ARM
 SG_ Ecat_InvalidFrame3 m31 : 176|8@1+ (1,0) [0|0] "" HETC_R_ARM
 SG_ Ecat_RxError0 m31 : 184|8@1+ (1,0) [0|0] "" HETC_R_ARM
 SG_ Ecat_RxError1 m31 : 192|8@1+ (1,0) [0|0] "" HETC_R_ARM
 SG_ Ecat_RxError2 m31 : 200|8@1+ (1,0) [0|0] "" HETC_R_ARM
 SG_ Ecat_RxError3 m31 : 208|8@1+ (1,0) [0|0] "" HETC_R_ARM
 SG_ Ecat_FwdRxError0 m31 : 216|8@1+ (1,0) [0|0] "" HETC_R_ARM
 SG_ Ecat_FwdRxError1 m31 : 224|8@1+ (1,0) [0|0] "" HETC_R_ARM
 SG_ Ecat_FwdRxError2 m31 : 232|8@1+ (1,0) [0|0] "" HETC_R_ARM
 SG_ Ecat_FwdRxError3 m31 : 240|8@1+ (1,0) [0|0] "" HETC_R_ARM
 SG_ Ecat_PuError m31 : 248|8@1+ (1,0) [0|0] "" HETC_R_ARM
 SG_ Ecat_PdiError m31 : 256|8@1+ (1,0) [0|0] "" HETC_R_ARM
 SG_ Ecat_LostLink0 m31 : 264|8@1+ (1,0) [0|0] "" HETC_R_ARM
 SG_ Ecat_LostLink1 m31 : 272|8@1+ (1,0) [0|0] "" HETC_R_ARM
 SG_ Ecat_LostLink2 m31 : 280|8@1+ (1,0) [0|0] "" HETC_R_ARM
 SG_ Ecat_LostLink3 m31 : 288|8@1+ (1,0) [0|0] "" HETC_R_ARM
 SG_ Saf_CanId m32 : 8|8@1+ (1,0) [0|0] "" HETC_R_ARM
 SG_ Saf_Name0 m32 : 16|8@1+ (1,0) [0|0] "" HETC_R_ARM
 SG_ Saf_Name1 m32 : 24|8@1+ (1,0) [0|0] "" HETC_R_ARM
 SG_ Saf_Name2 m32 : 32|8@1+ (1,0) [0|0] "" HETC_R_ARM
 SG_ Saf_Name3 m32 : 40|8@1+ (1,0) [0|0] "" HETC_R_ARM
 SG_ Saf_Name4 m32 : 48|8@1+ (1,0) [0|0] "" HETC_R_ARM
 SG_ Saf_Name5 m32 : 56|8@1+ (1,0) [0|0] "" HETC_R_ARM
 SG_ Saf_Name6 m32 : 64|8@1+ (1,0) [0|0] "" HETC_R_ARM
 SG_ Saf_Name7 m32 : 72|8@1+ (1,0) [0|0] "" HETC_R_ARM
 SG_ Saf_Name8 m32 : 80|8@1+ (1,0) [0|0] "" HETC_R_ARM
 SG_ Saf_Name9 m32 : 88|8@1+ (1,0) [0|0] "" HETC_R_ARM
 SG_ Saf_Name10 m32 : 96|8@1+ (1,0) [0|0] "" HETC_R_ARM
 SG_ Saf_Name11 m32 : 104|8@1+ (1,0) [0|0] "" HETC_R_ARM
 SG_ Saf_Name12 m32 : 112|8@1+ (1,0) [0|0] "" HETC_R_ARM
 SG_ Saf_Name13 m32 : 120|8@1+ (1,0) [0|0] "" HETC_R_ARM
 SG_ Saf_Name14 m32 : 128|8@1+ (1,0) [0|0] "" HETC_R_ARM
 SG_ Saf_Name15 m32 : 136|8@1+ (1,0) [0|0] "" HETC_R_ARM
 SG_ Saf_State m32 : 144|8@1+ (1,0) [0|0] "" HETC_R_ARM
 SG_ Saf_Bits m32 : 152|16@1+ (1,0) [0|0] "" HETC_R_ARM
 SG_ Saf_Estop m32 : 168|8@1+ (1,0) [0|0] "" HETC_R_ARM
 SG_ Saf_FatalLatched m32 : 176|16@1+ (1,0) [0|0] "" HETC_R_ARM
 SG_ Saf_ErrCode m32 : 192|32@1+ (1,0) [0|0] "" HETC_R_ARM

BO_ 2163308694 STATUS_HETC_L_ARM_to_HETC_R_TACT: 48 HETC_L_ARM
 SG_ SubCode M : 0|8@1+ (1,0) [0|0] "" HETC_R_TACT
 SG_ Ping_CanId m5 : 8|8@1+ (1,0) [0|0] "" HETC_R_TACT
 SG_ Ping_HostId m5 : 16|8@1+ (1,0) [0|0] "" HETC_R_TACT
 SG_ Ping_Pid m5 : 24|16@1+ (1,0) [0|0] "" HETC_R_TACT
 SG_ Ping_Bid m5 : 40|16@1+ (1,0) [0|0] "" HETC_R_TACT
 SG_ Ping_Mid m5 : 56|16@1+ (1,0) [0|0] "" HETC_R_TACT
 SG_ Ping_VerMajor m5 : 72|8@1+ (1,0) [0|0] "" HETC_R_TACT
 SG_ Ping_VerMinor m5 : 80|8@1+ (1,0) [0|0] "" HETC_R_TACT
 SG_ Ping_VerPatch m5 : 88|8@1+ (1,0) [0|0] "" HETC_R_TACT
 SG_ Ping_Name0 m5 : 96|8@1+ (1,0) [0|0] "" HETC_R_TACT
 SG_ Ping_Name1 m5 : 104|8@1+ (1,0) [0|0] "" HETC_R_TACT
 SG_ Ping_Name2 m5 : 112|8@1+ (1,0) [0|0] "" HETC_R_TACT
 SG_ Ping_Name3 m5 : 120|8@1+ (1,0) [0|0] "" HETC_R_TACT
 SG_ Ping_Name4 m5 : 128|8@1+ (1,0) [0|0] "" HETC_R_TACT
 SG_ Ping_Name5 m5 : 136|8@1+ (1,0) [0|0] "" HETC_R_TACT
 SG_ Ping_Name6 m5 : 144|8@1+ (1,0) [0|0] "" HETC_R_TACT
 SG_ Ping_Name7 m5 : 152|8@1+ (1,0) [0|0] "" HETC_R_TACT
 SG_ Ping_Name8 m5 : 160|8@1+ (1,0) [0|0] "" HETC_R_TACT
 SG_ Ping_Name9 m5 : 168|8@1+ (1,0) [0|0] "" HETC_R_TACT
 SG_ Ping_Name10 m5 : 176|8@1+ (1,0) [0|0] "" HETC_R_TACT
 SG_ Ping_Name11 m5 : 184|8@1+ (1,0) [0|0] "" HETC_R_TACT
 SG_ Ping_Name12 m5 : 192|8@1+ (1,0) [0|0] "" HETC_R_TACT
 SG_ Ping_Name13 m5 : 200|8@1+ (1,0) [0|0] "" HETC_R_TACT
 SG_ Ping_Name14 m5 : 208|8@1+ (1,0) [0|0] "" HETC_R_TACT
 SG_ Ping_Name15 m5 : 216|8@1+ (1,0) [0|0] "" HETC_R_TACT
 SG_ Ping_FmtVer m5 : 224|8@1+ (1,0) [0|0] "" HETC_R_TACT
 SG_ Ping_GitRev m5 : 232|32@1+ (1,0) [0|0] "" HETC_R_TACT
 SG_ Ping_FwCrc m5 : 264|16@1+ (1,0) [0|0] "" HETC_R_TACT
 SG_ Ping_UptimeS m5 : 280|16@1+ (1,0) [0|0] "s" HETC_R_TACT
 SG_ Ecat_CanId m31 : 8|8@1+ (1,0) [0|0] "" HETC_R_TACT
 SG_ Ecat_Name0 m31 : 16|8@1+ (1,0) [0|0] "" HETC_R_TACT
 SG_ Ecat_Name1 m31 : 24|8@1+ (1,0) [0|0] "" HETC_R_TACT
 SG_ Ecat_Name2 m31 : 32|8@1+ (1,0) [0|0] "" HETC_R_TACT
 SG_ Ecat_Name3 m31 : 40|8@1+ (1,0) [0|0] "" HETC_R_TACT
 SG_ Ecat_Name4 m31 : 48|8@1+ (1,0) [0|0] "" HETC_R_TACT
 SG_ Ecat_Name5 m31 : 56|8@1+ (1,0) [0|0] "" HETC_R_TACT
 SG_ Ecat_Name6 m31 : 64|8@1+ (1,0) [0|0] "" HETC_R_TACT
 SG_ Ecat_Name7 m31 : 72|8@1+ (1,0) [0|0] "" HETC_R_TACT
 SG_ Ecat_Name8 m31 : 80|8@1+ (1,0) [0|0] "" HETC_R_TACT
 SG_ Ecat_Name9 m31 : 88|8@1+ (1,0) [0|0] "" HETC_R_TACT
 SG_ Ecat_Name10 m31 : 96|8@1+ (1,0) [0|0] "" HETC_R_TACT
 SG_ Ecat_Name11 m31 : 104|8@1+ (1,0) [0|0] "" HETC_R_TACT
 SG_ Ecat_Name12 m31 : 112|8@1+ (1,0) [0|0] "" HETC_R_TACT
 SG_ Ecat_Name13 m31 : 120|8@1+ (1,0) [0|0] "" HETC_R_TACT
 SG_ Ecat_Name14 m31 : 128|8@1+ (1,0) [0|0] "" HETC_R_TACT
 SG_ Ecat_Name15 m31 : 136|8@1+ (1,0) [0|0] "" HETC_R_TACT
 SG_ Ecat_Link m31 : 144|8@1+ (1,0) [0|0] "" HETC_R_TACT
 SG_ Ecat_InvalidFrame0 m31 : 152|8@1+ (1,0) [0|0] "" HETC_R_TACT
 SG_ Ecat_InvalidFrame1 m31 : 160|8@1+ (1,0) [0|0] "" HETC_R_TACT
 SG_ Ecat_InvalidFrame2 m31 : 168|8@1+ (1,0) [0|0] "" HETC_R_TACT
 SG_ Ecat_InvalidFrame3 m31 : 176|8@1+ (1,0) [0|0] "" HETC_R_TACT
 SG_ Ecat_RxError0 m31 : 184|8@1+ (1,0) [0|0] "" HETC_R_TACT
 SG_ Ecat_RxError1 m31 : 192|8@1+ (1,0) [0|0] "" HETC_R_TACT
 SG_ Ecat_RxError2 m31 : 200|8@1+ (1,0) [0|0] "" HETC_R_TACT
 SG_ Ecat_RxError3 m31 : 208|8@1+ (1,0) [0|0] "" HETC_R_TACT
 SG_ Ecat_FwdRxError0 m31 : 216|8@1+ (1,0) [0|0] "" HETC_R_TACT
 SG_ Ecat_FwdRxError1 m31 : 224|8@1+ (1,0) [0|0] "" HETC_R_TACT
 SG_ Ecat_FwdRxError2 m31 : 232|8@1+ (1,0) [0|0] "" HETC_R_TACT
 SG_ Ecat_FwdRxError3 m31 : 240|8@1+ (1,0) [0|0] "" HETC_R_TACT
 SG_ Ecat_PuError m31 : 248|8@1+ (1,0) [0|0] "" HETC_R_TACT
 SG_ Ecat_PdiError m31 : 256|8@1+ (1,0) [0|0] "" HETC_R_TACT
 SG_ Ecat_LostLink0 m31 : 264|8@1+ (1,0) [0|0] "" HETC_R_TACT
 SG_ Ecat_LostLink1 m31 : 272|8@1+ (1,0) [0|0] "" HETC_R_TACT
 SG_ Ecat_LostLink2 m31 : 280|8@1+ (1,0) [0|0] "" HETC_R_TACT
 SG_ Ecat_LostLink3 m31 : 288|8@1+ (1,0) [0|0] "" HETC_R_TACT
 SG_ Saf_CanId m32 : 8|8@1+ (1,0) [0|0] "" HETC_R_TACT
 SG_ Saf_Name0 m32 : 16|8@1+ (1,0) [0|0] "" HETC_R_TACT
 SG_ Saf_Name1 m32 : 24|8@1+ (1,0) [0|0] "" HETC_R_TACT
 SG_ Saf_Name2 m32 : 32|8@1+ (1,0) [0|0] "" HETC_R_TACT
 SG_ Saf_Name3 m32 : 40|8@1+ (1,0) [0|0] "" HETC_R_TACT
 SG_ Saf_Name4 m32 : 48|8@1+ (1,0) [0|0] "" HETC_R_TACT
 SG_ Saf_Name5 m32 : 56|8@1+ (1,0) [0|0] "" HETC_R_TACT
 SG_ Saf_Name6 m32 : 64|8@1+ (1,0) [0|0] "" HETC_R_TACT
 SG_ Saf_Name7 m32 : 72|8@1+ (1,0) [0|0] "" HETC_R_TACT
 SG_ Saf_Name8 m32 : 80|8@1+ (1,0) [0|0] "" HETC_R_TACT
 SG_ Saf_Name9 m32 : 88|8@1+ (1,0) [0|0] "" HETC_R_TACT
 SG_ Saf_Name10 m32 : 96|8@1+ (1,0) [0|0] "" HETC_R_TACT
 SG_ Saf_Name11 m32 : 104|8@1+ (1,0) [0|0] "" HETC_R_TACT
 SG_ Saf_Name12 m32 : 112|8@1+ (1,0) [0|0] "" HETC_R_TACT
 SG_ Saf_Name13 m32 : 120|8@1+ (1,0) [0|0] "" HETC_R_TACT
 SG_ Saf_Name14 m32 : 128|8@1+ (1,0) [0|0] "" HETC_R_TACT
 SG_ Saf_Name15 m32 : 136|8@1+ (1,0) [0|0] "" HETC_R_TACT
 SG_ Saf_State m32 : 144|8@1+ (1,0) [0|0] "" HETC_R_TACT
 SG_ Saf_Bits m32 : 152|16@1+ (1,0) [0|0] "" HETC_R_TACT
 SG_ Saf_Estop m32 : 168|8@1+ (1,0) [0|0] "" HETC_R_TACT
 SG_ Saf_FatalLatched m32 : 176|16@1+ (1,0) [0|0] "" HETC_R_TACT
 SG_ Saf_ErrCode m32 : 192|32@1+ (1,0) [0|0] "" HETC_R_TACT

BO_ 2163308745 STATUS_HETC_L_ARM_to_HMDH_201: 48 HETC_L_ARM
 SG_ SubCode M : 0|8@1+ (1,0) [0|0] "" HMDH_201
 SG_ Ping_CanId m5 : 8|8@1+ (1,0) [0|0] "" HMDH_201
 SG_ Ping_HostId m5 : 16|8@1+ (1,0) [0|0] "" HMDH_201
 SG_ Ping_Pid m5 : 24|16@1+ (1,0) [0|0] "" HMDH_201
 SG_ Ping_Bid m5 : 40|16@1+ (1,0) [0|0] "" HMDH_201
 SG_ Ping_Mid m5 : 56|16@1+ (1,0) [0|0] "" HMDH_201
 SG_ Ping_VerMajor m5 : 72|8@1+ (1,0) [0|0] "" HMDH_201
 SG_ Ping_VerMinor m5 : 80|8@1+ (1,0) [0|0] "" HMDH_201
 SG_ Ping_VerPatch m5 : 88|8@1+ (1,0) [0|0] "" HMDH_201
 SG_ Ping_Name0 m5 : 96|8@1+ (1,0) [0|0] "" HMDH_201
 SG_ Ping_Name1 m5 : 104|8@1+ (1,0) [0|0] "" HMDH_201
 SG_ Ping_Name2 m5 : 112|8@1+ (1,0) [0|0] "" HMDH_201
 SG_ Ping_Name3 m5 : 120|8@1+ (1,0) [0|0] "" HMDH_201
 SG_ Ping_Name4 m5 : 128|8@1+ (1,0) [0|0] "" HMDH_201
 SG_ Ping_Name5 m5 : 136|8@1+ (1,0) [0|0] "" HMDH_201
 SG_ Ping_Name6 m5 : 144|8@1+ (1,0) [0|0] "" HMDH_201
 SG_ Ping_Name7 m5 : 152|8@1+ (1,0) [0|0] "" HMDH_201
 SG_ Ping_Name8 m5 : 160|8@1+ (1,0) [0|0] "" HMDH_201
 SG_ Ping_Name9 m5 : 168|8@1+ (1,0) [0|0] "" HMDH_201
 SG_ Ping_Name10 m5 : 176|8@1+ (1,0) [0|0] "" HMDH_201
 SG_ Ping_Name11 m5 : 184|8@1+ (1,0) [0|0] "" HMDH_201
 SG_ Ping_Name12 m5 : 192|8@1+ (1,0) [0|0] "" HMDH_201
 SG_ Ping_Name13 m5 : 200|8@1+ (1,0) [0|0] "" HMDH_201
 SG_ Ping_Name14 m5 : 208|8@1+ (1,0) [0|0] "" HMDH_201
 SG_ Ping_Name15 m5 : 216|8@1+ (1,0) [0|0] "" HMDH_201
 SG_ Ping_FmtVer m5 : 224|8@1+ (1,0) [0|0] "" HMDH_201
 SG_ Ping_GitRev m5 : 232|32@1+ (1,0) [0|0] "" HMDH_201
 SG_ Ping_FwCrc m5 : 264|16@1+ (1,0) [0|0] "" HMDH_201
 SG_ Ping_UptimeS m5 : 280|16@1+ (1,0) [0|0] "s" HMDH_201
 SG_ Ecat_CanId m31 : 8|8@1+ (1,0) [0|0] "" HMDH_201
 SG_ Ecat_Name0 m31 : 16|8@1+ (1,0) [0|0] "" HMDH_201
 SG_ Ecat_Name1 m31 : 24|8@1+ (1,0) [0|0] "" HMDH_201
 SG_ Ecat_Name2 m31 : 32|8@1+ (1,0) [0|0] "" HMDH_201
 SG_ Ecat_Name3 m31 : 40|8@1+ (1,0) [0|0] "" HMDH_201
 SG_ Ecat_Name4 m31 : 48|8@1+ (1,0) [0|0] "" HMDH_201
 SG_ Ecat_Name5 m31 : 56|8@1+ (1,0) [0|0] "" HMDH_201
 SG_ Ecat_Name6 m31 : 64|8@1+ (1,0) [0|0] "" HMDH_201
 SG_ Ecat_Name7 m31 : 72|8@1+ (1,0) [0|0] "" HMDH_201
 SG_ Ecat_Name8 m31 : 80|8@1+ (1,0) [0|0] "" HMDH_201
 SG_ Ecat_Name9 m31 : 88|8@1+ (1,0) [0|0] "" HMDH_201
 SG_ Ecat_Name10 m31 : 96|8@1+ (1,0) [0|0] "" HMDH_201
 SG_ Ecat_Name11 m31 : 104|8@1+ (1,0) [0|0] "" HMDH_201
 SG_ Ecat_Name12 m31 : 112|8@1+ (1,0) [0|0] "" HMDH_201
 SG_ Ecat_Name13 m31 : 120|8@1+ (1,0) [0|0] "" HMDH_201
 SG_ Ecat_Name14 m31 : 128|8@1+ (1,0) [0|0] "" HMDH_201
 SG_ Ecat_Name15 m31 : 136|8@1+ (1,0) [0|0] "" HMDH_201
 SG_ Ecat_Link m31 : 144|8@1+ (1,0) [0|0] "" HMDH_201
 SG_ Ecat_InvalidFrame0 m31 : 152|8@1+ (1,0) [0|0] "" HMDH_201
 SG_ Ecat_InvalidFrame1 m31 : 160|8@1+ (1,0) [0|0] "" HMDH_201
 SG_ Ecat_InvalidFrame2 m31 : 168|8@1+ (1,0) [0|0] "" HMDH_201
 SG_ Ecat_InvalidFrame3 m31 : 176|8@1+ (1,0) [0|0] "" HMDH_201
 SG_ Ecat_RxError0 m31 : 184|8@1+ (1,0) [0|0] "" HMDH_201
 SG_ Ecat_RxError1 m31 : 192|8@1+ (1,0) [0|0] "" HMDH_201
 SG_ Ecat_RxError2 m31 : 200|8@1+ (1,0) [0|0] "" HMDH_201
 SG_ Ecat_RxError3 m31 : 208|8@1+ (1,0) [0|0] "" HMDH_201
 SG_ Ecat_FwdRxError0 m31 : 216|8@1+ (1,0) [0|0] "" HMDH_201
 SG_ Ecat_FwdRxError1 m31 : 224|8@1+ (1,0) [0|0] "" HMDH_201
 SG_ Ecat_FwdRxError2 m31 : 232|8@1+ (1,0) [0|0] "" HMDH_201
 SG_ Ecat_FwdRxError3 m31 : 240|8@1+ (1,0) [0|0] "" HMDH_201
 SG_ Ecat_PuError m31 : 248|8@1+ (1,0) [0|0] "" HMDH_201
 SG_ Ecat_PdiError m31 : 256|8@1+ (1,0) [0|0] "" HMDH_201
 SG_ Ecat_LostLink0 m31 : 264|8@1+ (1,0) [0|0] "" HMDH_201
 SG_ Ecat_LostLink1 m31 : 272|8@1+ (1,0) [0|0] "" HMDH_201
 SG_ Ecat_LostLink2 m31 : 280|8@1+ (1,0) [0|0] "" HMDH_201
 SG_ Ecat_LostLink3 m31 : 288|8@1+ (1,0) [0|0] "" HMDH_201
 SG_ Saf_CanId m32 : 8|8@1+ (1,0) [0|0] "" HMDH_201
 SG_ Saf_Name0 m32 : 16|8@1+ (1,0) [0|0] "" HMDH_201
 SG_ Saf_Name1 m32 : 24|8@1+ (1,0) [0|0] "" HMDH_201
 SG_ Saf_Name2 m32 : 32|8@1+ (1,0) [0|0] "" HMDH_201
 SG_ Saf_Name3 m32 : 40|8@1+ (1,0) [0|0] "" HMDH_201
 SG_ Saf_Name4 m32 : 48|8@1+ (1,0) [0|0] "" HMDH_201
 SG_ Saf_Name5 m32 : 56|8@1+ (1,0) [0|0] "" HMDH_201
 SG_ Saf_Name6 m32 : 64|8@1+ (1,0) [0|0] "" HMDH_201
 SG_ Saf_Name7 m32 : 72|8@1+ (1,0) [0|0] "" HMDH_201
 SG_ Saf_Name8 m32 : 80|8@1+ (1,0) [0|0] "" HMDH_201
 SG_ Saf_Name9 m32 : 88|8@1+ (1,0) [0|0] "" HMDH_201
 SG_ Saf_Name10 m32 : 96|8@1+ (1,0) [0|0] "" HMDH_201
 SG_ Saf_Name11 m32 : 104|8@1+ (1,0) [0|0] "" HMDH_201
 SG_ Saf_Name12 m32 : 112|8@1+ (1,0) [0|0] "" HMDH_201
 SG_ Saf_Name13 m32 : 120|8@1+ (1,0) [0|0] "" HMDH_201
 SG_ Saf_Name14 m32 : 128|8@1+ (1,0) [0|0] "" HMDH_201
 SG_ Saf_Name15 m32 : 136|8@1+ (1,0) [0|0] "" HMDH_201
 SG_ Saf_State m32 : 144|8@1+ (1,0) [0|0] "" HMDH_201
 SG_ Saf_Bits m32 : 152|16@1+ (1,0) [0|0] "" HMDH_201
 SG_ Saf_Estop m32 : 168|8@1+ (1,0) [0|0] "" HMDH_201
 SG_ Saf_FatalLatched m32 : 176|16@1+ (1,0) [0|0] "" HMDH_201
 SG_ Saf_ErrCode m32 : 192|32@1+ (1,0) [0|0] "" HMDH_201

BO_ 2163308746 STATUS_HETC_L_ARM_to_HMDH_202: 48 HETC_L_ARM
 SG_ SubCode M : 0|8@1+ (1,0) [0|0] "" HMDH_202
 SG_ Ping_CanId m5 : 8|8@1+ (1,0) [0|0] "" HMDH_202
 SG_ Ping_HostId m5 : 16|8@1+ (1,0) [0|0] "" HMDH_202
 SG_ Ping_Pid m5 : 24|16@1+ (1,0) [0|0] "" HMDH_202
 SG_ Ping_Bid m5 : 40|16@1+ (1,0) [0|0] "" HMDH_202
 SG_ Ping_Mid m5 : 56|16@1+ (1,0) [0|0] "" HMDH_202
 SG_ Ping_VerMajor m5 : 72|8@1+ (1,0) [0|0] "" HMDH_202
 SG_ Ping_VerMinor m5 : 80|8@1+ (1,0) [0|0] "" HMDH_202
 SG_ Ping_VerPatch m5 : 88|8@1+ (1,0) [0|0] "" HMDH_202
 SG_ Ping_Name0 m5 : 96|8@1+ (1,0) [0|0] "" HMDH_202
 SG_ Ping_Name1 m5 : 104|8@1+ (1,0) [0|0] "" HMDH_202
 SG_ Ping_Name2 m5 : 112|8@1+ (1,0) [0|0] "" HMDH_202
 SG_ Ping_Name3 m5 : 120|8@1+ (1,0) [0|0] "" HMDH_202
 SG_ Ping_Name4 m5 : 128|8@1+ (1,0) [0|0] "" HMDH_202
 SG_ Ping_Name5 m5 : 136|8@1+ (1,0) [0|0] "" HMDH_202
 SG_ Ping_Name6 m5 : 144|8@1+ (1,0) [0|0] "" HMDH_202
 SG_ Ping_Name7 m5 : 152|8@1+ (1,0) [0|0] "" HMDH_202
 SG_ Ping_Name8 m5 : 160|8@1+ (1,0) [0|0] "" HMDH_202
 SG_ Ping_Name9 m5 : 168|8@1+ (1,0) [0|0] "" HMDH_202
 SG_ Ping_Name10 m5 : 176|8@1+ (1,0) [0|0] "" HMDH_202
 SG_ Ping_Name11 m5 : 184|8@1+ (1,0) [0|0] "" HMDH_202
 SG_ Ping_Name12 m5 : 192|8@1+ (1,0) [0|0] "" HMDH_202
 SG_ Ping_Name13 m5 : 200|8@1+ (1,0) [0|0] "" HMDH_202
 SG_ Ping_Name14 m5 : 208|8@1+ (1,0) [0|0] "" HMDH_202
 SG_ Ping_Name15 m5 : 216|8@1+ (1,0) [0|0] "" HMDH_202
 SG_ Ping_FmtVer m5 : 224|8@1+ (1,0) [0|0] "" HMDH_202
 SG_ Ping_GitRev m5 : 232|32@1+ (1,0) [0|0] "" HMDH_202
 SG_ Ping_FwCrc m5 : 264|16@1+ (1,0) [0|0] "" HMDH_202
 SG_ Ping_UptimeS m5 : 280|16@1+ (1,0) [0|0] "s" HMDH_202
 SG_ Ecat_CanId m31 : 8|8@1+ (1,0) [0|0] "" HMDH_202
 SG_ Ecat_Name0 m31 : 16|8@1+ (1,0) [0|0] "" HMDH_202
 SG_ Ecat_Name1 m31 : 24|8@1+ (1,0) [0|0] "" HMDH_202
 SG_ Ecat_Name2 m31 : 32|8@1+ (1,0) [0|0] "" HMDH_202
 SG_ Ecat_Name3 m31 : 40|8@1+ (1,0) [0|0] "" HMDH_202
 SG_ Ecat_Name4 m31 : 48|8@1+ (1,0) [0|0] "" HMDH_202
 SG_ Ecat_Name5 m31 : 56|8@1+ (1,0) [0|0] "" HMDH_202
 SG_ Ecat_Name6 m31 : 64|8@1+ (1,0) [0|0] "" HMDH_202
 SG_ Ecat_Name7 m31 : 72|8@1+ (1,0) [0|0] "" HMDH_202
 SG_ Ecat_Name8 m31 : 80|8@1+ (1,0) [0|0] "" HMDH_202
 SG_ Ecat_Name9 m31 : 88|8@1+ (1,0) [0|0] "" HMDH_202
 SG_ Ecat_Name10 m31 : 96|8@1+ (1,0) [0|0] "" HMDH_202
 SG_ Ecat_Name11 m31 : 104|8@1+ (1,0) [0|0] "" HMDH_202
 SG_ Ecat_Name12 m31 : 112|8@1+ (1,0) [0|0] "" HMDH_202
 SG_ Ecat_Name13 m31 : 120|8@1+ (1,0) [0|0] "" HMDH_202
 SG_ Ecat_Name14 m31 : 128|8@1+ (1,0) [0|0] "" HMDH_202
 SG_ Ecat_Name15 m31 : 136|8@1+ (1,0) [0|0] "" HMDH_202
 SG_ Ecat_Link m31 : 144|8@1+ (1,0) [0|0] "" HMDH_202
 SG_ Ecat_InvalidFrame0 m31 : 152|8@1+ (1,0) [0|0] "" HMDH_202
 SG_ Ecat_InvalidFrame1 m31 : 160|8@1+ (1,0) [0|0] "" HMDH_202
 SG_ Ecat_InvalidFrame2 m31 : 168|8@1+ (1,0) [0|0] "" HMDH_202
 SG_ Ecat_InvalidFrame3 m31 : 176|8@1+ (1,0) [0|0] "" HMDH_202
 SG_ Ecat_RxError0 m31 : 184|8@1+ (1,0) [0|0] "" HMDH_202
 SG_ Ecat_RxError1 m31 : 192|8@1+ (1,0) [0|0] "" HMDH_202
 SG_ Ecat_RxError2 m31 : 200|8@1+ (1,0) [0|0] "" HMDH_202
 SG_ Ecat_RxError3 m31 : 208|8@1+ (1,0) [0|0] "" HMDH_202
 SG_ Ecat_FwdRxError0 m31 : 216|8@1+ (1,0) [0|0] "" HMDH_202
 SG_ Ecat_FwdRxError1 m31 : 224|8@1+ (1,0) [0|0] "" HMDH_202
 SG_ Ecat_FwdRxError2 m31 : 232|8@1+ (1,0) [0|0] "" HMDH_202
 SG_ Ecat_FwdRxError3 m31 : 240|8@1+ (1,0) [0|0] "" HMDH_202
 SG_ Ecat_PuError m31 : 248|8@1+ (1,0) [0|0] "" HMDH_202
 SG_ Ecat_PdiError m31 : 256|8@1+ (1,0) [0|0] "" HMDH_202
 SG_ Ecat_LostLink0 m31 : 264|8@1+ (1,0) [0|0] "" HMDH_202
 SG_ Ecat_LostLink1 m31 : 272|8@1+ (1,0) [0|0] "" HMDH_202
 SG_ Ecat_LostLink2 m31 : 280|8@1+ (1,0) [0|0] "" HMDH_202
 SG_ Ecat_LostLink3 m31 : 288|8@1+ (1,0) [0|0] "" HMDH_202
 SG_ Saf_CanId m32 : 8|8@1+ (1,0) [0|0] "" HMDH_202
 SG_ Saf_Name0 m32 : 16|8@1+ (1,0) [0|0] "" HMDH_202
 SG_ Saf_Name1 m32 : 24|8@1+ (1,0) [0|0] "" HMDH_202
 SG_ Saf_Name2 m32 : 32|8@1+ (1,0) [0|0] "" HMDH_202
 SG_ Saf_Name3 m32 : 40|8@1+ (1,0) [0|0] "" HMDH_202
 SG_ Saf_Name4 m32 : 48|8@1+ (1,0) [0|0] "" HMDH_202
 SG_ Saf_Name5 m32 : 56|8@1+ (1,0) [0|0] "" HMDH_202
 SG_ Saf_Name6 m32 : 64|8@1+ (1,0) [0|0] "" HMDH_202
 SG_ Saf_Name7 m32 : 72|8@1+ (1,0) [0|0] "" HMDH_202
 SG_ Saf_Name8 m32 : 80|8@1+ (1,0) [0|0] "" HMDH_202
 SG_ Saf_Name9 m32 : 88|8@1+ (1,0) [0|0] "" HMDH_202
 SG_ Saf_Name10 m32 : 96|8@1+ (1,0) [0|0] "" HMDH_202
 SG_ Saf_Name11 m32 : 104|8@1+ (1,0) [0|0] "" HMDH_202
 SG_ Saf_Name12 m32 : 112|8@1+ (1,0) [0|0] "" HMDH_202
 SG_ Saf_Name13 m32 : 120|8@1+ (1,0) [0|0] "" HMDH_202
 SG_ Saf_Name14 m32 : 128|8@1+ (1,0) [0|0] "" HMDH_202
 SG_ Saf_Name15 m32 : 136|8@1+ (1,0) [0|0] "" HMDH_202
 SG_ Saf_State m32 : 144|8@1+ (1,0) [0|0] "" HMDH_202
 SG_ Saf_Bits m32 : 152|16@1+ (1,0) [0|0] "" HMDH_202
 SG_ Saf_Estop m32 : 168|8@1+ (1,0) [0|0] "" HMDH_202
 SG_ Saf_FatalLatched m32 : 176|16@1+ (1,0) [0|0] "" HMDH_202
 SG_ Saf_ErrCode m32 : 192|32@1+ (1,0) [0|0] "" HMDH_202

BO_ 2163308747 STATUS_HETC_L_ARM_to_HMDH_203: 48 HETC_L_ARM
 SG_ SubCode M : 0|8@1+ (1,0) [0|0] "" HMDH_203
 SG_ Ping_CanId m5 : 8|8@1+ (1,0) [0|0] "" HMDH_203
 SG_ Ping_HostId m5 : 16|8@1+ (1,0) [0|0] "" HMDH_203
 SG_ Ping_Pid m5 : 24|16@1+ (1,0) [0|0] "" HMDH_203
 SG_ Ping_Bid m5 : 40|16@1+ (1,0) [0|0] "" HMDH_203
 SG_ Ping_Mid m5 : 56|16@1+ (1,0) [0|0] "" HMDH_203
 SG_ Ping_VerMajor m5 : 72|8@1+ (1,0) [0|0] "" HMDH_203
 SG_ Ping_VerMinor m5 : 80|8@1+ (1,0) [0|0] "" HMDH_203
 SG_ Ping_VerPatch m5 : 88|8@1+ (1,0) [0|0] "" HMDH_203
 SG_ Ping_Name0 m5 : 96|8@1+ (1,0) [0|0] "" HMDH_203
 SG_ Ping_Name1 m5 : 104|8@1+ (1,0) [0|0] "" HMDH_203
 SG_ Ping_Name2 m5 : 112|8@1+ (1,0) [0|0] "" HMDH_203
 SG_ Ping_Name3 m5 : 120|8@1+ (1,0) [0|0] "" HMDH_203
 SG_ Ping_Name4 m5 : 128|8@1+ (1,0) [0|0] "" HMDH_203
 SG_ Ping_Name5 m5 : 136|8@1+ (1,0) [0|0] "" HMDH_203
 SG_ Ping_Name6 m5 : 144|8@1+ (1,0) [0|0] "" HMDH_203
 SG_ Ping_Name7 m5 : 152|8@1+ (1,0) [0|0] "" HMDH_203
 SG_ Ping_Name8 m5 : 160|8@1+ (1,0) [0|0] "" HMDH_203
 SG_ Ping_Name9 m5 : 168|8@1+ (1,0) [0|0] "" HMDH_203
 SG_ Ping_Name10 m5 : 176|8@1+ (1,0) [0|0] "" HMDH_203
 SG_ Ping_Name11 m5 : 184|8@1+ (1,0) [0|0] "" HMDH_203
 SG_ Ping_Name12 m5 : 192|8@1+ (1,0) [0|0] "" HMDH_203
 SG_ Ping_Name13 m5 : 200|8@1+ (1,0) [0|0] "" HMDH_203
 SG_ Ping_Name14 m5 : 208|8@1+ (1,0) [0|0] "" HMDH_203
 SG_ Ping_Name15 m5 : 216|8@1+ (1,0) [0|0] "" HMDH_203
 SG_ Ping_FmtVer m5 : 224|8@1+ (1,0) [0|0] "" HMDH_203
 SG_ Ping_GitRev m5 : 232|32@1+ (1,0) [0|0] "" HMDH_203
 SG_ Ping_FwCrc m5 : 264|16@1+ (1,0) [0|0] "" HMDH_203
 SG_ Ping_UptimeS m5 : 280|16@1+ (1,0) [0|0] "s" HMDH_203
 SG_ Ecat_CanId m31 : 8|8@1+ (1,0) [0|0] "" HMDH_203
 SG_ Ecat_Name0 m31 : 16|8@1+ (1,0) [0|0] "" HMDH_203
 SG_ Ecat_Name1 m31 : 24|8@1+ (1,0) [0|0] "" HMDH_203
 SG_ Ecat_Name2 m31 : 32|8@1+ (1,0) [0|0] "" HMDH_203
 SG_ Ecat_Name3 m31 : 40|8@1+ (1,0) [0|0] "" HMDH_203
 SG_ Ecat_Name4 m31 : 48|8@1+ (1,0) [0|0] "" HMDH_203
 SG_ Ecat_Name5 m31 : 56|8@1+ (1,0) [0|0] "" HMDH_203
 SG_ Ecat_Name6 m31 : 64|8@1+ (1,0) [0|0] "" HMDH_203
 SG_ Ecat_Name7 m31 : 72|8@1+ (1,0) [0|0] "" HMDH_203
 SG_ Ecat_Name8 m31 : 80|8@1+ (1,0) [0|0] "" HMDH_203
 SG_ Ecat_Name9 m31 : 88|8@1+ (1,0) [0|0] "" HMDH_203
 SG_ Ecat_Name10 m31 : 96|8@1+ (1,0) [0|0] "" HMDH_203
 SG_ Ecat_Name11 m31 : 104|8@1+ (1,0) [0|0] "" HMDH_203
 SG_ Ecat_Name12 m31 : 112|8@1+ (1,0) [0|0] "" HMDH_203
 SG_ Ecat_Name13 m31 : 120|8@1+ (1,0) [0|0] "" HMDH_203
 SG_ Ecat_Name14 m31 : 128|8@1+ (1,0) [0|0] "" HMDH_203
 SG_ Ecat_Name15 m31 : 136|8@1+ (1,0) [0|0] "" HMDH_203
 SG_ Ecat_Link m31 : 144|8@1+ (1,0) [0|0] "" HMDH_203
 SG_ Ecat_InvalidFrame0 m31 : 152|8@1+ (1,0) [0|0] "" HMDH_203
 SG_ Ecat_InvalidFrame1 m31 : 160|8@1+ (1,0) [0|0] "" HMDH_203
 SG_ Ecat_InvalidFrame2 m31 : 168|8@1+ (1,0) [0|0] "" HMDH_203
 SG_ Ecat_InvalidFrame3 m31 : 176|8@1+ (1,0) [0|0] "" HMDH_203
 SG_ Ecat_RxError0 m31 : 184|8@1+ (1,0) [0|0] "" HMDH_203
 SG_ Ecat_RxError1 m31 : 192|8@1+ (1,0) [0|0] "" HMDH_203
 SG_ Ecat_RxError2 m31 : 200|8@1+ (1,0) [0|0] "" HMDH_203
 SG_ Ecat_RxError3 m31 : 208|8@1+ (1,0) [0|0] "" HMDH_203
 SG_ Ecat_FwdRxError0 m31 : 216|8@1+ (1,0) [0|0] "" HMDH_203
 SG_ Ecat_FwdRxError1 m31 : 224|8@1+ (1,0) [0|0] "" HMDH_203
 SG_ Ecat_FwdRxError2 m31 : 232|8@1+ (1,0) [0|0] "" HMDH_203
 SG_ Ecat_FwdRxError3 m31 : 240|8@1+ (1,0) [0|0] "" HMDH_203
 SG_ Ecat_PuError m31 : 248|8@1+ (1,0) [0|0] "" HMDH_203
 SG_ Ecat_PdiError m31 : 256|8@1+ (1,0) [0|0] "" HMDH_203
 SG_ Ecat_LostLink0 m31 : 264|8@1+ (1,0) [0|0] "" HMDH_203
 SG_ Ecat_LostLink1 m31 : 272|8@1+ (1,0) [0|0] "" HMDH_203
 SG_ Ecat_LostLink2 m31 : 280|8@1+ (1,0) [0|0] "" HMDH_203
 SG_ Ecat_LostLink3 m31 : 288|8@1+ (1,0) [0|0] "" HMDH_203
 SG_ Saf_CanId m32 : 8|8@1+ (1,0) [0|0] "" HMDH_203
 SG_ Saf_Name0 m32 : 16|8@1+ (1,0) [0|0] "" HMDH_203
 SG_ Saf_Name1 m32 : 24|8@1+ (1,0) [0|0] "" HMDH_203
 SG_ Saf_Name2 m32 : 32|8@1+ (1,0) [0|0] "" HMDH_203
 SG_ Saf_Name3 m32 : 40|8@1+ (1,0) [0|0] "" HMDH_203
 SG_ Saf_Name4 m32 : 48|8@1+ (1,0) [0|0] "" HMDH_203
 SG_ Saf_Name5 m32 : 56|8@1+ (1,0) [0|0] "" HMDH_203
 SG_ Saf_Name6 m32 : 64|8@1+ (1,0) [0|0] "" HMDH_203
 SG_ Saf_Name7 m32 : 72|8@1+ (1,0) [0|0] "" HMDH_203
 SG_ Saf_Name8 m32 : 80|8@1+ (1,0) [0|0] "" HMDH_203
 SG_ Saf_Name9 m32 : 88|8@1+ (1,0) [0|0] "" HMDH_203
 SG_ Saf_Name10 m32 : 96|8@1+ (1,0) [0|0] "" HMDH_203
 SG_ Saf_Name11 m32 : 104|8@1+ (1,0) [0|0] "" HMDH_203
 SG_ Saf_Name12 m32 : 112|8@1+ (1,0) [0|0] "" HMDH_203
 SG_ Saf_Name13 m32 : 120|8@1+ (1,0) [0|0] "" HMDH_203
 SG_ Saf_Name14 m32 : 128|8@1+ (1,0) [0|0] "" HMDH_203
 SG_ Saf_Name15 m32 : 136|8@1+ (1,0) [0|0] "" HMDH_203
 SG_ Saf_State m32 : 144|8@1+ (1,0) [0|0] "" HMDH_203
 SG_ Saf_Bits m32 : 152|16@1+ (1,0) [0|0] "" HMDH_203
 SG_ Saf_Estop m32 : 168|8@1+ (1,0) [0|0] "" HMDH_203
 SG_ Saf_FatalLatched m32 : 176|16@1+ (1,0) [0|0] "" HMDH_203
 SG_ Saf_ErrCode m32 : 192|32@1+ (1,0) [0|0] "" HMDH_203

BO_ 2163308748 STATUS_HETC_L_ARM_to_HMDH_204: 48 HETC_L_ARM
 SG_ SubCode M : 0|8@1+ (1,0) [0|0] "" HMDH_204
 SG_ Ping_CanId m5 : 8|8@1+ (1,0) [0|0] "" HMDH_204
 SG_ Ping_HostId m5 : 16|8@1+ (1,0) [0|0] "" HMDH_204
 SG_ Ping_Pid m5 : 24|16@1+ (1,0) [0|0] "" HMDH_204
 SG_ Ping_Bid m5 : 40|16@1+ (1,0) [0|0] "" HMDH_204
 SG_ Ping_Mid m5 : 56|16@1+ (1,0) [0|0] "" HMDH_204
 SG_ Ping_VerMajor m5 : 72|8@1+ (1,0) [0|0] "" HMDH_204
 SG_ Ping_VerMinor m5 : 80|8@1+ (1,0) [0|0] "" HMDH_204
 SG_ Ping_VerPatch m5 : 88|8@1+ (1,0) [0|0] "" HMDH_204
 SG_ Ping_Name0 m5 : 96|8@1+ (1,0) [0|0] "" HMDH_204
 SG_ Ping_Name1 m5 : 104|8@1+ (1,0) [0|0] "" HMDH_204
 SG_ Ping_Name2 m5 : 112|8@1+ (1,0) [0|0] "" HMDH_204
 SG_ Ping_Name3 m5 : 120|8@1+ (1,0) [0|0] "" HMDH_204
 SG_ Ping_Name4 m5 : 128|8@1+ (1,0) [0|0] "" HMDH_204
 SG_ Ping_Name5 m5 : 136|8@1+ (1,0) [0|0] "" HMDH_204
 SG_ Ping_Name6 m5 : 144|8@1+ (1,0) [0|0] "" HMDH_204
 SG_ Ping_Name7 m5 : 152|8@1+ (1,0) [0|0] "" HMDH_204
 SG_ Ping_Name8 m5 : 160|8@1+ (1,0) [0|0] "" HMDH_204
 SG_ Ping_Name9 m5 : 168|8@1+ (1,0) [0|0] "" HMDH_204
 SG_ Ping_Name10 m5 : 176|8@1+ (1,0) [0|0] "" HMDH_204
 SG_ Ping_Name11 m5 : 184|8@1+ (1,0) [0|0] "" HMDH_204
 SG_ Ping_Name12 m5 : 192|8@1+ (1,0) [0|0] "" HMDH_204
 SG_ Ping_Name13 m5 : 200|8@1+ (1,0) [0|0] "" HMDH_204
 SG_ Ping_Name14 m5 : 208|8@1+ (1,0) [0|0] "" HMDH_204
 SG_ Ping_Name15 m5 : 216|8@1+ (1,0) [0|0] "" HMDH_204
 SG_ Ping_FmtVer m5 : 224|8@1+ (1,0) [0|0] "" HMDH_204
 SG_ Ping_GitRev m5 : 232|32@1+ (1,0) [0|0] "" HMDH_204
 SG_ Ping_FwCrc m5 : 264|16@1+ (1,0) [0|0] "" HMDH_204
 SG_ Ping_UptimeS m5 : 280|16@1+ (1,0) [0|0] "s" HMDH_204
 SG_ Ecat_CanId m31 : 8|8@1+ (1,0) [0|0] "" HMDH_204
 SG_ Ecat_Name0 m31 : 16|8@1+ (1,0) [0|0] "" HMDH_204
 SG_ Ecat_Name1 m31 : 24|8@1+ (1,0) [0|0] "" HMDH_204
 SG_ Ecat_Name2 m31 : 32|8@1+ (1,0) [0|0] "" HMDH_204
 SG_ Ecat_Name3 m31 : 40|8@1+ (1,0) [0|0] "" HMDH_204
 SG_ Ecat_Name4 m31 : 48|8@1+ (1,0) [0|0] "" HMDH_204
 SG_ Ecat_Name5 m31 : 56|8@1+ (1,0) [0|0] "" HMDH_204
 SG_ Ecat_Name6 m31 : 64|8@1+ (1,0) [0|0] "" HMDH_204
 SG_ Ecat_Name7 m31 : 72|8@1+ (1,0) [0|0] "" HMDH_204
 SG_ Ecat_Name8 m31 : 80|8@1+ (1,0) [0|0] "" HMDH_204
 SG_ Ecat_Name9 m31 : 88|8@1+ (1,0) [0|0] "" HMDH_204
 SG_ Ecat_Name10 m31 : 96|8@1+ (1,0) [0|0] "" HMDH_204
 SG_ Ecat_Name11 m31 : 104|8@1+ (1,0) [0|0] "" HMDH_204
 SG_ Ecat_Name12 m31 : 112|8@1+ (1,0) [0|0] "" HMDH_204
 SG_ Ecat_Name13 m31 : 120|8@1+ (1,0) [0|0] "" HMDH_204
 SG_ Ecat_Name14 m31 : 128|8@1+ (1,0) [0|0] "" HMDH_204
 SG_ Ecat_Name15 m31 : 136|8@1+ (1,0) [0|0] "" HMDH_204
 SG_ Ecat_Link m31 : 144|8@1+ (1,0) [0|0] "" HMDH_204
 SG_ Ecat_InvalidFrame0 m31 : 152|8@1+ (1,0) [0|0] "" HMDH_204
 SG_ Ecat_InvalidFrame1 m31 : 160|8@1+ (1,0) [0|0] "" HMDH_204
 SG_ Ecat_InvalidFrame2 m31 : 168|8@1+ (1,0) [0|0] "" HMDH_204
 SG_ Ecat_InvalidFrame3 m31 : 176|8@1+ (1,0) [0|0] "" HMDH_204
 SG_ Ecat_RxError0 m31 : 184|8@1+ (1,0) [0|0] "" HMDH_204
 SG_ Ecat_RxError1 m31 : 192|8@1+ (1,0) [0|0] "" HMDH_204
 SG_ Ecat_RxError2 m31 : 200|8@1+ (1,0) [0|0] "" HMDH_204
 SG_ Ecat_RxError3 m31 : 208|8@1+ (1,0) [0|0] "" HMDH_204
 SG_ Ecat_FwdRxError0 m31 : 216|8@1+ (1,0) [0|0] "" HMDH_204
 SG_ Ecat_FwdRxError1 m31 : 224|8@1+ (1,0) [0|0] "" HMDH_204
 SG_ Ecat_FwdRxError2 m31 : 232|8@1+ (1,0) [0|0] "" HMDH_204
 SG_ Ecat_FwdRxError3 m31 : 240|8@1+ (1,0) [0|0] "" HMDH_204
 SG_ Ecat_PuError m31 : 248|8@1+ (1,0) [0|0] "" HMDH_204
 SG_ Ecat_PdiError m31 : 256|8@1+ (1,0) [0|0] "" HMDH_204
 SG_ Ecat_LostLink0 m31 : 264|8@1+ (1,0) [0|0] "" HMDH_204
 SG_ Ecat_LostLink1 m31 : 272|8@1+ (1,0) [0|0] "" HMDH_204
 SG_ Ecat_LostLink2 m31 : 280|8@1+ (1,0) [0|0] "" HMDH_204
 SG_ Ecat_LostLink3 m31 : 288|8@1+ (1,0) [0|0] "" HMDH_204
 SG_ Saf_CanId m32 : 8|8@1+ (1,0) [0|0] "" HMDH_204
 SG_ Saf_Name0 m32 : 16|8@1+ (1,0) [0|0] "" HMDH_204
 SG_ Saf_Name1 m32 : 24|8@1+ (1,0) [0|0] "" HMDH_204
 SG_ Saf_Name2 m32 : 32|8@1+ (1,0) [0|0] "" HMDH_204
 SG_ Saf_Name3 m32 : 40|8@1+ (1,0) [0|0] "" HMDH_204
 SG_ Saf_Name4 m32 : 48|8@1+ (1,0) [0|0] "" HMDH_204
 SG_ Saf_Name5 m32 : 56|8@1+ (1,0) [0|0] "" HMDH_204
 SG_ Saf_Name6 m32 : 64|8@1+ (1,0) [0|0] "" HMDH_204
 SG_ Saf_Name7 m32 : 72|8@1+ (1,0) [0|0] "" HMDH_204
 SG_ Saf_Name8 m32 : 80|8@1+ (1,0) [0|0] "" HMDH_204
 SG_ Saf_Name9 m32 : 88|8@1+ (1,0) [0|0] "" HMDH_204
 SG_ Saf_Name10 m32 : 96|8@1+ (1,0) [0|0] "" HMDH_204
 SG_ Saf_Name11 m32 : 104|8@1+ (1,0) [0|0] "" HMDH_204
 SG_ Saf_Name12 m32 : 112|8@1+ (1,0) [0|0] "" HMDH_204
 SG_ Saf_Name13 m32 : 120|8@1+ (1,0) [0|0] "" HMDH_204
 SG_ Saf_Name14 m32 : 128|8@1+ (1,0) [0|0] "" HMDH_204
 SG_ Saf_Name15 m32 : 136|8@1+ (1,0) [0|0] "" HMDH_204
 SG_ Saf_State m32 : 144|8@1+ (1,0) [0|0] "" HMDH_204
 SG_ Saf_Bits m32 : 152|16@1+ (1,0) [0|0] "" HMDH_204
 SG_ Saf_Estop m32 : 168|8@1+ (1,0) [0|0] "" HMDH_204
 SG_ Saf_FatalLatched m32 : 176|16@1+ (1,0) [0|0] "" HMDH_204
 SG_ Saf_ErrCode m32 : 192|32@1+ (1,0) [0|0] "" HMDH_204

BO_ 2163308749 STATUS_HETC_L_ARM_to_HMDH_205: 48 HETC_L_ARM
 SG_ SubCode M : 0|8@1+ (1,0) [0|0] "" HMDH_205
 SG_ Ping_CanId m5 : 8|8@1+ (1,0) [0|0] "" HMDH_205
 SG_ Ping_HostId m5 : 16|8@1+ (1,0) [0|0] "" HMDH_205
 SG_ Ping_Pid m5 : 24|16@1+ (1,0) [0|0] "" HMDH_205
 SG_ Ping_Bid m5 : 40|16@1+ (1,0) [0|0] "" HMDH_205
 SG_ Ping_Mid m5 : 56|16@1+ (1,0) [0|0] "" HMDH_205
 SG_ Ping_VerMajor m5 : 72|8@1+ (1,0) [0|0] "" HMDH_205
 SG_ Ping_VerMinor m5 : 80|8@1+ (1,0) [0|0] "" HMDH_205
 SG_ Ping_VerPatch m5 : 88|8@1+ (1,0) [0|0] "" HMDH_205
 SG_ Ping_Name0 m5 : 96|8@1+ (1,0) [0|0] "" HMDH_205
 SG_ Ping_Name1 m5 : 104|8@1+ (1,0) [0|0] "" HMDH_205
 SG_ Ping_Name2 m5 : 112|8@1+ (1,0) [0|0] "" HMDH_205
 SG_ Ping_Name3 m5 : 120|8@1+ (1,0) [0|0] "" HMDH_205
 SG_ Ping_Name4 m5 : 128|8@1+ (1,0) [0|0] "" HMDH_205
 SG_ Ping_Name5 m5 : 136|8@1+ (1,0) [0|0] "" HMDH_205
 SG_ Ping_Name6 m5 : 144|8@1+ (1,0) [0|0] "" HMDH_205
 SG_ Ping_Name7 m5 : 152|8@1+ (1,0) [0|0] "" HMDH_205
 SG_ Ping_Name8 m5 : 160|8@1+ (1,0) [0|0] "" HMDH_205
 SG_ Ping_Name9 m5 : 168|8@1+ (1,0) [0|0] "" HMDH_205
 SG_ Ping_Name10 m5 : 176|8@1+ (1,0) [0|0] "" HMDH_205
 SG_ Ping_Name11 m5 : 184|8@1+ (1,0) [0|0] "" HMDH_205
 SG_ Ping_Name12 m5 : 192|8@1+ (1,0) [0|0] "" HMDH_205
 SG_ Ping_Name13 m5 : 200|8@1+ (1,0) [0|0] "" HMDH_205
 SG_ Ping_Name14 m5 : 208|8@1+ (1,0) [0|0] "" HMDH_205
 SG_ Ping_Name15 m5 : 216|8@1+ (1,0) [0|0] "" HMDH_205
 SG_ Ping_FmtVer m5 : 224|8@1+ (1,0) [0|0] "" HMDH_205
 SG_ Ping_GitRev m5 : 232|32@1+ (1,0) [0|0] "" HMDH_205
 SG_ Ping_FwCrc m5 : 264|16@1+ (1,0) [0|0] "" HMDH_205
 SG_ Ping_UptimeS m5 : 280|16@1+ (1,0) [0|0] "s" HMDH_205
 SG_ Ecat_CanId m31 : 8|8@1+ (1,0) [0|0] "" HMDH_205
 SG_ Ecat_Name0 m31 : 16|8@1+ (1,0) [0|0] "" HMDH_205
 SG_ Ecat_Name1 m31 : 24|8@1+ (1,0) [0|0] "" HMDH_205
 SG_ Ecat_Name2 m31 : 32|8@1+ (1,0) [0|0] "" HMDH_205
 SG_ Ecat_Name3 m31 : 40|8@1+ (1,0) [0|0] "" HMDH_205
 SG_ Ecat_Name4 m31 : 48|8@1+ (1,0) [0|0] "" HMDH_205
 SG_ Ecat_Name5 m31 : 56|8@1+ (1,0) [0|0] "" HMDH_205
 SG_ Ecat_Name6 m31 : 64|8@1+ (1,0) [0|0] "" HMDH_205
 SG_ Ecat_Name7 m31 : 72|8@1+ (1,0) [0|0] "" HMDH_205
 SG_ Ecat_Name8 m31 : 80|8@1+ (1,0) [0|0] "" HMDH_205
 SG_ Ecat_Name9 m31 : 88|8@1+ (1,0) [0|0] "" HMDH_205
 SG_ Ecat_Name10 m31 : 96|8@1+ (1,0) [0|0] "" HMDH_205
 SG_ Ecat_Name11 m31 : 104|8@1+ (1,0) [0|0] "" HMDH_205
 SG_ Ecat_Name12 m31 : 112|8@1+ (1,0) [0|0] "" HMDH_205
 SG_ Ecat_Name13 m31 : 120|8@1+ (1,0) [0|0] "" HMDH_205
 SG_ Ecat_Name14 m31 : 128|8@1+ (1,0) [0|0] "" HMDH_205
 SG_ Ecat_Name15 m31 : 136|8@1+ (1,0) [0|0] "" HMDH_205
 SG_ Ecat_Link m31 : 144|8@1+ (1,0) [0|0] "" HMDH_205
 SG_ Ecat_InvalidFrame0 m31 : 152|8@1+ (1,0) [0|0] "" HMDH_205
 SG_ Ecat_InvalidFrame1 m31 : 160|8@1+ (1,0) [0|0] "" HMDH_205
 SG_ Ecat_InvalidFrame2 m31 : 168|8@1+ (1,0) [0|0] "" HMDH_205
 SG_ Ecat_InvalidFrame3 m31 : 176|8@1+ (1,0) [0|0] "" HMDH_205
 SG_ Ecat_RxError0 m31 : 184|8@1+ (1,0) [0|0] "" HMDH_205
 SG_ Ecat_RxError1 m31 : 192|8@1+ (1,0) [0|0] "" HMDH_205
 SG_ Ecat_RxError2 m31 : 200|8@1+ (1,0) [0|0] "" HMDH_205
 SG_ Ecat_RxError3 m31 : 208|8@1+ (1,0) [0|0] "" HMDH_205
 SG_ Ecat_FwdRxError0 m31 : 216|8@1+ (1,0) [0|0] "" HMDH_205
 SG_ Ecat_FwdRxError1 m31 : 224|8@1+ (1,0) [0|0] "" HMDH_205
 SG_ Ecat_FwdRxError2 m31 : 232|8@1+ (1,0) [0|0] "" HMDH_205
 SG_ Ecat_FwdRxError3 m31 : 240|8@1+ (1,0) [0|0] "" HMDH_205
 SG_ Ecat_PuError m31 : 248|8@1+ (1,0) [0|0] "" HMDH_205
 SG_ Ecat_PdiError m31 : 256|8@1+ (1,0) [0|0] "" HMDH_205
 SG_ Ecat_LostLink0 m31 : 264|8@1+ (1,0) [0|0] "" HMDH_205
 SG_ Ecat_LostLink1 m31 : 272|8@1+ (1,0) [0|0] "" HMDH_205
 SG_ Ecat_LostLink2 m31 : 280|8@1+ (1,0) [0|0] "" HMDH_205
 SG_ Ecat_LostLink3 m31 : 288|8@1+ (1,0) [0|0] "" HMDH_205
 SG_ Saf_CanId m32 : 8|8@1+ (1,0) [0|0] "" HMDH_205
 SG_ Saf_Name0 m32 : 16|8@1+ (1,0) [0|0] "" HMDH_205
 SG_ Saf_Name1 m32 : 24|8@1+ (1,0) [0|0] "" HMDH_205
 SG_ Saf_Name2 m32 : 32|8@1+ (1,0) [0|0] "" HMDH_205
 SG_ Saf_Name3 m32 : 40|8@1+ (1,0) [0|0] "" HMDH_205
 SG_ Saf_Name4 m32 : 48|8@1+ (1,0) [0|0] "" HMDH_205
 SG_ Saf_Name5 m32 : 56|8@1+ (1,0) [0|0] "" HMDH_205
 SG_ Saf_Name6 m32 : 64|8@1+ (1,0) [0|0] "" HMDH_205
 SG_ Saf_Name7 m32 : 72|8@1+ (1,0) [0|0] "" HMDH_205
 SG_ Saf_Name8 m32 : 80|8@1+ (1,0) [0|0] "" HMDH_205
 SG_ Saf_Name9 m32 : 88|8@1+ (1,0) [0|0] "" HMDH_205
 SG_ Saf_Name10 m32 : 96|8@1+ (1,0) [0|0] "" HMDH_205
 SG_ Saf_Name11 m32 : 104|8@1+ (1,0) [0|0] "" HMDH_205
 SG_ Saf_Name12 m32 : 112|8@1+ (1,0) [0|0] "" HMDH_205
 SG_ Saf_Name13 m32 : 120|8@1+ (1,0) [0|0] "" HMDH_205
 SG_ Saf_Name14 m32 : 128|8@1+ (1,0) [0|0] "" HMDH_205
 SG_ Saf_Name15 m32 : 136|8@1+ (1,0) [0|0] "" HMDH_205
 SG_ Saf_State m32 : 144|8@1+ (1,0) [0|0] "" HMDH_205
 SG_ Saf_Bits m32 : 152|16@1+ (1,0) [0|0] "" HMDH_205
 SG_ Saf_Estop m32 : 168|8@1+ (1,0) [0|0] "" HMDH_205
 SG_ Saf_FatalLatched m32 : 176|16@1+ (1,0) [0|0] "" HMDH_205
 SG_ Saf_ErrCode m32 : 192|32@1+ (1,0) [0|0] "" HMDH_205

BO_ 2163308750 STATUS_HETC_L_ARM_to_HMDH_206: 48 HETC_L_ARM
 SG_ SubCode M : 0|8@1+ (1,0) [0|0] "" HMDH_206
 SG_ Ping_CanId m5 : 8|8@1+ (1,0) [0|0] "" HMDH_206
 SG_ Ping_HostId m5 : 16|8@1+ (1,0) [0|0] "" HMDH_206
 SG_ Ping_Pid m5 : 24|16@1+ (1,0) [0|0] "" HMDH_206
 SG_ Ping_Bid m5 : 40|16@1+ (1,0) [0|0] "" HMDH_206
 SG_ Ping_Mid m5 : 56|16@1+ (1,0) [0|0] "" HMDH_206
 SG_ Ping_VerMajor m5 : 72|8@1+ (1,0) [0|0] "" HMDH_206
 SG_ Ping_VerMinor m5 : 80|8@1+ (1,0) [0|0] "" HMDH_206
 SG_ Ping_VerPatch m5 : 88|8@1+ (1,0) [0|0] "" HMDH_206
 SG_ Ping_Name0 m5 : 96|8@1+ (1,0) [0|0] "" HMDH_206
 SG_ Ping_Name1 m5 : 104|8@1+ (1,0) [0|0] "" HMDH_206
 SG_ Ping_Name2 m5 : 112|8@1+ (1,0) [0|0] "" HMDH_206
 SG_ Ping_Name3 m5 : 120|8@1+ (1,0) [0|0] "" HMDH_206
 SG_ Ping_Name4 m5 : 128|8@1+ (1,0) [0|0] "" HMDH_206
 SG_ Ping_Name5 m5 : 136|8@1+ (1,0) [0|0] "" HMDH_206
 SG_ Ping_Name6 m5 : 144|8@1+ (1,0) [0|0] "" HMDH_206
 SG_ Ping_Name7 m5 : 152|8@1+ (1,0) [0|0] "" HMDH_206
 SG_ Ping_Name8 m5 : 160|8@1+ (1,0) [0|0] "" HMDH_206
 SG_ Ping_Name9 m5 : 168|8@1+ (1,0) [0|0] "" HMDH_206
 SG_ Ping_Name10 m5 : 176|8@1+ (1,0) [0|0] "" HMDH_206
 SG_ Ping_Name11 m5 : 184|8@1+ (1,0) [0|0] "" HMDH_206
 SG_ Ping_Name12 m5 : 192|8@1+ (1,0) [0|0] "" HMDH_206
 SG_ Ping_Name13 m5 : 200|8@1+ (1,0) [0|0] "" HMDH_206
 SG_ Ping_Name14 m5 : 208|8@1+ (1,0) [0|0] "" HMDH_206
 SG_ Ping_Name15 m5 : 216|8@1+ (1,0) [0|0] "" HMDH_206
 SG_ Ping_FmtVer m5 : 224|8@1+ (1,0) [0|0] "" HMDH_206
 SG_ Ping_GitRev m5 : 232|32@1+ (1,0) [0|0] "" HMDH_206
 SG_ Ping_FwCrc m5 : 264|16@1+ (1,0) [0|0] "" HMDH_206
 SG_ Ping_UptimeS m5 : 280|16@1+ (1,0) [0|0] "s" HMDH_206
 SG_ Ecat_CanId m31 : 8|8@1+ (1,0) [0|0] "" HMDH_206
 SG_ Ecat_Name0 m31 : 16|8@1+ (1,0) [0|0] "" HMDH_206
 SG_ Ecat_Name1 m31 : 24|8@1+ (1,0) [0|0] "" HMDH_206
 SG_ Ecat_Name2 m31 : 32|8@1+ (1,0) [0|0] "" HMDH_206
 SG_ Ecat_Name3 m31 : 40|8@1+ (1,0) [0|0] "" HMDH_206
 SG_ Ecat_Name4 m31 : 48|8@1+ (1,0) [0|0] "" HMDH_206
 SG_ Ecat_Name5 m31 : 56|8@1+ (1,0) [0|0] "" HMDH_206
 SG_ Ecat_Name6 m31 : 64|8@1+ (1,0) [0|0] "" HMDH_206
 SG_ Ecat_Name7 m31 : 72|8@1+ (1,0) [0|0] "" HMDH_206
 SG_ Ecat_Name8 m31 : 80|8@1+ (1,0) [0|0] "" HMDH_206
 SG_ Ecat_Name9 m31 : 88|8@1+ (1,0) [0|0] "" HMDH_206
 SG_ Ecat_Name10 m31 : 96|8@1+ (1,0) [0|0] "" HMDH_206
 SG_ Ecat_Name11 m31 : 104|8@1+ (1,0) [0|0] "" HMDH_206
 SG_ Ecat_Name12 m31 : 112|8@1+ (1,0) [0|0] "" HMDH_206
 SG_ Ecat_Name13 m31 : 120|8@1+ (1,0) [0|0] "" HMDH_206
 SG_ Ecat_Name14 m31 : 128|8@1+ (1,0) [0|0] "" HMDH_206
 SG_ Ecat_Name15 m31 : 136|8@1+ (1,0) [0|0] "" HMDH_206
 SG_ Ecat_Link m31 : 144|8@1+ (1,0) [0|0] "" HMDH_206
 SG_ Ecat_InvalidFrame0 m31 : 152|8@1+ (1,0) [0|0] "" HMDH_206
 SG_ Ecat_InvalidFrame1 m31 : 160|8@1+ (1,0) [0|0] "" HMDH_206
 SG_ Ecat_InvalidFrame2 m31 : 168|8@1+ (1,0) [0|0] "" HMDH_206
 SG_ Ecat_InvalidFrame3 m31 : 176|8@1+ (1,0) [0|0] "" HMDH_206
 SG_ Ecat_RxError0 m31 : 184|8@1+ (1,0) [0|0] "" HMDH_206
 SG_ Ecat_RxError1 m31 : 192|8@1+ (1,0) [0|0] "" HMDH_206
 SG_ Ecat_RxError2 m31 : 200|8@1+ (1,0) [0|0] "" HMDH_206
 SG_ Ecat_RxError3 m31 : 208|8@1+ (1,0) [0|0] "" HMDH_206
 SG_ Ecat_FwdRxError0 m31 : 216|8@1+ (1,0) [0|0] "" HMDH_206
 SG_ Ecat_FwdRxError1 m31 : 224|8@1+ (1,0) [0|0] "" HMDH_206
 SG_ Ecat_FwdRxError2 m31 : 232|8@1+ (1,0) [0|0] "" HMDH_206
 SG_ Ecat_FwdRxError3 m31 : 240|8@1+ (1,0) [0|0] "" HMDH_206
 SG_ Ecat_PuError m31 : 248|8@1+ (1,0) [0|0] "" HMDH_206
 SG_ Ecat_PdiError m31 : 256|8@1+ (1,0) [0|0] "" HMDH_206
 SG_ Ecat_LostLink0 m31 : 264|8@1+ (1,0) [0|0] "" HMDH_206
 SG_ Ecat_LostLink1 m31 : 272|8@1+ (1,0) [0|0] "" HMDH_206
 SG_ Ecat_LostLink2 m31 : 280|8@1+ (1,0) [0|0] "" HMDH_206
 SG_ Ecat_LostLink3 m31 : 288|8@1+ (1,0) [0|0] "" HMDH_206
 SG_ Saf_CanId m32 : 8|8@1+ (1,0) [0|0] "" HMDH_206
 SG_ Saf_Name0 m32 : 16|8@1+ (1,0) [0|0] "" HMDH_206
 SG_ Saf_Name1 m32 : 24|8@1+ (1,0) [0|0] "" HMDH_206
 SG_ Saf_Name2 m32 : 32|8@1+ (1,0) [0|0] "" HMDH_206
 SG_ Saf_Name3 m32 : 40|8@1+ (1,0) [0|0] "" HMDH_206
 SG_ Saf_Name4 m32 : 48|8@1+ (1,0) [0|0] "" HMDH_206
 SG_ Saf_Name5 m32 : 56|8@1+ (1,0) [0|0] "" HMDH_206
 SG_ Saf_Name6 m32 : 64|8@1+ (1,0) [0|0] "" HMDH_206
 SG_ Saf_Name7 m32 : 72|8@1+ (1,0) [0|0] "" HMDH_206
 SG_ Saf_Name8 m32 : 80|8@1+ (1,0) [0|0] "" HMDH_206
 SG_ Saf_Name9 m32 : 88|8@1+ (1,0) [0|0] "" HMDH_206
 SG_ Saf_Name10 m32 : 96|8@1+ (1,0) [0|0] "" HMDH_206
 SG_ Saf_Name11 m32 : 104|8@1+ (1,0) [0|0] "" HMDH_206
 SG_ Saf_Name12 m32 : 112|8@1+ (1,0) [0|0] "" HMDH_206
 SG_ Saf_Name13 m32 : 120|8@1+ (1,0) [0|0] "" HMDH_206
 SG_ Saf_Name14 m32 : 128|8@1+ (1,0) [0|0] "" HMDH_206
 SG_ Saf_Name15 m32 : 136|8@1+ (1,0) [0|0] "" HMDH_206
 SG_ Saf_State m32 : 144|8@1+ (1,0) [0|0] "" HMDH_206
 SG_ Saf_Bits m32 : 152|16@1+ (1,0) [0|0] "" HMDH_206
 SG_ Saf_Estop m32 : 168|8@1+ (1,0) [0|0] "" HMDH_206
 SG_ Saf_FatalLatched m32 : 176|16@1+ (1,0) [0|0] "" HMDH_206
 SG_ Saf_ErrCode m32 : 192|32@1+ (1,0) [0|0] "" HMDH_206

BO_ 2163308751 STATUS_HETC_L_ARM_to_HMDH_207: 48 HETC_L_ARM
 SG_ SubCode M : 0|8@1+ (1,0) [0|0] "" HMDH_207
 SG_ Ping_CanId m5 : 8|8@1+ (1,0) [0|0] "" HMDH_207
 SG_ Ping_HostId m5 : 16|8@1+ (1,0) [0|0] "" HMDH_207
 SG_ Ping_Pid m5 : 24|16@1+ (1,0) [0|0] "" HMDH_207
 SG_ Ping_Bid m5 : 40|16@1+ (1,0) [0|0] "" HMDH_207
 SG_ Ping_Mid m5 : 56|16@1+ (1,0) [0|0] "" HMDH_207
 SG_ Ping_VerMajor m5 : 72|8@1+ (1,0) [0|0] "" HMDH_207
 SG_ Ping_VerMinor m5 : 80|8@1+ (1,0) [0|0] "" HMDH_207
 SG_ Ping_VerPatch m5 : 88|8@1+ (1,0) [0|0] "" HMDH_207
 SG_ Ping_Name0 m5 : 96|8@1+ (1,0) [0|0] "" HMDH_207
 SG_ Ping_Name1 m5 : 104|8@1+ (1,0) [0|0] "" HMDH_207
 SG_ Ping_Name2 m5 : 112|8@1+ (1,0) [0|0] "" HMDH_207
 SG_ Ping_Name3 m5 : 120|8@1+ (1,0) [0|0] "" HMDH_207
 SG_ Ping_Name4 m5 : 128|8@1+ (1,0) [0|0] "" HMDH_207
 SG_ Ping_Name5 m5 : 136|8@1+ (1,0) [0|0] "" HMDH_207
 SG_ Ping_Name6 m5 : 144|8@1+ (1,0) [0|0] "" HMDH_207
 SG_ Ping_Name7 m5 : 152|8@1+ (1,0) [0|0] "" HMDH_207
 SG_ Ping_Name8 m5 : 160|8@1+ (1,0) [0|0] "" HMDH_207
 SG_ Ping_Name9 m5 : 168|8@1+ (1,0) [0|0] "" HMDH_207
 SG_ Ping_Name10 m5 : 176|8@1+ (1,0) [0|0] "" HMDH_207
 SG_ Ping_Name11 m5 : 184|8@1+ (1,0) [0|0] "" HMDH_207
 SG_ Ping_Name12 m5 : 192|8@1+ (1,0) [0|0] "" HMDH_207
 SG_ Ping_Name13 m5 : 200|8@1+ (1,0) [0|0] "" HMDH_207
 SG_ Ping_Name14 m5 : 208|8@1+ (1,0) [0|0] "" HMDH_207
 SG_ Ping_Name15 m5 : 216|8@1+ (1,0) [0|0] "" HMDH_207
 SG_ Ping_FmtVer m5 : 224|8@1+ (1,0) [0|0] "" HMDH_207
 SG_ Ping_GitRev m5 : 232|32@1+ (1,0) [0|0] "" HMDH_207
 SG_ Ping_FwCrc m5 : 264|16@1+ (1,0) [0|0] "" HMDH_207
 SG_ Ping_UptimeS m5 : 280|16@1+ (1,0) [0|0] "s" HMDH_207
 SG_ Ecat_CanId m31 : 8|8@1+ (1,0) [0|0] "" HMDH_207
 SG_ Ecat_Name0 m31 : 16|8@1+ (1,0) [0|0] "" HMDH_207
 SG_ Ecat_Name1 m31 : 24|8@1+ (1,0) [0|0] "" HMDH_207
 SG_ Ecat_Name2 m31 : 32|8@1+ (1,0) [0|0] "" HMDH_207
 SG_ Ecat_Name3 m31 : 40|8@1+ (1,0) [0|0] "" HMDH_207
 SG_ Ecat_Name4 m31 : 48|8@1+ (1,0) [0|0] "" HMDH_207
 SG_ Ecat_Name5 m31 : 56|8@1+ (1,0) [0|0] "" HMDH_207
 SG_ Ecat_Name6 m31 : 64|8@1+ (1,0) [0|0] "" HMDH_207
 SG_ Ecat_Name7 m31 : 72|8@1+ (1,0) [0|0] "" HMDH_207
 SG_ Ecat_Name8 m31 : 80|8@1+ (1,0) [0|0] "" HMDH_207
 SG_ Ecat_Name9 m31 : 88|8@1+ (1,0) [0|0] "" HMDH_207
 SG_ Ecat_Name10 m31 : 96|8@1+ (1,0) [0|0] "" HMDH_207
 SG_ Ecat_Name11 m31 : 104|8@1+ (1,0) [0|0] "" HMDH_207
 SG_ Ecat_Name12 m31 : 112|8@1+ (1,0) [0|0] "" HMDH_207
 SG_ Ecat_Name13 m31 : 120|8@1+ (1,0) [0|0] "" HMDH_207
 SG_ Ecat_Name14 m31 : 128|8@1+ (1,0) [0|0] "" HMDH_207
 SG_ Ecat_Name15 m31 : 136|8@1+ (1,0) [0|0] "" HMDH_207
 SG_ Ecat_Link m31 : 144|8@1+ (1,0) [0|0] "" HMDH_207
 SG_ Ecat_InvalidFrame0 m31 : 152|8@1+ (1,0) [0|0] "" HMDH_207
 SG_ Ecat_InvalidFrame1 m31 : 160|8@1+ (1,0) [0|0] "" HMDH_207
 SG_ Ecat_InvalidFrame2 m31 : 168|8@1+ (1,0) [0|0] "" HMDH_207
 SG_ Ecat_InvalidFrame3 m31 : 176|8@1+ (1,0) [0|0] "" HMDH_207
 SG_ Ecat_RxError0 m31 : 184|8@1+ (1,0) [0|0] "" HMDH_207
 SG_ Ecat_RxError1 m31 : 192|8@1+ (1,0) [0|0] "" HMDH_207
 SG_ Ecat_RxError2 m31 : 200|8@1+ (1,0) [0|0] "" HMDH_207
 SG_ Ecat_RxError3 m31 : 208|8@1+ (1,0) [0|0] "" HMDH_207
 SG_ Ecat_FwdRxError0 m31 : 216|8@1+ (1,0) [0|0] "" HMDH_207
 SG_ Ecat_FwdRxError1 m31 : 224|8@1+ (1,0) [0|0] "" HMDH_207
 SG_ Ecat_FwdRxError2 m31 : 232|8@1+ (1,0) [0|0] "" HMDH_207
 SG_ Ecat_FwdRxError3 m31 : 240|8@1+ (1,0) [0|0] "" HMDH_207
 SG_ Ecat_PuError m31 : 248|8@1+ (1,0) [0|0] "" HMDH_207
 SG_ Ecat_PdiError m31 : 256|8@1+ (1,0) [0|0] "" HMDH_207
 SG_ Ecat_LostLink0 m31 : 264|8@1+ (1,0) [0|0] "" HMDH_207
 SG_ Ecat_LostLink1 m31 : 272|8@1+ (1,0) [0|0] "" HMDH_207
 SG_ Ecat_LostLink2 m31 : 280|8@1+ (1,0) [0|0] "" HMDH_207
 SG_ Ecat_LostLink3 m31 : 288|8@1+ (1,0) [0|0] "" HMDH_207
 SG_ Saf_CanId m32 : 8|8@1+ (1,0) [0|0] "" HMDH_207
 SG_ Saf_Name0 m32 : 16|8@1+ (1,0) [0|0] "" HMDH_207
 SG_ Saf_Name1 m32 : 24|8@1+ (1,0) [0|0] "" HMDH_207
 SG_ Saf_Name2 m32 : 32|8@1+ (1,0) [0|0] "" HMDH_207
 SG_ Saf_Name3 m32 : 40|8@1+ (1,0) [0|0] "" HMDH_207
 SG_ Saf_Name4 m32 : 48|8@1+ (1,0) [0|0] "" HMDH_207
 SG_ Saf_Name5 m32 : 56|8@1+ (1,0) [0|0] "" HMDH_207
 SG_ Saf_Name6 m32 : 64|8@1+ (1,0) [0|0] "" HMDH_207
 SG_ Saf_Name7 m32 : 72|8@1+ (1,0) [0|0] "" HMDH_207
 SG_ Saf_Name8 m32 : 80|8@1+ (1,0) [0|0] "" HMDH_207
 SG_ Saf_Name9 m32 : 88|8@1+ (1,0) [0|0] "" HMDH_207
 SG_ Saf_Name10 m32 : 96|8@1+ (1,0) [0|0] "" HMDH_207
 SG_ Saf_Name11 m32 : 104|8@1+ (1,0) [0|0] "" HMDH_207
 SG_ Saf_Name12 m32 : 112|8@1+ (1,0) [0|0] "" HMDH_207
 SG_ Saf_Name13 m32 : 120|8@1+ (1,0) [0|0] "" HMDH_207
 SG_ Saf_Name14 m32 : 128|8@1+ (1,0) [0|0] "" HMDH_207
 SG_ Saf_Name15 m32 : 136|8@1+ (1,0) [0|0] "" HMDH_207
 SG_ Saf_State m32 : 144|8@1+ (1,0) [0|0] "" HMDH_207
 SG_ Saf_Bits m32 : 152|16@1+ (1,0) [0|0] "" HMDH_207
 SG_ Saf_Estop m32 : 168|8@1+ (1,0) [0|0] "" HMDH_207
 SG_ Saf_FatalLatched m32 : 176|16@1+ (1,0) [0|0] "" HMDH_207
 SG_ Saf_ErrCode m32 : 192|32@1+ (1,0) [0|0] "" HMDH_207

BO_ 2163311204 STATUS_HETC_L_TACT_to_HETC_M_MOB: 48 HETC_L_TACT
 SG_ SubCode M : 0|8@1+ (1,0) [0|0] "" HETC_M_MOB
 SG_ Ping_CanId m5 : 8|8@1+ (1,0) [0|0] "" HETC_M_MOB
 SG_ Ping_HostId m5 : 16|8@1+ (1,0) [0|0] "" HETC_M_MOB
 SG_ Ping_Pid m5 : 24|16@1+ (1,0) [0|0] "" HETC_M_MOB
 SG_ Ping_Bid m5 : 40|16@1+ (1,0) [0|0] "" HETC_M_MOB
 SG_ Ping_Mid m5 : 56|16@1+ (1,0) [0|0] "" HETC_M_MOB
 SG_ Ping_VerMajor m5 : 72|8@1+ (1,0) [0|0] "" HETC_M_MOB
 SG_ Ping_VerMinor m5 : 80|8@1+ (1,0) [0|0] "" HETC_M_MOB
 SG_ Ping_VerPatch m5 : 88|8@1+ (1,0) [0|0] "" HETC_M_MOB
 SG_ Ping_Name0 m5 : 96|8@1+ (1,0) [0|0] "" HETC_M_MOB
 SG_ Ping_Name1 m5 : 104|8@1+ (1,0) [0|0] "" HETC_M_MOB
 SG_ Ping_Name2 m5 : 112|8@1+ (1,0) [0|0] "" HETC_M_MOB
 SG_ Ping_Name3 m5 : 120|8@1+ (1,0) [0|0] "" HETC_M_MOB
 SG_ Ping_Name4 m5 : 128|8@1+ (1,0) [0|0] "" HETC_M_MOB
 SG_ Ping_Name5 m5 : 136|8@1+ (1,0) [0|0] "" HETC_M_MOB
 SG_ Ping_Name6 m5 : 144|8@1+ (1,0) [0|0] "" HETC_M_MOB
 SG_ Ping_Name7 m5 : 152|8@1+ (1,0) [0|0] "" HETC_M_MOB
 SG_ Ping_Name8 m5 : 160|8@1+ (1,0) [0|0] "" HETC_M_MOB
 SG_ Ping_Name9 m5 : 168|8@1+ (1,0) [0|0] "" HETC_M_MOB
 SG_ Ping_Name10 m5 : 176|8@1+ (1,0) [0|0] "" HETC_M_MOB
 SG_ Ping_Name11 m5 : 184|8@1+ (1,0) [0|0] "" HETC_M_MOB
 SG_ Ping_Name12 m5 : 192|8@1+ (1,0) [0|0] "" HETC_M_MOB
 SG_ Ping_Name13 m5 : 200|8@1+ (1,0) [0|0] "" HETC_M_MOB
 SG_ Ping_Name14 m5 : 208|8@1+ (1,0) [0|0] "" HETC_M_MOB
 SG_ Ping_Name15 m5 : 216|8@1+ (1,0) [0|0] "" HETC_M_MOB
 SG_ Ping_FmtVer m5 : 224|8@1+ (1,0) [0|0] "" HETC_M_MOB
 SG_ Ping_GitRev m5 : 232|32@1+ (1,0) [0|0] "" HETC_M_MOB
 SG_ Ping_FwCrc m5 : 264|16@1+ (1,0) [0|0] "" HETC_M_MOB
 SG_ Ping_UptimeS m5 : 280|16@1+ (1,0) [0|0] "s" HETC_M_MOB
 SG_ Ecat_CanId m31 : 8|8@1+ (1,0) [0|0] "" HETC_M_MOB
 SG_ Ecat_Name0 m31 : 16|8@1+ (1,0) [0|0] "" HETC_M_MOB
 SG_ Ecat_Name1 m31 : 24|8@1+ (1,0) [0|0] "" HETC_M_MOB
 SG_ Ecat_Name2 m31 : 32|8@1+ (1,0) [0|0] "" HETC_M_MOB
 SG_ Ecat_Name3 m31 : 40|8@1+ (1,0) [0|0] "" HETC_M_MOB
 SG_ Ecat_Name4 m31 : 48|8@1+ (1,0) [0|0] "" HETC_M_MOB
 SG_ Ecat_Name5 m31 : 56|8@1+ (1,0) [0|0] "" HETC_M_MOB
 SG_ Ecat_Name6 m31 : 64|8@1+ (1,0) [0|0] "" HETC_M_MOB
 SG_ Ecat_Name7 m31 : 72|8@1+ (1,0) [0|0] "" HETC_M_MOB
 SG_ Ecat_Name8 m31 : 80|8@1+ (1,0) [0|0] "" HETC_M_MOB
 SG_ Ecat_Name9 m31 : 88|8@1+ (1,0) [0|0] "" HETC_M_MOB
 SG_ Ecat_Name10 m31 : 96|8@1+ (1,0) [0|0] "" HETC_M_MOB
 SG_ Ecat_Name11 m31 : 104|8@1+ (1,0) [0|0] "" HETC_M_MOB
 SG_ Ecat_Name12 m31 : 112|8@1+ (1,0) [0|0] "" HETC_M_MOB
 SG_ Ecat_Name13 m31 : 120|8@1+ (1,0) [0|0] "" HETC_M_MOB
 SG_ Ecat_Name14 m31 : 128|8@1+ (1,0) [0|0] "" HETC_M_MOB
 SG_ Ecat_Name15 m31 : 136|8@1+ (1,0) [0|0] "" HETC_M_MOB
 SG_ Ecat_Link m31 : 144|8@1+ (1,0) [0|0] "" HETC_M_MOB
 SG_ Ecat_InvalidFrame0 m31 : 152|8@1+ (1,0) [0|0] "" HETC_M_MOB
 SG_ Ecat_InvalidFrame1 m31 : 160|8@1+ (1,0) [0|0] "" HETC_M_MOB
 SG_ Ecat_InvalidFrame2 m31 : 168|8@1+ (1,0) [0|0] "" HETC_M_MOB
 SG_ Ecat_InvalidFrame3 m31 : 176|8@1+ (1,0) [0|0] "" HETC_M_MOB
 SG_ Ecat_RxError0 m31 : 184|8@1+ (1,0) [0|0] "" HETC_M_MOB
 SG_ Ecat_RxError1 m31 : 192|8@1+ (1,0) [0|0] "" HETC_M_MOB
 SG_ Ecat_RxError2 m31 : 200|8@1+ (1,0) [0|0] "" HETC_M_MOB
 SG_ Ecat_RxError3 m31 : 208|8@1+ (1,0) [0|0] "" HETC_M_MOB
 SG_ Ecat_FwdRxError0 m31 : 216|8@1+ (1,0) [0|0] "" HETC_M_MOB
 SG_ Ecat_FwdRxError1 m31 : 224|8@1+ (1,0) [0|0] "" HETC_M_MOB
 SG_ Ecat_FwdRxError2 m31 : 232|8@1+ (1,0) [0|0] "" HETC_M_MOB
 SG_ Ecat_FwdRxError3 m31 : 240|8@1+ (1,0) [0|0] "" HETC_M_MOB
 SG_ Ecat_PuError m31 : 248|8@1+ (1,0) [0|0] "" HETC_M_MOB
 SG_ Ecat_PdiError m31 : 256|8@1+ (1,0) [0|0] "" HETC_M_MOB
 SG_ Ecat_LostLink0 m31 : 264|8@1+ (1,0) [0|0] "" HETC_M_MOB
 SG_ Ecat_LostLink1 m31 : 272|8@1+ (1,0) [0|0] "" HETC_M_MOB
 SG_ Ecat_LostLink2 m31 : 280|8@1+ (1,0) [0|0] "" HETC_M_MOB
 SG_ Ecat_LostLink3 m31 : 288|8@1+ (1,0) [0|0] "" HETC_M_MOB
 SG_ Saf_CanId m32 : 8|8@1+ (1,0) [0|0] "" HETC_M_MOB
 SG_ Saf_Name0 m32 : 16|8@1+ (1,0) [0|0] "" HETC_M_MOB
 SG_ Saf_Name1 m32 : 24|8@1+ (1,0) [0|0] "" HETC_M_MOB
 SG_ Saf_Name2 m32 : 32|8@1+ (1,0) [0|0] "" HETC_M_MOB
 SG_ Saf_Name3 m32 : 40|8@1+ (1,0) [0|0] "" HETC_M_MOB
 SG_ Saf_Name4 m32 : 48|8@1+ (1,0) [0|0] "" HETC_M_MOB
 SG_ Saf_Name5 m32 : 56|8@1+ (1,0) [0|0] "" HETC_M_MOB
 SG_ Saf_Name6 m32 : 64|8@1+ (1,0) [0|0] "" HETC_M_MOB
 SG_ Saf_Name7 m32 : 72|8@1+ (1,0) [0|0] "" HETC_M_MOB
 SG_ Saf_Name8 m32 : 80|8@1+ (1,0) [0|0] "" HETC_M_MOB
 SG_ Saf_Name9 m32 : 88|8@1+ (1,0) [0|0] "" HETC_M_MOB
 SG_ Saf_Name10 m32 : 96|8@1+ (1,0) [0|0] "" HETC_M_MOB
 SG_ Saf_Name11 m32 : 104|8@1+ (1,0) [0|0] "" HETC_M_MOB
 SG_ Saf_Name12 m32 : 112|8@1+ (1,0) [0|0] "" HETC_M_MOB
 SG_ Saf_Name13 m32 : 120|8@1+ (1,0) [0|0] "" HETC_M_MOB
 SG_ Saf_Name14 m32 : 128|8@1+ (1,0) [0|0] "" HETC_M_MOB
 SG_ Saf_Name15 m32 : 136|8@1+ (1,0) [0|0] "" HETC_M_MOB
 SG_ Saf_State m32 : 144|8@1+ (1,0) [0|0] "" HETC_M_MOB
 SG_ Saf_Bits m32 : 152|16@1+ (1,0) [0|0] "" HETC_M_MOB
 SG_ Saf_Estop m32 : 168|8@1+ (1,0) [0|0] "" HETC_M_MOB
 SG_ Saf_FatalLatched m32 : 176|16@1+ (1,0) [0|0] "" HETC_M_MOB
 SG_ Saf_ErrCode m32 : 192|32@1+ (1,0) [0|0] "" HETC_M_MOB

BO_ 2163311214 STATUS_HETC_L_TACT_to_HETC_M_WST: 48 HETC_L_TACT
 SG_ SubCode M : 0|8@1+ (1,0) [0|0] "" HETC_M_WST
 SG_ Ping_CanId m5 : 8|8@1+ (1,0) [0|0] "" HETC_M_WST
 SG_ Ping_HostId m5 : 16|8@1+ (1,0) [0|0] "" HETC_M_WST
 SG_ Ping_Pid m5 : 24|16@1+ (1,0) [0|0] "" HETC_M_WST
 SG_ Ping_Bid m5 : 40|16@1+ (1,0) [0|0] "" HETC_M_WST
 SG_ Ping_Mid m5 : 56|16@1+ (1,0) [0|0] "" HETC_M_WST
 SG_ Ping_VerMajor m5 : 72|8@1+ (1,0) [0|0] "" HETC_M_WST
 SG_ Ping_VerMinor m5 : 80|8@1+ (1,0) [0|0] "" HETC_M_WST
 SG_ Ping_VerPatch m5 : 88|8@1+ (1,0) [0|0] "" HETC_M_WST
 SG_ Ping_Name0 m5 : 96|8@1+ (1,0) [0|0] "" HETC_M_WST
 SG_ Ping_Name1 m5 : 104|8@1+ (1,0) [0|0] "" HETC_M_WST
 SG_ Ping_Name2 m5 : 112|8@1+ (1,0) [0|0] "" HETC_M_WST
 SG_ Ping_Name3 m5 : 120|8@1+ (1,0) [0|0] "" HETC_M_WST
 SG_ Ping_Name4 m5 : 128|8@1+ (1,0) [0|0] "" HETC_M_WST
 SG_ Ping_Name5 m5 : 136|8@1+ (1,0) [0|0] "" HETC_M_WST
 SG_ Ping_Name6 m5 : 144|8@1+ (1,0) [0|0] "" HETC_M_WST
 SG_ Ping_Name7 m5 : 152|8@1+ (1,0) [0|0] "" HETC_M_WST
 SG_ Ping_Name8 m5 : 160|8@1+ (1,0) [0|0] "" HETC_M_WST
 SG_ Ping_Name9 m5 : 168|8@1+ (1,0) [0|0] "" HETC_M_WST
 SG_ Ping_Name10 m5 : 176|8@1+ (1,0) [0|0] "" HETC_M_WST
 SG_ Ping_Name11 m5 : 184|8@1+ (1,0) [0|0] "" HETC_M_WST
 SG_ Ping_Name12 m5 : 192|8@1+ (1,0) [0|0] "" HETC_M_WST
 SG_ Ping_Name13 m5 : 200|8@1+ (1,0) [0|0] "" HETC_M_WST
 SG_ Ping_Name14 m5 : 208|8@1+ (1,0) [0|0] "" HETC_M_WST
 SG_ Ping_Name15 m5 : 216|8@1+ (1,0) [0|0] "" HETC_M_WST
 SG_ Ping_FmtVer m5 : 224|8@1+ (1,0) [0|0] "" HETC_M_WST
 SG_ Ping_GitRev m5 : 232|32@1+ (1,0) [0|0] "" HETC_M_WST
 SG_ Ping_FwCrc m5 : 264|16@1+ (1,0) [0|0] "" HETC_M_WST
 SG_ Ping_UptimeS m5 : 280|16@1+ (1,0) [0|0] "s" HETC_M_WST
 SG_ Ecat_CanId m31 : 8|8@1+ (1,0) [0|0] "" HETC_M_WST
 SG_ Ecat_Name0 m31 : 16|8@1+ (1,0) [0|0] "" HETC_M_WST
 SG_ Ecat_Name1 m31 : 24|8@1+ (1,0) [0|0] "" HETC_M_WST
 SG_ Ecat_Name2 m31 : 32|8@1+ (1,0) [0|0] "" HETC_M_WST
 SG_ Ecat_Name3 m31 : 40|8@1+ (1,0) [0|0] "" HETC_M_WST
 SG_ Ecat_Name4 m31 : 48|8@1+ (1,0) [0|0] "" HETC_M_WST
 SG_ Ecat_Name5 m31 : 56|8@1+ (1,0) [0|0] "" HETC_M_WST
 SG_ Ecat_Name6 m31 : 64|8@1+ (1,0) [0|0] "" HETC_M_WST
 SG_ Ecat_Name7 m31 : 72|8@1+ (1,0) [0|0] "" HETC_M_WST
 SG_ Ecat_Name8 m31 : 80|8@1+ (1,0) [0|0] "" HETC_M_WST
 SG_ Ecat_Name9 m31 : 88|8@1+ (1,0) [0|0] "" HETC_M_WST
 SG_ Ecat_Name10 m31 : 96|8@1+ (1,0) [0|0] "" HETC_M_WST
 SG_ Ecat_Name11 m31 : 104|8@1+ (1,0) [0|0] "" HETC_M_WST
 SG_ Ecat_Name12 m31 : 112|8@1+ (1,0) [0|0] "" HETC_M_WST
 SG_ Ecat_Name13 m31 : 120|8@1+ (1,0) [0|0] "" HETC_M_WST
 SG_ Ecat_Name14 m31 : 128|8@1+ (1,0) [0|0] "" HETC_M_WST
 SG_ Ecat_Name15 m31 : 136|8@1+ (1,0) [0|0] "" HETC_M_WST
 SG_ Ecat_Link m31 : 144|8@1+ (1,0) [0|0] "" HETC_M_WST
 SG_ Ecat_InvalidFrame0 m31 : 152|8@1+ (1,0) [0|0] "" HETC_M_WST
 SG_ Ecat_InvalidFrame1 m31 : 160|8@1+ (1,0) [0|0] "" HETC_M_WST
 SG_ Ecat_InvalidFrame2 m31 : 168|8@1+ (1,0) [0|0] "" HETC_M_WST
 SG_ Ecat_InvalidFrame3 m31 : 176|8@1+ (1,0) [0|0] "" HETC_M_WST
 SG_ Ecat_RxError0 m31 : 184|8@1+ (1,0) [0|0] "" HETC_M_WST
 SG_ Ecat_RxError1 m31 : 192|8@1+ (1,0) [0|0] "" HETC_M_WST
 SG_ Ecat_RxError2 m31 : 200|8@1+ (1,0) [0|0] "" HETC_M_WST
 SG_ Ecat_RxError3 m31 : 208|8@1+ (1,0) [0|0] "" HETC_M_WST
 SG_ Ecat_FwdRxError0 m31 : 216|8@1+ (1,0) [0|0] "" HETC_M_WST
 SG_ Ecat_FwdRxError1 m31 : 224|8@1+ (1,0) [0|0] "" HETC_M_WST
 SG_ Ecat_FwdRxError2 m31 : 232|8@1+ (1,0) [0|0] "" HETC_M_WST
 SG_ Ecat_FwdRxError3 m31 : 240|8@1+ (1,0) [0|0] "" HETC_M_WST
 SG_ Ecat_PuError m31 : 248|8@1+ (1,0) [0|0] "" HETC_M_WST
 SG_ Ecat_PdiError m31 : 256|8@1+ (1,0) [0|0] "" HETC_M_WST
 SG_ Ecat_LostLink0 m31 : 264|8@1+ (1,0) [0|0] "" HETC_M_WST
 SG_ Ecat_LostLink1 m31 : 272|8@1+ (1,0) [0|0] "" HETC_M_WST
 SG_ Ecat_LostLink2 m31 : 280|8@1+ (1,0) [0|0] "" HETC_M_WST
 SG_ Ecat_LostLink3 m31 : 288|8@1+ (1,0) [0|0] "" HETC_M_WST
 SG_ Saf_CanId m32 : 8|8@1+ (1,0) [0|0] "" HETC_M_WST
 SG_ Saf_Name0 m32 : 16|8@1+ (1,0) [0|0] "" HETC_M_WST
 SG_ Saf_Name1 m32 : 24|8@1+ (1,0) [0|0] "" HETC_M_WST
 SG_ Saf_Name2 m32 : 32|8@1+ (1,0) [0|0] "" HETC_M_WST
 SG_ Saf_Name3 m32 : 40|8@1+ (1,0) [0|0] "" HETC_M_WST
 SG_ Saf_Name4 m32 : 48|8@1+ (1,0) [0|0] "" HETC_M_WST
 SG_ Saf_Name5 m32 : 56|8@1+ (1,0) [0|0] "" HETC_M_WST
 SG_ Saf_Name6 m32 : 64|8@1+ (1,0) [0|0] "" HETC_M_WST
 SG_ Saf_Name7 m32 : 72|8@1+ (1,0) [0|0] "" HETC_M_WST
 SG_ Saf_Name8 m32 : 80|8@1+ (1,0) [0|0] "" HETC_M_WST
 SG_ Saf_Name9 m32 : 88|8@1+ (1,0) [0|0] "" HETC_M_WST
 SG_ Saf_Name10 m32 : 96|8@1+ (1,0) [0|0] "" HETC_M_WST
 SG_ Saf_Name11 m32 : 104|8@1+ (1,0) [0|0] "" HETC_M_WST
 SG_ Saf_Name12 m32 : 112|8@1+ (1,0) [0|0] "" HETC_M_WST
 SG_ Saf_Name13 m32 : 120|8@1+ (1,0) [0|0] "" HETC_M_WST
 SG_ Saf_Name14 m32 : 128|8@1+ (1,0) [0|0] "" HETC_M_WST
 SG_ Saf_Name15 m32 : 136|8@1+ (1,0) [0|0] "" HETC_M_WST
 SG_ Saf_State m32 : 144|8@1+ (1,0) [0|0] "" HETC_M_WST
 SG_ Saf_Bits m32 : 152|16@1+ (1,0) [0|0] "" HETC_M_WST
 SG_ Saf_Estop m32 : 168|8@1+ (1,0) [0|0] "" HETC_M_WST
 SG_ Saf_FatalLatched m32 : 176|16@1+ (1,0) [0|0] "" HETC_M_WST
 SG_ Saf_ErrCode m32 : 192|32@1+ (1,0) [0|0] "" HETC_M_WST

BO_ 2163311224 STATUS_HETC_L_TACT_to_HETC_L_ARM: 48 HETC_L_TACT
 SG_ SubCode M : 0|8@1+ (1,0) [0|0] "" HETC_L_ARM
 SG_ Ping_CanId m5 : 8|8@1+ (1,0) [0|0] "" HETC_L_ARM
 SG_ Ping_HostId m5 : 16|8@1+ (1,0) [0|0] "" HETC_L_ARM
 SG_ Ping_Pid m5 : 24|16@1+ (1,0) [0|0] "" HETC_L_ARM
 SG_ Ping_Bid m5 : 40|16@1+ (1,0) [0|0] "" HETC_L_ARM
 SG_ Ping_Mid m5 : 56|16@1+ (1,0) [0|0] "" HETC_L_ARM
 SG_ Ping_VerMajor m5 : 72|8@1+ (1,0) [0|0] "" HETC_L_ARM
 SG_ Ping_VerMinor m5 : 80|8@1+ (1,0) [0|0] "" HETC_L_ARM
 SG_ Ping_VerPatch m5 : 88|8@1+ (1,0) [0|0] "" HETC_L_ARM
 SG_ Ping_Name0 m5 : 96|8@1+ (1,0) [0|0] "" HETC_L_ARM
 SG_ Ping_Name1 m5 : 104|8@1+ (1,0) [0|0] "" HETC_L_ARM
 SG_ Ping_Name2 m5 : 112|8@1+ (1,0) [0|0] "" HETC_L_ARM
 SG_ Ping_Name3 m5 : 120|8@1+ (1,0) [0|0] "" HETC_L_ARM
 SG_ Ping_Name4 m5 : 128|8@1+ (1,0) [0|0] "" HETC_L_ARM
 SG_ Ping_Name5 m5 : 136|8@1+ (1,0) [0|0] "" HETC_L_ARM
 SG_ Ping_Name6 m5 : 144|8@1+ (1,0) [0|0] "" HETC_L_ARM
 SG_ Ping_Name7 m5 : 152|8@1+ (1,0) [0|0] "" HETC_L_ARM
 SG_ Ping_Name8 m5 : 160|8@1+ (1,0) [0|0] "" HETC_L_ARM
 SG_ Ping_Name9 m5 : 168|8@1+ (1,0) [0|0] "" HETC_L_ARM
 SG_ Ping_Name10 m5 : 176|8@1+ (1,0) [0|0] "" HETC_L_ARM
 SG_ Ping_Name11 m5 : 184|8@1+ (1,0) [0|0] "" HETC_L_ARM
 SG_ Ping_Name12 m5 : 192|8@1+ (1,0) [0|0] "" HETC_L_ARM
 SG_ Ping_Name13 m5 : 200|8@1+ (1,0) [0|0] "" HETC_L_ARM
 SG_ Ping_Name14 m5 : 208|8@1+ (1,0) [0|0] "" HETC_L_ARM
 SG_ Ping_Name15 m5 : 216|8@1+ (1,0) [0|0] "" HETC_L_ARM
 SG_ Ping_FmtVer m5 : 224|8@1+ (1,0) [0|0] "" HETC_L_ARM
 SG_ Ping_GitRev m5 : 232|32@1+ (1,0) [0|0] "" HETC_L_ARM
 SG_ Ping_FwCrc m5 : 264|16@1+ (1,0) [0|0] "" HETC_L_ARM
 SG_ Ping_UptimeS m5 : 280|16@1+ (1,0) [0|0] "s" HETC_L_ARM
 SG_ Ecat_CanId m31 : 8|8@1+ (1,0) [0|0] "" HETC_L_ARM
 SG_ Ecat_Name0 m31 : 16|8@1+ (1,0) [0|0] "" HETC_L_ARM
 SG_ Ecat_Name1 m31 : 24|8@1+ (1,0) [0|0] "" HETC_L_ARM
 SG_ Ecat_Name2 m31 : 32|8@1+ (1,0) [0|0] "" HETC_L_ARM
 SG_ Ecat_Name3 m31 : 40|8@1+ (1,0) [0|0] "" HETC_L_ARM
 SG_ Ecat_Name4 m31 : 48|8@1+ (1,0) [0|0] "" HETC_L_ARM
 SG_ Ecat_Name5 m31 : 56|8@1+ (1,0) [0|0] "" HETC_L_ARM
 SG_ Ecat_Name6 m31 : 64|8@1+ (1,0) [0|0] "" HETC_L_ARM
 SG_ Ecat_Name7 m31 : 72|8@1+ (1,0) [0|0] "" HETC_L_ARM
 SG_ Ecat_Name8 m31 : 80|8@1+ (1,0) [0|0] "" HETC_L_ARM
 SG_ Ecat_Name9 m31 : 88|8@1+ (1,0) [0|0] "" HETC_L_ARM
 SG_ Ecat_Name10 m31 : 96|8@1+ (1,0) [0|0] "" HETC_L_ARM
 SG_ Ecat_Name11 m31 : 104|8@1+ (1,0) [0|0] "" HETC_L_ARM
 SG_ Ecat_Name12 m31 : 112|8@1+ (1,0) [0|0] "" HETC_L_ARM
 SG_ Ecat_Name13 m31 : 120|8@1+ (1,0) [0|0] "" HETC_L_ARM
 SG_ Ecat_Name14 m31 : 128|8@1+ (1,0) [0|0] "" HETC_L_ARM
 SG_ Ecat_Name15 m31 : 136|8@1+ (1,0) [0|0] "" HETC_L_ARM
 SG_ Ecat_Link m31 : 144|8@1+ (1,0) [0|0] "" HETC_L_ARM
 SG_ Ecat_InvalidFrame0 m31 : 152|8@1+ (1,0) [0|0] "" HETC_L_ARM
 SG_ Ecat_InvalidFrame1 m31 : 160|8@1+ (1,0) [0|0] "" HETC_L_ARM
 SG_ Ecat_InvalidFrame2 m31 : 168|8@1+ (1,0) [0|0] "" HETC_L_ARM
 SG_ Ecat_InvalidFrame3 m31 : 176|8@1+ (1,0) [0|0] "" HETC_L_ARM
 SG_ Ecat_RxError0 m31 : 184|8@1+ (1,0) [0|0] "" HETC_L_ARM
 SG_ Ecat_RxError1 m31 : 192|8@1+ (1,0) [0|0] "" HETC_L_ARM
 SG_ Ecat_RxError2 m31 : 200|8@1+ (1,0) [0|0] "" HETC_L_ARM
 SG_ Ecat_RxError3 m31 : 208|8@1+ (1,0) [0|0] "" HETC_L_ARM
 SG_ Ecat_FwdRxError0 m31 : 216|8@1+ (1,0) [0|0] "" HETC_L_ARM
 SG_ Ecat_FwdRxError1 m31 : 224|8@1+ (1,0) [0|0] "" HETC_L_ARM
 SG_ Ecat_FwdRxError2 m31 : 232|8@1+ (1,0) [0|0] "" HETC_L_ARM
 SG_ Ecat_FwdRxError3 m31 : 240|8@1+ (1,0) [0|0] "" HETC_L_ARM
 SG_ Ecat_PuError m31 : 248|8@1+ (1,0) [0|0] "" HETC_L_ARM
 SG_ Ecat_PdiError m31 : 256|8@1+ (1,0) [0|0] "" HETC_L_ARM
 SG_ Ecat_LostLink0 m31 : 264|8@1+ (1,0) [0|0] "" HETC_L_ARM
 SG_ Ecat_LostLink1 m31 : 272|8@1+ (1,0) [0|0] "" HETC_L_ARM
 SG_ Ecat_LostLink2 m31 : 280|8@1+ (1,0) [0|0] "" HETC_L_ARM
 SG_ Ecat_LostLink3 m31 : 288|8@1+ (1,0) [0|0] "" HETC_L_ARM
 SG_ Saf_CanId m32 : 8|8@1+ (1,0) [0|0] "" HETC_L_ARM
 SG_ Saf_Name0 m32 : 16|8@1+ (1,0) [0|0] "" HETC_L_ARM
 SG_ Saf_Name1 m32 : 24|8@1+ (1,0) [0|0] "" HETC_L_ARM
 SG_ Saf_Name2 m32 : 32|8@1+ (1,0) [0|0] "" HETC_L_ARM
 SG_ Saf_Name3 m32 : 40|8@1+ (1,0) [0|0] "" HETC_L_ARM
 SG_ Saf_Name4 m32 : 48|8@1+ (1,0) [0|0] "" HETC_L_ARM
 SG_ Saf_Name5 m32 : 56|8@1+ (1,0) [0|0] "" HETC_L_ARM
 SG_ Saf_Name6 m32 : 64|8@1+ (1,0) [0|0] "" HETC_L_ARM
 SG_ Saf_Name7 m32 : 72|8@1+ (1,0) [0|0] "" HETC_L_ARM
 SG_ Saf_Name8 m32 : 80|8@1+ (1,0) [0|0] "" HETC_L_ARM
 SG_ Saf_Name9 m32 : 88|8@1+ (1,0) [0|0] "" HETC_L_ARM
 SG_ Saf_Name10 m32 : 96|8@1+ (1,0) [0|0] "" HETC_L_ARM
 SG_ Saf_Name11 m32 : 104|8@1+ (1,0) [0|0] "" HETC_L_ARM
 SG_ Saf_Name12 m32 : 112|8@1+ (1,0) [0|0] "" HETC_L_ARM
 SG_ Saf_Name13 m32 : 120|8@1+ (1,0) [0|0] "" HETC_L_ARM
 SG_ Saf_Name14 m32 : 128|8@1+ (1,0) [0|0] "" HETC_L_ARM
 SG_ Saf_Name15 m32 : 136|8@1+ (1,0) [0|0] "" HETC_L_ARM
 SG_ Saf_State m32 : 144|8@1+ (1,0) [0|0] "" HETC_L_ARM
 SG_ Saf_Bits m32 : 152|16@1+ (1,0) [0|0] "" HETC_L_ARM
 SG_ Saf_Estop m32 : 168|8@1+ (1,0) [0|0] "" HETC_L_ARM
 SG_ Saf_FatalLatched m32 : 176|16@1+ (1,0) [0|0] "" HETC_L_ARM
 SG_ Saf_ErrCode m32 : 192|32@1+ (1,0) [0|0] "" HETC_L_ARM

BO_ 2163311244 STATUS_HETC_L_TACT_to_HETC_R_ARM: 48 HETC_L_TACT
 SG_ SubCode M : 0|8@1+ (1,0) [0|0] "" HETC_R_ARM
 SG_ Ping_CanId m5 : 8|8@1+ (1,0) [0|0] "" HETC_R_ARM
 SG_ Ping_HostId m5 : 16|8@1+ (1,0) [0|0] "" HETC_R_ARM
 SG_ Ping_Pid m5 : 24|16@1+ (1,0) [0|0] "" HETC_R_ARM
 SG_ Ping_Bid m5 : 40|16@1+ (1,0) [0|0] "" HETC_R_ARM
 SG_ Ping_Mid m5 : 56|16@1+ (1,0) [0|0] "" HETC_R_ARM
 SG_ Ping_VerMajor m5 : 72|8@1+ (1,0) [0|0] "" HETC_R_ARM
 SG_ Ping_VerMinor m5 : 80|8@1+ (1,0) [0|0] "" HETC_R_ARM
 SG_ Ping_VerPatch m5 : 88|8@1+ (1,0) [0|0] "" HETC_R_ARM
 SG_ Ping_Name0 m5 : 96|8@1+ (1,0) [0|0] "" HETC_R_ARM
 SG_ Ping_Name1 m5 : 104|8@1+ (1,0) [0|0] "" HETC_R_ARM
 SG_ Ping_Name2 m5 : 112|8@1+ (1,0) [0|0] "" HETC_R_ARM
 SG_ Ping_Name3 m5 : 120|8@1+ (1,0) [0|0] "" HETC_R_ARM
 SG_ Ping_Name4 m5 : 128|8@1+ (1,0) [0|0] "" HETC_R_ARM
 SG_ Ping_Name5 m5 : 136|8@1+ (1,0) [0|0] "" HETC_R_ARM
 SG_ Ping_Name6 m5 : 144|8@1+ (1,0) [0|0] "" HETC_R_ARM
 SG_ Ping_Name7 m5 : 152|8@1+ (1,0) [0|0] "" HETC_R_ARM
 SG_ Ping_Name8 m5 : 160|8@1+ (1,0) [0|0] "" HETC_R_ARM
 SG_ Ping_Name9 m5 : 168|8@1+ (1,0) [0|0] "" HETC_R_ARM
 SG_ Ping_Name10 m5 : 176|8@1+ (1,0) [0|0] "" HETC_R_ARM
 SG_ Ping_Name11 m5 : 184|8@1+ (1,0) [0|0] "" HETC_R_ARM
 SG_ Ping_Name12 m5 : 192|8@1+ (1,0) [0|0] "" HETC_R_ARM
 SG_ Ping_Name13 m5 : 200|8@1+ (1,0) [0|0] "" HETC_R_ARM
 SG_ Ping_Name14 m5 : 208|8@1+ (1,0) [0|0] "" HETC_R_ARM
 SG_ Ping_Name15 m5 : 216|8@1+ (1,0) [0|0] "" HETC_R_ARM
 SG_ Ping_FmtVer m5 : 224|8@1+ (1,0) [0|0] "" HETC_R_ARM
 SG_ Ping_GitRev m5 : 232|32@1+ (1,0) [0|0] "" HETC_R_ARM
 SG_ Ping_FwCrc m5 : 264|16@1+ (1,0) [0|0] "" HETC_R_ARM
 SG_ Ping_UptimeS m5 : 280|16@1+ (1,0) [0|0] "s" HETC_R_ARM
 SG_ Ecat_CanId m31 : 8|8@1+ (1,0) [0|0] "" HETC_R_ARM
 SG_ Ecat_Name0 m31 : 16|8@1+ (1,0) [0|0] "" HETC_R_ARM
 SG_ Ecat_Name1 m31 : 24|8@1+ (1,0) [0|0] "" HETC_R_ARM
 SG_ Ecat_Name2 m31 : 32|8@1+ (1,0) [0|0] "" HETC_R_ARM
 SG_ Ecat_Name3 m31 : 40|8@1+ (1,0) [0|0] "" HETC_R_ARM
 SG_ Ecat_Name4 m31 : 48|8@1+ (1,0) [0|0] "" HETC_R_ARM
 SG_ Ecat_Name5 m31 : 56|8@1+ (1,0) [0|0] "" HETC_R_ARM
 SG_ Ecat_Name6 m31 : 64|8@1+ (1,0) [0|0] "" HETC_R_ARM
 SG_ Ecat_Name7 m31 : 72|8@1+ (1,0) [0|0] "" HETC_R_ARM
 SG_ Ecat_Name8 m31 : 80|8@1+ (1,0) [0|0] "" HETC_R_ARM
 SG_ Ecat_Name9 m31 : 88|8@1+ (1,0) [0|0] "" HETC_R_ARM
 SG_ Ecat_Name10 m31 : 96|8@1+ (1,0) [0|0] "" HETC_R_ARM
 SG_ Ecat_Name11 m31 : 104|8@1+ (1,0) [0|0] "" HETC_R_ARM
 SG_ Ecat_Name12 m31 : 112|8@1+ (1,0) [0|0] "" HETC_R_ARM
 SG_ Ecat_Name13 m31 : 120|8@1+ (1,0) [0|0] "" HETC_R_ARM
 SG_ Ecat_Name14 m31 : 128|8@1+ (1,0) [0|0] "" HETC_R_ARM
 SG_ Ecat_Name15 m31 : 136|8@1+ (1,0) [0|0] "" HETC_R_ARM
 SG_ Ecat_Link m31 : 144|8@1+ (1,0) [0|0] "" HETC_R_ARM
 SG_ Ecat_InvalidFrame0 m31 : 152|8@1+ (1,0) [0|0] "" HETC_R_ARM
 SG_ Ecat_InvalidFrame1 m31 : 160|8@1+ (1,0) [0|0] "" HETC_R_ARM
 SG_ Ecat_InvalidFrame2 m31 : 168|8@1+ (1,0) [0|0] "" HETC_R_ARM
 SG_ Ecat_InvalidFrame3 m31 : 176|8@1+ (1,0) [0|0] "" HETC_R_ARM
 SG_ Ecat_RxError0 m31 : 184|8@1+ (1,0) [0|0] "" HETC_R_ARM
 SG_ Ecat_RxError1 m31 : 192|8@1+ (1,0) [0|0] "" HETC_R_ARM
 SG_ Ecat_RxError2 m31 : 200|8@1+ (1,0) [0|0] "" HETC_R_ARM
 SG_ Ecat_RxError3 m31 : 208|8@1+ (1,0) [0|0] "" HETC_R_ARM
 SG_ Ecat_FwdRxError0 m31 : 216|8@1+ (1,0) [0|0] "" HETC_R_ARM
 SG_ Ecat_FwdRxError1 m31 : 224|8@1+ (1,0) [0|0] "" HETC_R_ARM
 SG_ Ecat_FwdRxError2 m31 : 232|8@1+ (1,0) [0|0] "" HETC_R_ARM
 SG_ Ecat_FwdRxError3 m31 : 240|8@1+ (1,0) [0|0] "" HETC_R_ARM
 SG_ Ecat_PuError m31 : 248|8@1+ (1,0) [0|0] "" HETC_R_ARM
 SG_ Ecat_PdiError m31 : 256|8@1+ (1,0) [0|0] "" HETC_R_ARM
 SG_ Ecat_LostLink0 m31 : 264|8@1+ (1,0) [0|0] "" HETC_R_ARM
 SG_ Ecat_LostLink1 m31 : 272|8@1+ (1,0) [0|0] "" HETC_R_ARM
 SG_ Ecat_LostLink2 m31 : 280|8@1+ (1,0) [0|0] "" HETC_R_ARM
 SG_ Ecat_LostLink3 m31 : 288|8@1+ (1,0) [0|0] "" HETC_R_ARM
 SG_ Saf_CanId m32 : 8|8@1+ (1,0) [0|0] "" HETC_R_ARM
 SG_ Saf_Name0 m32 : 16|8@1+ (1,0) [0|0] "" HETC_R_ARM
 SG_ Saf_Name1 m32 : 24|8@1+ (1,0) [0|0] "" HETC_R_ARM
 SG_ Saf_Name2 m32 : 32|8@1+ (1,0) [0|0] "" HETC_R_ARM
 SG_ Saf_Name3 m32 : 40|8@1+ (1,0) [0|0] "" HETC_R_ARM
 SG_ Saf_Name4 m32 : 48|8@1+ (1,0) [0|0] "" HETC_R_ARM
 SG_ Saf_Name5 m32 : 56|8@1+ (1,0) [0|0] "" HETC_R_ARM
 SG_ Saf_Name6 m32 : 64|8@1+ (1,0) [0|0] "" HETC_R_ARM
 SG_ Saf_Name7 m32 : 72|8@1+ (1,0) [0|0] "" HETC_R_ARM
 SG_ Saf_Name8 m32 : 80|8@1+ (1,0) [0|0] "" HETC_R_ARM
 SG_ Saf_Name9 m32 : 88|8@1+ (1,0) [0|0] "" HETC_R_ARM
 SG_ Saf_Name10 m32 : 96|8@1+ (1,0) [0|0] "" HETC_R_ARM
 SG_ Saf_Name11 m32 : 104|8@1+ (1,0) [0|0] "" HETC_R_ARM
 SG_ Saf_Name12 m32 : 112|8@1+ (1,0) [0|0] "" HETC_R_ARM
 SG_ Saf_Name13 m32 : 120|8@1+ (1,0) [0|0] "" HETC_R_ARM
 SG_ Saf_Name14 m32 : 128|8@1+ (1,0) [0|0] "" HETC_R_ARM
 SG_ Saf_Name15 m32 : 136|8@1+ (1,0) [0|0] "" HETC_R_ARM
 SG_ Saf_State m32 : 144|8@1+ (1,0) [0|0] "" HETC_R_ARM
 SG_ Saf_Bits m32 : 152|16@1+ (1,0) [0|0] "" HETC_R_ARM
 SG_ Saf_Estop m32 : 168|8@1+ (1,0) [0|0] "" HETC_R_ARM
 SG_ Saf_FatalLatched m32 : 176|16@1+ (1,0) [0|0] "" HETC_R_ARM
 SG_ Saf_ErrCode m32 : 192|32@1+ (1,0) [0|0] "" HETC_R_ARM

BO_ 2163311254 STATUS_HETC_L_TACT_to_HETC_R_TACT: 48 HETC_L_TACT
 SG_ SubCode M : 0|8@1+ (1,0) [0|0] "" HETC_R_TACT
 SG_ Ping_CanId m5 : 8|8@1+ (1,0) [0|0] "" HETC_R_TACT
 SG_ Ping_HostId m5 : 16|8@1+ (1,0) [0|0] "" HETC_R_TACT
 SG_ Ping_Pid m5 : 24|16@1+ (1,0) [0|0] "" HETC_R_TACT
 SG_ Ping_Bid m5 : 40|16@1+ (1,0) [0|0] "" HETC_R_TACT
 SG_ Ping_Mid m5 : 56|16@1+ (1,0) [0|0] "" HETC_R_TACT
 SG_ Ping_VerMajor m5 : 72|8@1+ (1,0) [0|0] "" HETC_R_TACT
 SG_ Ping_VerMinor m5 : 80|8@1+ (1,0) [0|0] "" HETC_R_TACT
 SG_ Ping_VerPatch m5 : 88|8@1+ (1,0) [0|0] "" HETC_R_TACT
 SG_ Ping_Name0 m5 : 96|8@1+ (1,0) [0|0] "" HETC_R_TACT
 SG_ Ping_Name1 m5 : 104|8@1+ (1,0) [0|0] "" HETC_R_TACT
 SG_ Ping_Name2 m5 : 112|8@1+ (1,0) [0|0] "" HETC_R_TACT
 SG_ Ping_Name3 m5 : 120|8@1+ (1,0) [0|0] "" HETC_R_TACT
 SG_ Ping_Name4 m5 : 128|8@1+ (1,0) [0|0] "" HETC_R_TACT
 SG_ Ping_Name5 m5 : 136|8@1+ (1,0) [0|0] "" HETC_R_TACT
 SG_ Ping_Name6 m5 : 144|8@1+ (1,0) [0|0] "" HETC_R_TACT
 SG_ Ping_Name7 m5 : 152|8@1+ (1,0) [0|0] "" HETC_R_TACT
 SG_ Ping_Name8 m5 : 160|8@1+ (1,0) [0|0] "" HETC_R_TACT
 SG_ Ping_Name9 m5 : 168|8@1+ (1,0) [0|0] "" HETC_R_TACT
 SG_ Ping_Name10 m5 : 176|8@1+ (1,0) [0|0] "" HETC_R_TACT
 SG_ Ping_Name11 m5 : 184|8@1+ (1,0) [0|0] "" HETC_R_TACT
 SG_ Ping_Name12 m5 : 192|8@1+ (1,0) [0|0] "" HETC_R_TACT
 SG_ Ping_Name13 m5 : 200|8@1+ (1,0) [0|0] "" HETC_R_TACT
 SG_ Ping_Name14 m5 : 208|8@1+ (1,0) [0|0] "" HETC_R_TACT
 SG_ Ping_Name15 m5 : 216|8@1+ (1,0) [0|0] "" HETC_R_TACT
 SG_ Ping_FmtVer m5 : 224|8@1+ (1,0) [0|0] "" HETC_R_TACT
 SG_ Ping_GitRev m5 : 232|32@1+ (1,0) [0|0] "" HETC_R_TACT
 SG_ Ping_FwCrc m5 : 264|16@1+ (1,0) [0|0] "" HETC_R_TACT
 SG_ Ping_UptimeS m5 : 280|16@1+ (1,0) [0|0] "s" HETC_R_TACT
 SG_ Ecat_CanId m31 : 8|8@1+ (1,0) [0|0] "" HETC_R_TACT
 SG_ Ecat_Name0 m31 : 16|8@1+ (1,0) [0|0] "" HETC_R_TACT
 SG_ Ecat_Name1 m31 : 24|8@1+ (1,0) [0|0] "" HETC_R_TACT
 SG_ Ecat_Name2 m31 : 32|8@1+ (1,0) [0|0] "" HETC_R_TACT
 SG_ Ecat_Name3 m31 : 40|8@1+ (1,0) [0|0] "" HETC_R_TACT
 SG_ Ecat_Name4 m31 : 48|8@1+ (1,0) [0|0] "" HETC_R_TACT
 SG_ Ecat_Name5 m31 : 56|8@1+ (1,0) [0|0] "" HETC_R_TACT
 SG_ Ecat_Name6 m31 : 64|8@1+ (1,0) [0|0] "" HETC_R_TACT
 SG_ Ecat_Name7 m31 : 72|8@1+ (1,0) [0|0] "" HETC_R_TACT
 SG_ Ecat_Name8 m31 : 80|8@1+ (1,0) [0|0] "" HETC_R_TACT
 SG_ Ecat_Name9 m31 : 88|8@1+ (1,0) [0|0] "" HETC_R_TACT
 SG_ Ecat_Name10 m31 : 96|8@1+ (1,0) [0|0] "" HETC_R_TACT
 SG_ Ecat_Name11 m31 : 104|8@1+ (1,0) [0|0] "" HETC_R_TACT
 SG_ Ecat_Name12 m31 : 112|8@1+ (1,0) [0|0] "" HETC_R_TACT
 SG_ Ecat_Name13 m31 : 120|8@1+ (1,0) [0|0] "" HETC_R_TACT
 SG_ Ecat_Name14 m31 : 128|8@1+ (1,0) [0|0] "" HETC_R_TACT
 SG_ Ecat_Name15 m31 : 136|8@1+ (1,0) [0|0] "" HETC_R_TACT
 SG_ Ecat_Link m31 : 144|8@1+ (1,0) [0|0] "" HETC_R_TACT
 SG_ Ecat_InvalidFrame0 m31 : 152|8@1+ (1,0) [0|0] "" HETC_R_TACT
 SG_ Ecat_InvalidFrame1 m31 : 160|8@1+ (1,0) [0|0] "" HETC_R_TACT
 SG_ Ecat_InvalidFrame2 m31 : 168|8@1+ (1,0) [0|0] "" HETC_R_TACT
 SG_ Ecat_InvalidFrame3 m31 : 176|8@1+ (1,0) [0|0] "" HETC_R_TACT
 SG_ Ecat_RxError0 m31 : 184|8@1+ (1,0) [0|0] "" HETC_R_TACT
 SG_ Ecat_RxError1 m31 : 192|8@1+ (1,0) [0|0] "" HETC_R_TACT
 SG_ Ecat_RxError2 m31 : 200|8@1+ (1,0) [0|0] "" HETC_R_TACT
 SG_ Ecat_RxError3 m31 : 208|8@1+ (1,0) [0|0] "" HETC_R_TACT
 SG_ Ecat_FwdRxError0 m31 : 216|8@1+ (1,0) [0|0] "" HETC_R_TACT
 SG_ Ecat_FwdRxError1 m31 : 224|8@1+ (1,0) [0|0] "" HETC_R_TACT
 SG_ Ecat_FwdRxError2 m31 : 232|8@1+ (1,0) [0|0] "" HETC_R_TACT
 SG_ Ecat_FwdRxError3 m31 : 240|8@1+ (1,0) [0|0] "" HETC_R_TACT
 SG_ Ecat_PuError m31 : 248|8@1+ (1,0) [0|0] "" HETC_R_TACT
 SG_ Ecat_PdiError m31 : 256|8@1+ (1,0) [0|0] "" HETC_R_TACT
 SG_ Ecat_LostLink0 m31 : 264|8@1+ (1,0) [0|0] "" HETC_R_TACT
 SG_ Ecat_LostLink1 m31 : 272|8@1+ (1,0) [0|0] "" HETC_R_TACT
 SG_ Ecat_LostLink2 m31 : 280|8@1+ (1,0) [0|0] "" HETC_R_TACT
 SG_ Ecat_LostLink3 m31 : 288|8@1+ (1,0) [0|0] "" HETC_R_TACT
 SG_ Saf_CanId m32 : 8|8@1+ (1,0) [0|0] "" HETC_R_TACT
 SG_ Saf_Name0 m32 : 16|8@1+ (1,0) [0|0] "" HETC_R_TACT
 SG_ Saf_Name1 m32 : 24|8@1+ (1,0) [0|0] "" HETC_R_TACT
 SG_ Saf_Name2 m32 : 32|8@1+ (1,0) [0|0] "" HETC_R_TACT
 SG_ Saf_Name3 m32 : 40|8@1+ (1,0) [0|0] "" HETC_R_TACT
 SG_ Saf_Name4 m32 : 48|8@1+ (1,0) [0|0] "" HETC_R_TACT
 SG_ Saf_Name5 m32 : 56|8@1+ (1,0) [0|0] "" HETC_R_TACT
 SG_ Saf_Name6 m32 : 64|8@1+ (1,0) [0|0] "" HETC_R_TACT
 SG_ Saf_Name7 m32 : 72|8@1+ (1,0) [0|0] "" HETC_R_TACT
 SG_ Saf_Name8 m32 : 80|8@1+ (1,0) [0|0] "" HETC_R_TACT
 SG_ Saf_Name9 m32 : 88|8@1+ (1,0) [0|0] "" HETC_R_TACT
 SG_ Saf_Name10 m32 : 96|8@1+ (1,0) [0|0] "" HETC_R_TACT
 SG_ Saf_Name11 m32 : 104|8@1+ (1,0) [0|0] "" HETC_R_TACT
 SG_ Saf_Name12 m32 : 112|8@1+ (1,0) [0|0] "" HETC_R_TACT
 SG_ Saf_Name13 m32 : 120|8@1+ (1,0) [0|0] "" HETC_R_TACT
 SG_ Saf_Name14 m32 : 128|8@1+ (1,0) [0|0] "" HETC_R_TACT
 SG_ Saf_Name15 m32 : 136|8@1+ (1,0) [0|0] "" HETC_R_TACT
 SG_ Saf_State m32 : 144|8@1+ (1,0) [0|0] "" HETC_R_TACT
 SG_ Saf_Bits m32 : 152|16@1+ (1,0) [0|0] "" HETC_R_TACT
 SG_ Saf_Estop m32 : 168|8@1+ (1,0) [0|0] "" HETC_R_TACT
 SG_ Saf_FatalLatched m32 : 176|16@1+ (1,0) [0|0] "" HETC_R_TACT
 SG_ Saf_ErrCode m32 : 192|32@1+ (1,0) [0|0] "" HETC_R_TACT

BO_ 2163311305 STATUS_HETC_L_TACT_to_HMDH_201: 48 HETC_L_TACT
 SG_ SubCode M : 0|8@1+ (1,0) [0|0] "" HMDH_201
 SG_ Ping_CanId m5 : 8|8@1+ (1,0) [0|0] "" HMDH_201
 SG_ Ping_HostId m5 : 16|8@1+ (1,0) [0|0] "" HMDH_201
 SG_ Ping_Pid m5 : 24|16@1+ (1,0) [0|0] "" HMDH_201
 SG_ Ping_Bid m5 : 40|16@1+ (1,0) [0|0] "" HMDH_201
 SG_ Ping_Mid m5 : 56|16@1+ (1,0) [0|0] "" HMDH_201
 SG_ Ping_VerMajor m5 : 72|8@1+ (1,0) [0|0] "" HMDH_201
 SG_ Ping_VerMinor m5 : 80|8@1+ (1,0) [0|0] "" HMDH_201
 SG_ Ping_VerPatch m5 : 88|8@1+ (1,0) [0|0] "" HMDH_201
 SG_ Ping_Name0 m5 : 96|8@1+ (1,0) [0|0] "" HMDH_201
 SG_ Ping_Name1 m5 : 104|8@1+ (1,0) [0|0] "" HMDH_201
 SG_ Ping_Name2 m5 : 112|8@1+ (1,0) [0|0] "" HMDH_201
 SG_ Ping_Name3 m5 : 120|8@1+ (1,0) [0|0] "" HMDH_201
 SG_ Ping_Name4 m5 : 128|8@1+ (1,0) [0|0] "" HMDH_201
 SG_ Ping_Name5 m5 : 136|8@1+ (1,0) [0|0] "" HMDH_201
 SG_ Ping_Name6 m5 : 144|8@1+ (1,0) [0|0] "" HMDH_201
 SG_ Ping_Name7 m5 : 152|8@1+ (1,0) [0|0] "" HMDH_201
 SG_ Ping_Name8 m5 : 160|8@1+ (1,0) [0|0] "" HMDH_201
 SG_ Ping_Name9 m5 : 168|8@1+ (1,0) [0|0] "" HMDH_201
 SG_ Ping_Name10 m5 : 176|8@1+ (1,0) [0|0] "" HMDH_201
 SG_ Ping_Name11 m5 : 184|8@1+ (1,0) [0|0] "" HMDH_201
 SG_ Ping_Name12 m5 : 192|8@1+ (1,0) [0|0] "" HMDH_201
 SG_ Ping_Name13 m5 : 200|8@1+ (1,0) [0|0] "" HMDH_201
 SG_ Ping_Name14 m5 : 208|8@1+ (1,0) [0|0] "" HMDH_201
 SG_ Ping_Name15 m5 : 216|8@1+ (1,0) [0|0] "" HMDH_201
 SG_ Ping_FmtVer m5 : 224|8@1+ (1,0) [0|0] "" HMDH_201
 SG_ Ping_GitRev m5 : 232|32@1+ (1,0) [0|0] "" HMDH_201
 SG_ Ping_FwCrc m5 : 264|16@1+ (1,0) [0|0] "" HMDH_201
 SG_ Ping_UptimeS m5 : 280|16@1+ (1,0) [0|0] "s" HMDH_201
 SG_ Ecat_CanId m31 : 8|8@1+ (1,0) [0|0] "" HMDH_201
 SG_ Ecat_Name0 m31 : 16|8@1+ (1,0) [0|0] "" HMDH_201
 SG_ Ecat_Name1 m31 : 24|8@1+ (1,0) [0|0] "" HMDH_201
 SG_ Ecat_Name2 m31 : 32|8@1+ (1,0) [0|0] "" HMDH_201
 SG_ Ecat_Name3 m31 : 40|8@1+ (1,0) [0|0] "" HMDH_201
 SG_ Ecat_Name4 m31 : 48|8@1+ (1,0) [0|0] "" HMDH_201
 SG_ Ecat_Name5 m31 : 56|8@1+ (1,0) [0|0] "" HMDH_201
 SG_ Ecat_Name6 m31 : 64|8@1+ (1,0) [0|0] "" HMDH_201
 SG_ Ecat_Name7 m31 : 72|8@1+ (1,0) [0|0] "" HMDH_201
 SG_ Ecat_Name8 m31 : 80|8@1+ (1,0) [0|0] "" HMDH_201
 SG_ Ecat_Name9 m31 : 88|8@1+ (1,0) [0|0] "" HMDH_201
 SG_ Ecat_Name10 m31 : 96|8@1+ (1,0) [0|0] "" HMDH_201
 SG_ Ecat_Name11 m31 : 104|8@1+ (1,0) [0|0] "" HMDH_201
 SG_ Ecat_Name12 m31 : 112|8@1+ (1,0) [0|0] "" HMDH_201
 SG_ Ecat_Name13 m31 : 120|8@1+ (1,0) [0|0] "" HMDH_201
 SG_ Ecat_Name14 m31 : 128|8@1+ (1,0) [0|0] "" HMDH_201
 SG_ Ecat_Name15 m31 : 136|8@1+ (1,0) [0|0] "" HMDH_201
 SG_ Ecat_Link m31 : 144|8@1+ (1,0) [0|0] "" HMDH_201
 SG_ Ecat_InvalidFrame0 m31 : 152|8@1+ (1,0) [0|0] "" HMDH_201
 SG_ Ecat_InvalidFrame1 m31 : 160|8@1+ (1,0) [0|0] "" HMDH_201
 SG_ Ecat_InvalidFrame2 m31 : 168|8@1+ (1,0) [0|0] "" HMDH_201
 SG_ Ecat_InvalidFrame3 m31 : 176|8@1+ (1,0) [0|0] "" HMDH_201
 SG_ Ecat_RxError0 m31 : 184|8@1+ (1,0) [0|0] "" HMDH_201
 SG_ Ecat_RxError1 m31 : 192|8@1+ (1,0) [0|0] "" HMDH_201
 SG_ Ecat_RxError2 m31 : 200|8@1+ (1,0) [0|0] "" HMDH_201
 SG_ Ecat_RxError3 m31 : 208|8@1+ (1,0) [0|0] "" HMDH_201
 SG_ Ecat_FwdRxError0 m31 : 216|8@1+ (1,0) [0|0] "" HMDH_201
 SG_ Ecat_FwdRxError1 m31 : 224|8@1+ (1,0) [0|0] "" HMDH_201
 SG_ Ecat_FwdRxError2 m31 : 232|8@1+ (1,0) [0|0] "" HMDH_201
 SG_ Ecat_FwdRxError3 m31 : 240|8@1+ (1,0) [0|0] "" HMDH_201
 SG_ Ecat_PuError m31 : 248|8@1+ (1,0) [0|0] "" HMDH_201
 SG_ Ecat_PdiError m31 : 256|8@1+ (1,0) [0|0] "" HMDH_201
 SG_ Ecat_LostLink0 m31 : 264|8@1+ (1,0) [0|0] "" HMDH_201
 SG_ Ecat_LostLink1 m31 : 272|8@1+ (1,0) [0|0] "" HMDH_201
 SG_ Ecat_LostLink2 m31 : 280|8@1+ (1,0) [0|0] "" HMDH_201
 SG_ Ecat_LostLink3 m31 : 288|8@1+ (1,0) [0|0] "" HMDH_201
 SG_ Saf_CanId m32 : 8|8@1+ (1,0) [0|0] "" HMDH_201
 SG_ Saf_Name0 m32 : 16|8@1+ (1,0) [0|0] "" HMDH_201
 SG_ Saf_Name1 m32 : 24|8@1+ (1,0) [0|0] "" HMDH_201
 SG_ Saf_Name2 m32 : 32|8@1+ (1,0) [0|0] "" HMDH_201
 SG_ Saf_Name3 m32 : 40|8@1+ (1,0) [0|0] "" HMDH_201
 SG_ Saf_Name4 m32 : 48|8@1+ (1,0) [0|0] "" HMDH_201
 SG_ Saf_Name5 m32 : 56|8@1+ (1,0) [0|0] "" HMDH_201
 SG_ Saf_Name6 m32 : 64|8@1+ (1,0) [0|0] "" HMDH_201
 SG_ Saf_Name7 m32 : 72|8@1+ (1,0) [0|0] "" HMDH_201
 SG_ Saf_Name8 m32 : 80|8@1+ (1,0) [0|0] "" HMDH_201
 SG_ Saf_Name9 m32 : 88|8@1+ (1,0) [0|0] "" HMDH_201
 SG_ Saf_Name10 m32 : 96|8@1+ (1,0) [0|0] "" HMDH_201
 SG_ Saf_Name11 m32 : 104|8@1+ (1,0) [0|0] "" HMDH_201
 SG_ Saf_Name12 m32 : 112|8@1+ (1,0) [0|0] "" HMDH_201
 SG_ Saf_Name13 m32 : 120|8@1+ (1,0) [0|0] "" HMDH_201
 SG_ Saf_Name14 m32 : 128|8@1+ (1,0) [0|0] "" HMDH_201
 SG_ Saf_Name15 m32 : 136|8@1+ (1,0) [0|0] "" HMDH_201
 SG_ Saf_State m32 : 144|8@1+ (1,0) [0|0] "" HMDH_201
 SG_ Saf_Bits m32 : 152|16@1+ (1,0) [0|0] "" HMDH_201
 SG_ Saf_Estop m32 : 168|8@1+ (1,0) [0|0] "" HMDH_201
 SG_ Saf_FatalLatched m32 : 176|16@1+ (1,0) [0|0] "" HMDH_201
 SG_ Saf_ErrCode m32 : 192|32@1+ (1,0) [0|0] "" HMDH_201

BO_ 2163311306 STATUS_HETC_L_TACT_to_HMDH_202: 48 HETC_L_TACT
 SG_ SubCode M : 0|8@1+ (1,0) [0|0] "" HMDH_202
 SG_ Ping_CanId m5 : 8|8@1+ (1,0) [0|0] "" HMDH_202
 SG_ Ping_HostId m5 : 16|8@1+ (1,0) [0|0] "" HMDH_202
 SG_ Ping_Pid m5 : 24|16@1+ (1,0) [0|0] "" HMDH_202
 SG_ Ping_Bid m5 : 40|16@1+ (1,0) [0|0] "" HMDH_202
 SG_ Ping_Mid m5 : 56|16@1+ (1,0) [0|0] "" HMDH_202
 SG_ Ping_VerMajor m5 : 72|8@1+ (1,0) [0|0] "" HMDH_202
 SG_ Ping_VerMinor m5 : 80|8@1+ (1,0) [0|0] "" HMDH_202
 SG_ Ping_VerPatch m5 : 88|8@1+ (1,0) [0|0] "" HMDH_202
 SG_ Ping_Name0 m5 : 96|8@1+ (1,0) [0|0] "" HMDH_202
 SG_ Ping_Name1 m5 : 104|8@1+ (1,0) [0|0] "" HMDH_202
 SG_ Ping_Name2 m5 : 112|8@1+ (1,0) [0|0] "" HMDH_202
 SG_ Ping_Name3 m5 : 120|8@1+ (1,0) [0|0] "" HMDH_202
 SG_ Ping_Name4 m5 : 128|8@1+ (1,0) [0|0] "" HMDH_202
 SG_ Ping_Name5 m5 : 136|8@1+ (1,0) [0|0] "" HMDH_202
 SG_ Ping_Name6 m5 : 144|8@1+ (1,0) [0|0] "" HMDH_202
 SG_ Ping_Name7 m5 : 152|8@1+ (1,0) [0|0] "" HMDH_202
 SG_ Ping_Name8 m5 : 160|8@1+ (1,0) [0|0] "" HMDH_202
 SG_ Ping_Name9 m5 : 168|8@1+ (1,0) [0|0] "" HMDH_202
 SG_ Ping_Name10 m5 : 176|8@1+ (1,0) [0|0] "" HMDH_202
 SG_ Ping_Name11 m5 : 184|8@1+ (1,0) [0|0] "" HMDH_202
 SG_ Ping_Name12 m5 : 192|8@1+ (1,0) [0|0] "" HMDH_202
 SG_ Ping_Name13 m5 : 200|8@1+ (1,0) [0|0] "" HMDH_202
 SG_ Ping_Name14 m5 : 208|8@1+ (1,0) [0|0] "" HMDH_202
 SG_ Ping_Name15 m5 : 216|8@1+ (1,0) [0|0] "" HMDH_202
 SG_ Ping_FmtVer m5 : 224|8@1+ (1,0) [0|0] "" HMDH_202
 SG_ Ping_GitRev m5 : 232|32@1+ (1,0) [0|0] "" HMDH_202
 SG_ Ping_FwCrc m5 : 264|16@1+ (1,0) [0|0] "" HMDH_202
 SG_ Ping_UptimeS m5 : 280|16@1+ (1,0) [0|0] "s" HMDH_202
 SG_ Ecat_CanId m31 : 8|8@1+ (1,0) [0|0] "" HMDH_202
 SG_ Ecat_Name0 m31 : 16|8@1+ (1,0) [0|0] "" HMDH_202
 SG_ Ecat_Name1 m31 : 24|8@1+ (1,0) [0|0] "" HMDH_202
 SG_ Ecat_Name2 m31 : 32|8@1+ (1,0) [0|0] "" HMDH_202
 SG_ Ecat_Name3 m31 : 40|8@1+ (1,0) [0|0] "" HMDH_202
 SG_ Ecat_Name4 m31 : 48|8@1+ (1,0) [0|0] "" HMDH_202
 SG_ Ecat_Name5 m31 : 56|8@1+ (1,0) [0|0] "" HMDH_202
 SG_ Ecat_Name6 m31 : 64|8@1+ (1,0) [0|0] "" HMDH_202
 SG_ Ecat_Name7 m31 : 72|8@1+ (1,0) [0|0] "" HMDH_202
 SG_ Ecat_Name8 m31 : 80|8@1+ (1,0) [0|0] "" HMDH_202
 SG_ Ecat_Name9 m31 : 88|8@1+ (1,0) [0|0] "" HMDH_202
 SG_ Ecat_Name10 m31 : 96|8@1+ (1,0) [0|0] "" HMDH_202
 SG_ Ecat_Name11 m31 : 104|8@1+ (1,0) [0|0] "" HMDH_202
 SG_ Ecat_Name12 m31 : 112|8@1+ (1,0) [0|0] "" HMDH_202
 SG_ Ecat_Name13 m31 : 120|8@1+ (1,0) [0|0] "" HMDH_202
 SG_ Ecat_Name14 m31 : 128|8@1+ (1,0) [0|0] "" HMDH_202
 SG_ Ecat_Name15 m31 : 136|8@1+ (1,0) [0|0] "" HMDH_202
 SG_ Ecat_Link m31 : 144|8@1+ (1,0) [0|0] "" HMDH_202
 SG_ Ecat_InvalidFrame0 m31 : 152|8@1+ (1,0) [0|0] "" HMDH_202
 SG_ Ecat_InvalidFrame1 m31 : 160|8@1+ (1,0) [0|0] "" HMDH_202
 SG_ Ecat_InvalidFrame2 m31 : 168|8@1+ (1,0) [0|0] "" HMDH_202
 SG_ Ecat_InvalidFrame3 m31 : 176|8@1+ (1,0) [0|0] "" HMDH_202
 SG_ Ecat_RxError0 m31 : 184|8@1+ (1,0) [0|0] "" HMDH_202
 SG_ Ecat_RxError1 m31 : 192|8@1+ (1,0) [0|0] "" HMDH_202
 SG_ Ecat_RxError2 m31 : 200|8@1+ (1,0) [0|0] "" HMDH_202
 SG_ Ecat_RxError3 m31 : 208|8@1+ (1,0) [0|0] "" HMDH_202
 SG_ Ecat_FwdRxError0 m31 : 216|8@1+ (1,0) [0|0] "" HMDH_202
 SG_ Ecat_FwdRxError1 m31 : 224|8@1+ (1,0) [0|0] "" HMDH_202
 SG_ Ecat_FwdRxError2 m31 : 232|8@1+ (1,0) [0|0] "" HMDH_202
 SG_ Ecat_FwdRxError3 m31 : 240|8@1+ (1,0) [0|0] "" HMDH_202
 SG_ Ecat_PuError m31 : 248|8@1+ (1,0) [0|0] "" HMDH_202
 SG_ Ecat_PdiError m31 : 256|8@1+ (1,0) [0|0] "" HMDH_202
 SG_ Ecat_LostLink0 m31 : 264|8@1+ (1,0) [0|0] "" HMDH_202
 SG_ Ecat_LostLink1 m31 : 272|8@1+ (1,0) [0|0] "" HMDH_202
 SG_ Ecat_LostLink2 m31 : 280|8@1+ (1,0) [0|0] "" HMDH_202
 SG_ Ecat_LostLink3 m31 : 288|8@1+ (1,0) [0|0] "" HMDH_202
 SG_ Saf_CanId m32 : 8|8@1+ (1,0) [0|0] "" HMDH_202
 SG_ Saf_Name0 m32 : 16|8@1+ (1,0) [0|0] "" HMDH_202
 SG_ Saf_Name1 m32 : 24|8@1+ (1,0) [0|0] "" HMDH_202
 SG_ Saf_Name2 m32 : 32|8@1+ (1,0) [0|0] "" HMDH_202
 SG_ Saf_Name3 m32 : 40|8@1+ (1,0) [0|0] "" HMDH_202
 SG_ Saf_Name4 m32 : 48|8@1+ (1,0) [0|0] "" HMDH_202
 SG_ Saf_Name5 m32 : 56|8@1+ (1,0) [0|0] "" HMDH_202
 SG_ Saf_Name6 m32 : 64|8@1+ (1,0) [0|0] "" HMDH_202
 SG_ Saf_Name7 m32 : 72|8@1+ (1,0) [0|0] "" HMDH_202
 SG_ Saf_Name8 m32 : 80|8@1+ (1,0) [0|0] "" HMDH_202
 SG_ Saf_Name9 m32 : 88|8@1+ (1,0) [0|0] "" HMDH_202
 SG_ Saf_Name10 m32 : 96|8@1+ (1,0) [0|0] "" HMDH_202
 SG_ Saf_Name11 m32 : 104|8@1+ (1,0) [0|0] "" HMDH_202
 SG_ Saf_Name12 m32 : 112|8@1+ (1,0) [0|0] "" HMDH_202
 SG_ Saf_Name13 m32 : 120|8@1+ (1,0) [0|0] "" HMDH_202
 SG_ Saf_Name14 m32 : 128|8@1+ (1,0) [0|0] "" HMDH_202
 SG_ Saf_Name15 m32 : 136|8@1+ (1,0) [0|0] "" HMDH_202
 SG_ Saf_State m32 : 144|8@1+ (1,0) [0|0] "" HMDH_202
 SG_ Saf_Bits m32 : 152|16@1+ (1,0) [0|0] "" HMDH_202
 SG_ Saf_Estop m32 : 168|8@1+ (1,0) [0|0] "" HMDH_202
 SG_ Saf_FatalLatched m32 : 176|16@1+ (1,0) [0|0] "" HMDH_202
 SG_ Saf_ErrCode m32 : 192|32@1+ (1,0) [0|0] "" HMDH_202

BO_ 2163311307 STATUS_HETC_L_TACT_to_HMDH_203: 48 HETC_L_TACT
 SG_ SubCode M : 0|8@1+ (1,0) [0|0] "" HMDH_203
 SG_ Ping_CanId m5 : 8|8@1+ (1,0) [0|0] "" HMDH_203
 SG_ Ping_HostId m5 : 16|8@1+ (1,0) [0|0] "" HMDH_203
 SG_ Ping_Pid m5 : 24|16@1+ (1,0) [0|0] "" HMDH_203
 SG_ Ping_Bid m5 : 40|16@1+ (1,0) [0|0] "" HMDH_203
 SG_ Ping_Mid m5 : 56|16@1+ (1,0) [0|0] "" HMDH_203
 SG_ Ping_VerMajor m5 : 72|8@1+ (1,0) [0|0] "" HMDH_203
 SG_ Ping_VerMinor m5 : 80|8@1+ (1,0) [0|0] "" HMDH_203
 SG_ Ping_VerPatch m5 : 88|8@1+ (1,0) [0|0] "" HMDH_203
 SG_ Ping_Name0 m5 : 96|8@1+ (1,0) [0|0] "" HMDH_203
 SG_ Ping_Name1 m5 : 104|8@1+ (1,0) [0|0] "" HMDH_203
 SG_ Ping_Name2 m5 : 112|8@1+ (1,0) [0|0] "" HMDH_203
 SG_ Ping_Name3 m5 : 120|8@1+ (1,0) [0|0] "" HMDH_203
 SG_ Ping_Name4 m5 : 128|8@1+ (1,0) [0|0] "" HMDH_203
 SG_ Ping_Name5 m5 : 136|8@1+ (1,0) [0|0] "" HMDH_203
 SG_ Ping_Name6 m5 : 144|8@1+ (1,0) [0|0] "" HMDH_203
 SG_ Ping_Name7 m5 : 152|8@1+ (1,0) [0|0] "" HMDH_203
 SG_ Ping_Name8 m5 : 160|8@1+ (1,0) [0|0] "" HMDH_203
 SG_ Ping_Name9 m5 : 168|8@1+ (1,0) [0|0] "" HMDH_203
 SG_ Ping_Name10 m5 : 176|8@1+ (1,0) [0|0] "" HMDH_203
 SG_ Ping_Name11 m5 : 184|8@1+ (1,0) [0|0] "" HMDH_203
 SG_ Ping_Name12 m5 : 192|8@1+ (1,0) [0|0] "" HMDH_203
 SG_ Ping_Name13 m5 : 200|8@1+ (1,0) [0|0] "" HMDH_203
 SG_ Ping_Name14 m5 : 208|8@1+ (1,0) [0|0] "" HMDH_203
 SG_ Ping_Name15 m5 : 216|8@1+ (1,0) [0|0] "" HMDH_203
 SG_ Ping_FmtVer m5 : 224|8@1+ (1,0) [0|0] "" HMDH_203
 SG_ Ping_GitRev m5 : 232|32@1+ (1,0) [0|0] "" HMDH_203
 SG_ Ping_FwCrc m5 : 264|16@1+ (1,0) [0|0] "" HMDH_203
 SG_ Ping_UptimeS m5 : 280|16@1+ (1,0) [0|0] "s" HMDH_203
 SG_ Ecat_CanId m31 : 8|8@1+ (1,0) [0|0] "" HMDH_203
 SG_ Ecat_Name0 m31 : 16|8@1+ (1,0) [0|0] "" HMDH_203
 SG_ Ecat_Name1 m31 : 24|8@1+ (1,0) [0|0] "" HMDH_203
 SG_ Ecat_Name2 m31 : 32|8@1+ (1,0) [0|0] "" HMDH_203
 SG_ Ecat_Name3 m31 : 40|8@1+ (1,0) [0|0] "" HMDH_203
 SG_ Ecat_Name4 m31 : 48|8@1+ (1,0) [0|0] "" HMDH_203
 SG_ Ecat_Name5 m31 : 56|8@1+ (1,0) [0|0] "" HMDH_203
 SG_ Ecat_Name6 m31 : 64|8@1+ (1,0) [0|0] "" HMDH_203
 SG_ Ecat_Name7 m31 : 72|8@1+ (1,0) [0|0] "" HMDH_203
 SG_ Ecat_Name8 m31 : 80|8@1+ (1,0) [0|0] "" HMDH_203
 SG_ Ecat_Name9 m31 : 88|8@1+ (1,0) [0|0] "" HMDH_203
 SG_ Ecat_Name10 m31 : 96|8@1+ (1,0) [0|0] "" HMDH_203
 SG_ Ecat_Name11 m31 : 104|8@1+ (1,0) [0|0] "" HMDH_203
 SG_ Ecat_Name12 m31 : 112|8@1+ (1,0) [0|0] "" HMDH_203
 SG_ Ecat_Name13 m31 : 120|8@1+ (1,0) [0|0] "" HMDH_203
 SG_ Ecat_Name14 m31 : 128|8@1+ (1,0) [0|0] "" HMDH_203
 SG_ Ecat_Name15 m31 : 136|8@1+ (1,0) [0|0] "" HMDH_203
 SG_ Ecat_Link m31 : 144|8@1+ (1,0) [0|0] "" HMDH_203
 SG_ Ecat_InvalidFrame0 m31 : 152|8@1+ (1,0) [0|0] "" HMDH_203
 SG_ Ecat_InvalidFrame1 m31 : 160|8@1+ (1,0) [0|0] "" HMDH_203
 SG_ Ecat_InvalidFrame2 m31 : 168|8@1+ (1,0) [0|0] "" HMDH_203
 SG_ Ecat_InvalidFrame3 m31 : 176|8@1+ (1,0) [0|0] "" HMDH_203
 SG_ Ecat_RxError0 m31 : 184|8@1+ (1,0) [0|0] "" HMDH_203
 SG_ Ecat_RxError1 m31 : 192|8@1+ (1,0) [0|0] "" HMDH_203
 SG_ Ecat_RxError2 m31 : 200|8@1+ (1,0) [0|0] "" HMDH_203
 SG_ Ecat_RxError3 m31 : 208|8@1+ (1,0) [0|0] "" HMDH_203
 SG_ Ecat_FwdRxError0 m31 : 216|8@1+ (1,0) [0|0] "" HMDH_203
 SG_ Ecat_FwdRxError1 m31 : 224|8@1+ (1,0) [0|0] "" HMDH_203
 SG_ Ecat_FwdRxError2 m31 : 232|8@1+ (1,0) [0|0] "" HMDH_203
 SG_ Ecat_FwdRxError3 m31 : 240|8@1+ (1,0) [0|0] "" HMDH_203
 SG_ Ecat_PuError m31 : 248|8@1+ (1,0) [0|0] "" HMDH_203
 SG_ Ecat_PdiError m31 : 256|8@1+ (1,0) [0|0] "" HMDH_203
 SG_ Ecat_LostLink0 m31 : 264|8@1+ (1,0) [0|0] "" HMDH_203
 SG_ Ecat_LostLink1 m31 : 272|8@1+ (1,0) [0|0] "" HMDH_203
 SG_ Ecat_LostLink2 m31 : 280|8@1+ (1,0) [0|0] "" HMDH_203
 SG_ Ecat_LostLink3 m31 : 288|8@1+ (1,0) [0|0] "" HMDH_203
 SG_ Saf_CanId m32 : 8|8@1+ (1,0) [0|0] "" HMDH_203
 SG_ Saf_Name0 m32 : 16|8@1+ (1,0) [0|0] "" HMDH_203
 SG_ Saf_Name1 m32 : 24|8@1+ (1,0) [0|0] "" HMDH_203
 SG_ Saf_Name2 m32 : 32|8@1+ (1,0) [0|0] "" HMDH_203
 SG_ Saf_Name3 m32 : 40|8@1+ (1,0) [0|0] "" HMDH_203
 SG_ Saf_Name4 m32 : 48|8@1+ (1,0) [0|0] "" HMDH_203
 SG_ Saf_Name5 m32 : 56|8@1+ (1,0) [0|0] "" HMDH_203
 SG_ Saf_Name6 m32 : 64|8@1+ (1,0) [0|0] "" HMDH_203
 SG_ Saf_Name7 m32 : 72|8@1+ (1,0) [0|0] "" HMDH_203
 SG_ Saf_Name8 m32 : 80|8@1+ (1,0) [0|0] "" HMDH_203
 SG_ Saf_Name9 m32 : 88|8@1+ (1,0) [0|0] "" HMDH_203
 SG_ Saf_Name10 m32 : 96|8@1+ (1,0) [0|0] "" HMDH_203
 SG_ Saf_Name11 m32 : 104|8@1+ (1,0) [0|0] "" HMDH_203
 SG_ Saf_Name12 m32 : 112|8@1+ (1,0) [0|0] "" HMDH_203
 SG_ Saf_Name13 m32 : 120|8@1+ (1,0) [0|0] "" HMDH_203
 SG_ Saf_Name14 m32 : 128|8@1+ (1,0) [0|0] "" HMDH_203
 SG_ Saf_Name15 m32 : 136|8@1+ (1,0) [0|0] "" HMDH_203
 SG_ Saf_State m32 : 144|8@1+ (1,0) [0|0] "" HMDH_203
 SG_ Saf_Bits m32 : 152|16@1+ (1,0) [0|0] "" HMDH_203
 SG_ Saf_Estop m32 : 168|8@1+ (1,0) [0|0] "" HMDH_203
 SG_ Saf_FatalLatched m32 : 176|16@1+ (1,0) [0|0] "" HMDH_203
 SG_ Saf_ErrCode m32 : 192|32@1+ (1,0) [0|0] "" HMDH_203

BO_ 2163311308 STATUS_HETC_L_TACT_to_HMDH_204: 48 HETC_L_TACT
 SG_ SubCode M : 0|8@1+ (1,0) [0|0] "" HMDH_204
 SG_ Ping_CanId m5 : 8|8@1+ (1,0) [0|0] "" HMDH_204
 SG_ Ping_HostId m5 : 16|8@1+ (1,0) [0|0] "" HMDH_204
 SG_ Ping_Pid m5 : 24|16@1+ (1,0) [0|0] "" HMDH_204
 SG_ Ping_Bid m5 : 40|16@1+ (1,0) [0|0] "" HMDH_204
 SG_ Ping_Mid m5 : 56|16@1+ (1,0) [0|0] "" HMDH_204
 SG_ Ping_VerMajor m5 : 72|8@1+ (1,0) [0|0] "" HMDH_204
 SG_ Ping_VerMinor m5 : 80|8@1+ (1,0) [0|0] "" HMDH_204
 SG_ Ping_VerPatch m5 : 88|8@1+ (1,0) [0|0] "" HMDH_204
 SG_ Ping_Name0 m5 : 96|8@1+ (1,0) [0|0] "" HMDH_204
 SG_ Ping_Name1 m5 : 104|8@1+ (1,0) [0|0] "" HMDH_204
 SG_ Ping_Name2 m5 : 112|8@1+ (1,0) [0|0] "" HMDH_204
 SG_ Ping_Name3 m5 : 120|8@1+ (1,0) [0|0] "" HMDH_204
 SG_ Ping_Name4 m5 : 128|8@1+ (1,0) [0|0] "" HMDH_204
 SG_ Ping_Name5 m5 : 136|8@1+ (1,0) [0|0] "" HMDH_204
 SG_ Ping_Name6 m5 : 144|8@1+ (1,0) [0|0] "" HMDH_204
 SG_ Ping_Name7 m5 : 152|8@1+ (1,0) [0|0] "" HMDH_204
 SG_ Ping_Name8 m5 : 160|8@1+ (1,0) [0|0] "" HMDH_204
 SG_ Ping_Name9 m5 : 168|8@1+ (1,0) [0|0] "" HMDH_204
 SG_ Ping_Name10 m5 : 176|8@1+ (1,0) [0|0] "" HMDH_204
 SG_ Ping_Name11 m5 : 184|8@1+ (1,0) [0|0] "" HMDH_204
 SG_ Ping_Name12 m5 : 192|8@1+ (1,0) [0|0] "" HMDH_204
 SG_ Ping_Name13 m5 : 200|8@1+ (1,0) [0|0] "" HMDH_204
 SG_ Ping_Name14 m5 : 208|8@1+ (1,0) [0|0] "" HMDH_204
 SG_ Ping_Name15 m5 : 216|8@1+ (1,0) [0|0] "" HMDH_204
 SG_ Ping_FmtVer m5 : 224|8@1+ (1,0) [0|0] "" HMDH_204
 SG_ Ping_GitRev m5 : 232|32@1+ (1,0) [0|0] "" HMDH_204
 SG_ Ping_FwCrc m5 : 264|16@1+ (1,0) [0|0] "" HMDH_204
 SG_ Ping_UptimeS m5 : 280|16@1+ (1,0) [0|0] "s" HMDH_204
 SG_ Ecat_CanId m31 : 8|8@1+ (1,0) [0|0] "" HMDH_204
 SG_ Ecat_Name0 m31 : 16|8@1+ (1,0) [0|0] "" HMDH_204
 SG_ Ecat_Name1 m31 : 24|8@1+ (1,0) [0|0] "" HMDH_204
 SG_ Ecat_Name2 m31 : 32|8@1+ (1,0) [0|0] "" HMDH_204
 SG_ Ecat_Name3 m31 : 40|8@1+ (1,0) [0|0] "" HMDH_204
 SG_ Ecat_Name4 m31 : 48|8@1+ (1,0) [0|0] "" HMDH_204
 SG_ Ecat_Name5 m31 : 56|8@1+ (1,0) [0|0] "" HMDH_204
 SG_ Ecat_Name6 m31 : 64|8@1+ (1,0) [0|0] "" HMDH_204
 SG_ Ecat_Name7 m31 : 72|8@1+ (1,0) [0|0] "" HMDH_204
 SG_ Ecat_Name8 m31 : 80|8@1+ (1,0) [0|0] "" HMDH_204
 SG_ Ecat_Name9 m31 : 88|8@1+ (1,0) [0|0] "" HMDH_204
 SG_ Ecat_Name10 m31 : 96|8@1+ (1,0) [0|0] "" HMDH_204
 SG_ Ecat_Name11 m31 : 104|8@1+ (1,0) [0|0] "" HMDH_204
 SG_ Ecat_Name12 m31 : 112|8@1+ (1,0) [0|0] "" HMDH_204
 SG_ Ecat_Name13 m31 : 120|8@1+ (1,0) [0|0] "" HMDH_204
 SG_ Ecat_Name14 m31 : 128|8@1+ (1,0) [0|0] "" HMDH_204
 SG_ Ecat_Name15 m31 : 136|8@1+ (1,0) [0|0] "" HMDH_204
 SG_ Ecat_Link m31 : 144|8@1+ (1,0) [0|0] "" HMDH_204
 SG_ Ecat_InvalidFrame0 m31 : 152|8@1+ (1,0) [0|0] "" HMDH_204
 SG_ Ecat_InvalidFrame1 m31 : 160|8@1+ (1,0) [0|0] "" HMDH_204
 SG_ Ecat_InvalidFrame2 m31 : 168|8@1+ (1,0) [0|0] "" HMDH_204
 SG_ Ecat_InvalidFrame3 m31 : 176|8@1+ (1,0) [0|0] "" HMDH_204
 SG_ Ecat_RxError0 m31 : 184|8@1+ (1,0) [0|0] "" HMDH_204
 SG_ Ecat_RxError1 m31 : 192|8@1+ (1,0) [0|0] "" HMDH_204
 SG_ Ecat_RxError2 m31 : 200|8@1+ (1,0) [0|0] "" HMDH_204
 SG_ Ecat_RxError3 m31 : 208|8@1+ (1,0) [0|0] "" HMDH_204
 SG_ Ecat_FwdRxError0 m31 : 216|8@1+ (1,0) [0|0] "" HMDH_204
 SG_ Ecat_FwdRxError1 m31 : 224|8@1+ (1,0) [0|0] "" HMDH_204
 SG_ Ecat_FwdRxError2 m31 : 232|8@1+ (1,0) [0|0] "" HMDH_204
 SG_ Ecat_FwdRxError3 m31 : 240|8@1+ (1,0) [0|0] "" HMDH_204
 SG_ Ecat_PuError m31 : 248|8@1+ (1,0) [0|0] "" HMDH_204
 SG_ Ecat_PdiError m31 : 256|8@1+ (1,0) [0|0] "" HMDH_204
 SG_ Ecat_LostLink0 m31 : 264|8@1+ (1,0) [0|0] "" HMDH_204
 SG_ Ecat_LostLink1 m31 : 272|8@1+ (1,0) [0|0] "" HMDH_204
 SG_ Ecat_LostLink2 m31 : 280|8@1+ (1,0) [0|0] "" HMDH_204
 SG_ Ecat_LostLink3 m31 : 288|8@1+ (1,0) [0|0] "" HMDH_204
 SG_ Saf_CanId m32 : 8|8@1+ (1,0) [0|0] "" HMDH_204
 SG_ Saf_Name0 m32 : 16|8@1+ (1,0) [0|0] "" HMDH_204
 SG_ Saf_Name1 m32 : 24|8@1+ (1,0) [0|0] "" HMDH_204
 SG_ Saf_Name2 m32 : 32|8@1+ (1,0) [0|0] "" HMDH_204
 SG_ Saf_Name3 m32 : 40|8@1+ (1,0) [0|0] "" HMDH_204
 SG_ Saf_Name4 m32 : 48|8@1+ (1,0) [0|0] "" HMDH_204
 SG_ Saf_Name5 m32 : 56|8@1+ (1,0) [0|0] "" HMDH_204
 SG_ Saf_Name6 m32 : 64|8@1+ (1,0) [0|0] "" HMDH_204
 SG_ Saf_Name7 m32 : 72|8@1+ (1,0) [0|0] "" HMDH_204
 SG_ Saf_Name8 m32 : 80|8@1+ (1,0) [0|0] "" HMDH_204
 SG_ Saf_Name9 m32 : 88|8@1+ (1,0) [0|0] "" HMDH_204
 SG_ Saf_Name10 m32 : 96|8@1+ (1,0) [0|0] "" HMDH_204
 SG_ Saf_Name11 m32 : 104|8@1+ (1,0) [0|0] "" HMDH_204
 SG_ Saf_Name12 m32 : 112|8@1+ (1,0) [0|0] "" HMDH_204
 SG_ Saf_Name13 m32 : 120|8@1+ (1,0) [0|0] "" HMDH_204
 SG_ Saf_Name14 m32 : 128|8@1+ (1,0) [0|0] "" HMDH_204
 SG_ Saf_Name15 m32 : 136|8@1+ (1,0) [0|0] "" HMDH_204
 SG_ Saf_State m32 : 144|8@1+ (1,0) [0|0] "" HMDH_204
 SG_ Saf_Bits m32 : 152|16@1+ (1,0) [0|0] "" HMDH_204
 SG_ Saf_Estop m32 : 168|8@1+ (1,0) [0|0] "" HMDH_204
 SG_ Saf_FatalLatched m32 : 176|16@1+ (1,0) [0|0] "" HMDH_204
 SG_ Saf_ErrCode m32 : 192|32@1+ (1,0) [0|0] "" HMDH_204

BO_ 2163311309 STATUS_HETC_L_TACT_to_HMDH_205: 48 HETC_L_TACT
 SG_ SubCode M : 0|8@1+ (1,0) [0|0] "" HMDH_205
 SG_ Ping_CanId m5 : 8|8@1+ (1,0) [0|0] "" HMDH_205
 SG_ Ping_HostId m5 : 16|8@1+ (1,0) [0|0] "" HMDH_205
 SG_ Ping_Pid m5 : 24|16@1+ (1,0) [0|0] "" HMDH_205
 SG_ Ping_Bid m5 : 40|16@1+ (1,0) [0|0] "" HMDH_205
 SG_ Ping_Mid m5 : 56|16@1+ (1,0) [0|0] "" HMDH_205
 SG_ Ping_VerMajor m5 : 72|8@1+ (1,0) [0|0] "" HMDH_205
 SG_ Ping_VerMinor m5 : 80|8@1+ (1,0) [0|0] "" HMDH_205
 SG_ Ping_VerPatch m5 : 88|8@1+ (1,0) [0|0] "" HMDH_205
 SG_ Ping_Name0 m5 : 96|8@1+ (1,0) [0|0] "" HMDH_205
 SG_ Ping_Name1 m5 : 104|8@1+ (1,0) [0|0] "" HMDH_205
 SG_ Ping_Name2 m5 : 112|8@1+ (1,0) [0|0] "" HMDH_205
 SG_ Ping_Name3 m5 : 120|8@1+ (1,0) [0|0] "" HMDH_205
 SG_ Ping_Name4 m5 : 128|8@1+ (1,0) [0|0] "" HMDH_205
 SG_ Ping_Name5 m5 : 136|8@1+ (1,0) [0|0] "" HMDH_205
 SG_ Ping_Name6 m5 : 144|8@1+ (1,0) [0|0] "" HMDH_205
 SG_ Ping_Name7 m5 : 152|8@1+ (1,0) [0|0] "" HMDH_205
 SG_ Ping_Name8 m5 : 160|8@1+ (1,0) [0|0] "" HMDH_205
 SG_ Ping_Name9 m5 : 168|8@1+ (1,0) [0|0] "" HMDH_205
 SG_ Ping_Name10 m5 : 176|8@1+ (1,0) [0|0] "" HMDH_205
 SG_ Ping_Name11 m5 : 184|8@1+ (1,0) [0|0] "" HMDH_205
 SG_ Ping_Name12 m5 : 192|8@1+ (1,0) [0|0] "" HMDH_205
 SG_ Ping_Name13 m5 : 200|8@1+ (1,0) [0|0] "" HMDH_205
 SG_ Ping_Name14 m5 : 208|8@1+ (1,0) [0|0] "" HMDH_205
 SG_ Ping_Name15 m5 : 216|8@1+ (1,0) [0|0] "" HMDH_205
 SG_ Ping_FmtVer m5 : 224|8@1+ (1,0) [0|0] "" HMDH_205
 SG_ Ping_GitRev m5 : 232|32@1+ (1,0) [0|0] "" HMDH_205
 SG_ Ping_FwCrc m5 : 264|16@1+ (1,0) [0|0] "" HMDH_205
 SG_ Ping_UptimeS m5 : 280|16@1+ (1,0) [0|0] "s" HMDH_205
 SG_ Ecat_CanId m31 : 8|8@1+ (1,0) [0|0] "" HMDH_205
 SG_ Ecat_Name0 m31 : 16|8@1+ (1,0) [0|0] "" HMDH_205
 SG_ Ecat_Name1 m31 : 24|8@1+ (1,0) [0|0] "" HMDH_205
 SG_ Ecat_Name2 m31 : 32|8@1+ (1,0) [0|0] "" HMDH_205
 SG_ Ecat_Name3 m31 : 40|8@1+ (1,0) [0|0] "" HMDH_205
 SG_ Ecat_Name4 m31 : 48|8@1+ (1,0) [0|0] "" HMDH_205
 SG_ Ecat_Name5 m31 : 56|8@1+ (1,0) [0|0] "" HMDH_205
 SG_ Ecat_Name6 m31 : 64|8@1+ (1,0) [0|0] "" HMDH_205
 SG_ Ecat_Name7 m31 : 72|8@1+ (1,0) [0|0] "" HMDH_205
 SG_ Ecat_Name8 m31 : 80|8@1+ (1,0) [0|0] "" HMDH_205
 SG_ Ecat_Name9 m31 : 88|8@1+ (1,0) [0|0] "" HMDH_205
 SG_ Ecat_Name10 m31 : 96|8@1+ (1,0) [0|0] "" HMDH_205
 SG_ Ecat_Name11 m31 : 104|8@1+ (1,0) [0|0] "" HMDH_205
 SG_ Ecat_Name12 m31 : 112|8@1+ (1,0) [0|0] "" HMDH_205
 SG_ Ecat_Name13 m31 : 120|8@1+ (1,0) [0|0] "" HMDH_205
 SG_ Ecat_Name14 m31 : 128|8@1+ (1,0) [0|0] "" HMDH_205
 SG_ Ecat_Name15 m31 : 136|8@1+ (1,0) [0|0] "" HMDH_205
 SG_ Ecat_Link m31 : 144|8@1+ (1,0) [0|0] "" HMDH_205
 SG_ Ecat_InvalidFrame0 m31 : 152|8@1+ (1,0) [0|0] "" HMDH_205
 SG_ Ecat_InvalidFrame1 m31 : 160|8@1+ (1,0) [0|0] "" HMDH_205
 SG_ Ecat_InvalidFrame2 m31 : 168|8@1+ (1,0) [0|0] "" HMDH_205
 SG_ Ecat_InvalidFrame3 m31 : 176|8@1+ (1,0) [0|0] "" HMDH_205
 SG_ Ecat_RxError0 m31 : 184|8@1+ (1,0) [0|0] "" HMDH_205
 SG_ Ecat_RxError1 m31 : 192|8@1+ (1,0) [0|0] "" HMDH_205
 SG_ Ecat_RxError2 m31 : 200|8@1+ (1,0) [0|0] "" HMDH_205
 SG_ Ecat_RxError3 m31 : 208|8@1+ (1,0) [0|0] "" HMDH_205
 SG_ Ecat_FwdRxError0 m31 : 216|8@1+ (1,0) [0|0] "" HMDH_205
 SG_ Ecat_FwdRxError1 m31 : 224|8@1+ (1,0) [0|0] "" HMDH_205
 SG_ Ecat_FwdRxError2 m31 : 232|8@1+ (1,0) [0|0] "" HMDH_205
 SG_ Ecat_FwdRxError3 m31 : 240|8@1+ (1,0) [0|0] "" HMDH_205
 SG_ Ecat_PuError m31 : 248|8@1+ (1,0) [0|0] "" HMDH_205
 SG_ Ecat_PdiError m31 : 256|8@1+ (1,0) [0|0] "" HMDH_205
 SG_ Ecat_LostLink0 m31 : 264|8@1+ (1,0) [0|0] "" HMDH_205
 SG_ Ecat_LostLink1 m31 : 272|8@1+ (1,0) [0|0] "" HMDH_205
 SG_ Ecat_LostLink2 m31 : 280|8@1+ (1,0) [0|0] "" HMDH_205
 SG_ Ecat_LostLink3 m31 : 288|8@1+ (1,0) [0|0] "" HMDH_205
 SG_ Saf_CanId m32 : 8|8@1+ (1,0) [0|0] "" HMDH_205
 SG_ Saf_Name0 m32 : 16|8@1+ (1,0) [0|0] "" HMDH_205
 SG_ Saf_Name1 m32 : 24|8@1+ (1,0) [0|0] "" HMDH_205
 SG_ Saf_Name2 m32 : 32|8@1+ (1,0) [0|0] "" HMDH_205
 SG_ Saf_Name3 m32 : 40|8@1+ (1,0) [0|0] "" HMDH_205
 SG_ Saf_Name4 m32 : 48|8@1+ (1,0) [0|0] "" HMDH_205
 SG_ Saf_Name5 m32 : 56|8@1+ (1,0) [0|0] "" HMDH_205
 SG_ Saf_Name6 m32 : 64|8@1+ (1,0) [0|0] "" HMDH_205
 SG_ Saf_Name7 m32 : 72|8@1+ (1,0) [0|0] "" HMDH_205
 SG_ Saf_Name8 m32 : 80|8@1+ (1,0) [0|0] "" HMDH_205
 SG_ Saf_Name9 m32 : 88|8@1+ (1,0) [0|0] "" HMDH_205
 SG_ Saf_Name10 m32 : 96|8@1+ (1,0) [0|0] "" HMDH_205
 SG_ Saf_Name11 m32 : 104|8@1+ (1,0) [0|0] "" HMDH_205
 SG_ Saf_Name12 m32 : 112|8@1+ (1,0) [0|0] "" HMDH_205
 SG_ Saf_Name13 m32 : 120|8@1+ (1,0) [0|0] "" HMDH_205
 SG_ Saf_Name14 m32 : 128|8@1+ (1,0) [0|0] "" HMDH_205
 SG_ Saf_Name15 m32 : 136|8@1+ (1,0) [0|0] "" HMDH_205
 SG_ Saf_State m32 : 144|8@1+ (1,0) [0|0] "" HMDH_205
 SG_ Saf_Bits m32 : 152|16@1+ (1,0) [0|0] "" HMDH_205
 SG_ Saf_Estop m32 : 168|8@1+ (1,0) [0|0] "" HMDH_205
 SG_ Saf_FatalLatched m32 : 176|16@1+ (1,0) [0|0] "" HMDH_205
 SG_ Saf_ErrCode m32 : 192|32@1+ (1,0) [0|0] "" HMDH_205

BO_ 2163311310 STATUS_HETC_L_TACT_to_HMDH_206: 48 HETC_L_TACT
 SG_ SubCode M : 0|8@1+ (1,0) [0|0] "" HMDH_206
 SG_ Ping_CanId m5 : 8|8@1+ (1,0) [0|0] "" HMDH_206
 SG_ Ping_HostId m5 : 16|8@1+ (1,0) [0|0] "" HMDH_206
 SG_ Ping_Pid m5 : 24|16@1+ (1,0) [0|0] "" HMDH_206
 SG_ Ping_Bid m5 : 40|16@1+ (1,0) [0|0] "" HMDH_206
 SG_ Ping_Mid m5 : 56|16@1+ (1,0) [0|0] "" HMDH_206
 SG_ Ping_VerMajor m5 : 72|8@1+ (1,0) [0|0] "" HMDH_206
 SG_ Ping_VerMinor m5 : 80|8@1+ (1,0) [0|0] "" HMDH_206
 SG_ Ping_VerPatch m5 : 88|8@1+ (1,0) [0|0] "" HMDH_206
 SG_ Ping_Name0 m5 : 96|8@1+ (1,0) [0|0] "" HMDH_206
 SG_ Ping_Name1 m5 : 104|8@1+ (1,0) [0|0] "" HMDH_206
 SG_ Ping_Name2 m5 : 112|8@1+ (1,0) [0|0] "" HMDH_206
 SG_ Ping_Name3 m5 : 120|8@1+ (1,0) [0|0] "" HMDH_206
 SG_ Ping_Name4 m5 : 128|8@1+ (1,0) [0|0] "" HMDH_206
 SG_ Ping_Name5 m5 : 136|8@1+ (1,0) [0|0] "" HMDH_206
 SG_ Ping_Name6 m5 : 144|8@1+ (1,0) [0|0] "" HMDH_206
 SG_ Ping_Name7 m5 : 152|8@1+ (1,0) [0|0] "" HMDH_206
 SG_ Ping_Name8 m5 : 160|8@1+ (1,0) [0|0] "" HMDH_206
 SG_ Ping_Name9 m5 : 168|8@1+ (1,0) [0|0] "" HMDH_206
 SG_ Ping_Name10 m5 : 176|8@1+ (1,0) [0|0] "" HMDH_206
 SG_ Ping_Name11 m5 : 184|8@1+ (1,0) [0|0] "" HMDH_206
 SG_ Ping_Name12 m5 : 192|8@1+ (1,0) [0|0] "" HMDH_206
 SG_ Ping_Name13 m5 : 200|8@1+ (1,0) [0|0] "" HMDH_206
 SG_ Ping_Name14 m5 : 208|8@1+ (1,0) [0|0] "" HMDH_206
 SG_ Ping_Name15 m5 : 216|8@1+ (1,0) [0|0] "" HMDH_206
 SG_ Ping_FmtVer m5 : 224|8@1+ (1,0) [0|0] "" HMDH_206
 SG_ Ping_GitRev m5 : 232|32@1+ (1,0) [0|0] "" HMDH_206
 SG_ Ping_FwCrc m5 : 264|16@1+ (1,0) [0|0] "" HMDH_206
 SG_ Ping_UptimeS m5 : 280|16@1+ (1,0) [0|0] "s" HMDH_206
 SG_ Ecat_CanId m31 : 8|8@1+ (1,0) [0|0] "" HMDH_206
 SG_ Ecat_Name0 m31 : 16|8@1+ (1,0) [0|0] "" HMDH_206
 SG_ Ecat_Name1 m31 : 24|8@1+ (1,0) [0|0] "" HMDH_206
 SG_ Ecat_Name2 m31 : 32|8@1+ (1,0) [0|0] "" HMDH_206
 SG_ Ecat_Name3 m31 : 40|8@1+ (1,0) [0|0] "" HMDH_206
 SG_ Ecat_Name4 m31 : 48|8@1+ (1,0) [0|0] "" HMDH_206
 SG_ Ecat_Name5 m31 : 56|8@1+ (1,0) [0|0] "" HMDH_206
 SG_ Ecat_Name6 m31 : 64|8@1+ (1,0) [0|0] "" HMDH_206
 SG_ Ecat_Name7 m31 : 72|8@1+ (1,0) [0|0] "" HMDH_206
 SG_ Ecat_Name8 m31 : 80|8@1+ (1,0) [0|0] "" HMDH_206
 SG_ Ecat_Name9 m31 : 88|8@1+ (1,0) [0|0] "" HMDH_206
 SG_ Ecat_Name10 m31 : 96|8@1+ (1,0) [0|0] "" HMDH_206
 SG_ Ecat_Name11 m31 : 104|8@1+ (1,0) [0|0] "" HMDH_206
 SG_ Ecat_Name12 m31 : 112|8@1+ (1,0) [0|0] "" HMDH_206
 SG_ Ecat_Name13 m31 : 120|8@1+ (1,0) [0|0] "" HMDH_206
 SG_ Ecat_Name14 m31 : 128|8@1+ (1,0) [0|0] "" HMDH_206
 SG_ Ecat_Name15 m31 : 136|8@1+ (1,0) [0|0] "" HMDH_206
 SG_ Ecat_Link m31 : 144|8@1+ (1,0) [0|0] "" HMDH_206
 SG_ Ecat_InvalidFrame0 m31 : 152|8@1+ (1,0) [0|0] "" HMDH_206
 SG_ Ecat_InvalidFrame1 m31 : 160|8@1+ (1,0) [0|0] "" HMDH_206
 SG_ Ecat_InvalidFrame2 m31 : 168|8@1+ (1,0) [0|0] "" HMDH_206
 SG_ Ecat_InvalidFrame3 m31 : 176|8@1+ (1,0) [0|0] "" HMDH_206
 SG_ Ecat_RxError0 m31 : 184|8@1+ (1,0) [0|0] "" HMDH_206
 SG_ Ecat_RxError1 m31 : 192|8@1+ (1,0) [0|0] "" HMDH_206
 SG_ Ecat_RxError2 m31 : 200|8@1+ (1,0) [0|0] "" HMDH_206
 SG_ Ecat_RxError3 m31 : 208|8@1+ (1,0) [0|0] "" HMDH_206
 SG_ Ecat_FwdRxError0 m31 : 216|8@1+ (1,0) [0|0] "" HMDH_206
 SG_ Ecat_FwdRxError1 m31 : 224|8@1+ (1,0) [0|0] "" HMDH_206
 SG_ Ecat_FwdRxError2 m31 : 232|8@1+ (1,0) [0|0] "" HMDH_206
 SG_ Ecat_FwdRxError3 m31 : 240|8@1+ (1,0) [0|0] "" HMDH_206
 SG_ Ecat_PuError m31 : 248|8@1+ (1,0) [0|0] "" HMDH_206
 SG_ Ecat_PdiError m31 : 256|8@1+ (1,0) [0|0] "" HMDH_206
 SG_ Ecat_LostLink0 m31 : 264|8@1+ (1,0) [0|0] "" HMDH_206
 SG_ Ecat_LostLink1 m31 : 272|8@1+ (1,0) [0|0] "" HMDH_206
 SG_ Ecat_LostLink2 m31 : 280|8@1+ (1,0) [0|0] "" HMDH_206
 SG_ Ecat_LostLink3 m31 : 288|8@1+ (1,0) [0|0] "" HMDH_206
 SG_ Saf_CanId m32 : 8|8@1+ (1,0) [0|0] "" HMDH_206
 SG_ Saf_Name0 m32 : 16|8@1+ (1,0) [0|0] "" HMDH_206
 SG_ Saf_Name1 m32 : 24|8@1+ (1,0) [0|0] "" HMDH_206
 SG_ Saf_Name2 m32 : 32|8@1+ (1,0) [0|0] "" HMDH_206
 SG_ Saf_Name3 m32 : 40|8@1+ (1,0) [0|0] "" HMDH_206
 SG_ Saf_Name4 m32 : 48|8@1+ (1,0) [0|0] "" HMDH_206
 SG_ Saf_Name5 m32 : 56|8@1+ (1,0) [0|0] "" HMDH_206
 SG_ Saf_Name6 m32 : 64|8@1+ (1,0) [0|0] "" HMDH_206
 SG_ Saf_Name7 m32 : 72|8@1+ (1,0) [0|0] "" HMDH_206
 SG_ Saf_Name8 m32 : 80|8@1+ (1,0) [0|0] "" HMDH_206
 SG_ Saf_Name9 m32 : 88|8@1+ (1,0) [0|0] "" HMDH_206
 SG_ Saf_Name10 m32 : 96|8@1+ (1,0) [0|0] "" HMDH_206
 SG_ Saf_Name11 m32 : 104|8@1+ (1,0) [0|0] "" HMDH_206
 SG_ Saf_Name12 m32 : 112|8@1+ (1,0) [0|0] "" HMDH_206
 SG_ Saf_Name13 m32 : 120|8@1+ (1,0) [0|0] "" HMDH_206
 SG_ Saf_Name14 m32 : 128|8@1+ (1,0) [0|0] "" HMDH_206
 SG_ Saf_Name15 m32 : 136|8@1+ (1,0) [0|0] "" HMDH_206
 SG_ Saf_State m32 : 144|8@1+ (1,0) [0|0] "" HMDH_206
 SG_ Saf_Bits m32 : 152|16@1+ (1,0) [0|0] "" HMDH_206
 SG_ Saf_Estop m32 : 168|8@1+ (1,0) [0|0] "" HMDH_206
 SG_ Saf_FatalLatched m32 : 176|16@1+ (1,0) [0|0] "" HMDH_206
 SG_ Saf_ErrCode m32 : 192|32@1+ (1,0) [0|0] "" HMDH_206

BO_ 2163311311 STATUS_HETC_L_TACT_to_HMDH_207: 48 HETC_L_TACT
 SG_ SubCode M : 0|8@1+ (1,0) [0|0] "" HMDH_207
 SG_ Ping_CanId m5 : 8|8@1+ (1,0) [0|0] "" HMDH_207
 SG_ Ping_HostId m5 : 16|8@1+ (1,0) [0|0] "" HMDH_207
 SG_ Ping_Pid m5 : 24|16@1+ (1,0) [0|0] "" HMDH_207
 SG_ Ping_Bid m5 : 40|16@1+ (1,0) [0|0] "" HMDH_207
 SG_ Ping_Mid m5 : 56|16@1+ (1,0) [0|0] "" HMDH_207
 SG_ Ping_VerMajor m5 : 72|8@1+ (1,0) [0|0] "" HMDH_207
 SG_ Ping_VerMinor m5 : 80|8@1+ (1,0) [0|0] "" HMDH_207
 SG_ Ping_VerPatch m5 : 88|8@1+ (1,0) [0|0] "" HMDH_207
 SG_ Ping_Name0 m5 : 96|8@1+ (1,0) [0|0] "" HMDH_207
 SG_ Ping_Name1 m5 : 104|8@1+ (1,0) [0|0] "" HMDH_207
 SG_ Ping_Name2 m5 : 112|8@1+ (1,0) [0|0] "" HMDH_207
 SG_ Ping_Name3 m5 : 120|8@1+ (1,0) [0|0] "" HMDH_207
 SG_ Ping_Name4 m5 : 128|8@1+ (1,0) [0|0] "" HMDH_207
 SG_ Ping_Name5 m5 : 136|8@1+ (1,0) [0|0] "" HMDH_207
 SG_ Ping_Name6 m5 : 144|8@1+ (1,0) [0|0] "" HMDH_207
 SG_ Ping_Name7 m5 : 152|8@1+ (1,0) [0|0] "" HMDH_207
 SG_ Ping_Name8 m5 : 160|8@1+ (1,0) [0|0] "" HMDH_207
 SG_ Ping_Name9 m5 : 168|8@1+ (1,0) [0|0] "" HMDH_207
 SG_ Ping_Name10 m5 : 176|8@1+ (1,0) [0|0] "" HMDH_207
 SG_ Ping_Name11 m5 : 184|8@1+ (1,0) [0|0] "" HMDH_207
 SG_ Ping_Name12 m5 : 192|8@1+ (1,0) [0|0] "" HMDH_207
 SG_ Ping_Name13 m5 : 200|8@1+ (1,0) [0|0] "" HMDH_207
 SG_ Ping_Name14 m5 : 208|8@1+ (1,0) [0|0] "" HMDH_207
 SG_ Ping_Name15 m5 : 216|8@1+ (1,0) [0|0] "" HMDH_207
 SG_ Ping_FmtVer m5 : 224|8@1+ (1,0) [0|0] "" HMDH_207
 SG_ Ping_GitRev m5 : 232|32@1+ (1,0) [0|0] "" HMDH_207
 SG_ Ping_FwCrc m5 : 264|16@1+ (1,0) [0|0] "" HMDH_207
 SG_ Ping_UptimeS m5 : 280|16@1+ (1,0) [0|0] "s" HMDH_207
 SG_ Ecat_CanId m31 : 8|8@1+ (1,0) [0|0] "" HMDH_207
 SG_ Ecat_Name0 m31 : 16|8@1+ (1,0) [0|0] "" HMDH_207
 SG_ Ecat_Name1 m31 : 24|8@1+ (1,0) [0|0] "" HMDH_207
 SG_ Ecat_Name2 m31 : 32|8@1+ (1,0) [0|0] "" HMDH_207
 SG_ Ecat_Name3 m31 : 40|8@1+ (1,0) [0|0] "" HMDH_207
 SG_ Ecat_Name4 m31 : 48|8@1+ (1,0) [0|0] "" HMDH_207
 SG_ Ecat_Name5 m31 : 56|8@1+ (1,0) [0|0] "" HMDH_207
 SG_ Ecat_Name6 m31 : 64|8@1+ (1,0) [0|0] "" HMDH_207
 SG_ Ecat_Name7 m31 : 72|8@1+ (1,0) [0|0] "" HMDH_207
 SG_ Ecat_Name8 m31 : 80|8@1+ (1,0) [0|0] "" HMDH_207
 SG_ Ecat_Name9 m31 : 88|8@1+ (1,0) [0|0] "" HMDH_207
 SG_ Ecat_Name10 m31 : 96|8@1+ (1,0) [0|0] "" HMDH_207
 SG_ Ecat_Name11 m31 : 104|8@1+ (1,0) [0|0] "" HMDH_207
 SG_ Ecat_Name12 m31 : 112|8@1+ (1,0) [0|0] "" HMDH_207
 SG_ Ecat_Name13 m31 : 120|8@1+ (1,0) [0|0] "" HMDH_207
 SG_ Ecat_Name14 m31 : 128|8@1+ (1,0) [0|0] "" HMDH_207
 SG_ Ecat_Name15 m31 : 136|8@1+ (1,0) [0|0] "" HMDH_207
 SG_ Ecat_Link m31 : 144|8@1+ (1,0) [0|0] "" HMDH_207
 SG_ Ecat_InvalidFrame0 m31 : 152|8@1+ (1,0) [0|0] "" HMDH_207
 SG_ Ecat_InvalidFrame1 m31 : 160|8@1+ (1,0) [0|0] "" HMDH_207
 SG_ Ecat_InvalidFrame2 m31 : 168|8@1+ (1,0) [0|0] "" HMDH_207
 SG_ Ecat_InvalidFrame3 m31 : 176|8@1+ (1,0) [0|0] "" HMDH_207
 SG_ Ecat_RxError0 m31 : 184|8@1+ (1,0) [0|0] "" HMDH_207
 SG_ Ecat_RxError1 m31 : 192|8@1+ (1,0) [0|0] "" HMDH_207
 SG_ Ecat_RxError2 m31 : 200|8@1+ (1,0) [0|0] "" HMDH_207
 SG_ Ecat_RxError3 m31 : 208|8@1+ (1,0) [0|0] "" HMDH_207
 SG_ Ecat_FwdRxError0 m31 : 216|8@1+ (1,0) [0|0] "" HMDH_207
 SG_ Ecat_FwdRxError1 m31 : 224|8@1+ (1,0) [0|0] "" HMDH_207
 SG_ Ecat_FwdRxError2 m31 : 232|8@1+ (1,0) [0|0] "" HMDH_207
 SG_ Ecat_FwdRxError3 m31 : 240|8@1+ (1,0) [0|0] "" HMDH_207
 SG_ Ecat_PuError m31 : 248|8@1+ (1,0) [0|0] "" HMDH_207
 SG_ Ecat_PdiError m31 : 256|8@1+ (1,0) [0|0] "" HMDH_207
 SG_ Ecat_LostLink0 m31 : 264|8@1+ (1,0) [0|0] "" HMDH_207
 SG_ Ecat_LostLink1 m31 : 272|8@1+ (1,0) [0|0] "" HMDH_207
 SG_ Ecat_LostLink2 m31 : 280|8@1+ (1,0) [0|0] "" HMDH_207
 SG_ Ecat_LostLink3 m31 : 288|8@1+ (1,0) [0|0] "" HMDH_207
 SG_ Saf_CanId m32 : 8|8@1+ (1,0) [0|0] "" HMDH_207
 SG_ Saf_Name0 m32 : 16|8@1+ (1,0) [0|0] "" HMDH_207
 SG_ Saf_Name1 m32 : 24|8@1+ (1,0) [0|0] "" HMDH_207
 SG_ Saf_Name2 m32 : 32|8@1+ (1,0) [0|0] "" HMDH_207
 SG_ Saf_Name3 m32 : 40|8@1+ (1,0) [0|0] "" HMDH_207
 SG_ Saf_Name4 m32 : 48|8@1+ (1,0) [0|0] "" HMDH_207
 SG_ Saf_Name5 m32 : 56|8@1+ (1,0) [0|0] "" HMDH_207
 SG_ Saf_Name6 m32 : 64|8@1+ (1,0) [0|0] "" HMDH_207
 SG_ Saf_Name7 m32 : 72|8@1+ (1,0) [0|0] "" HMDH_207
 SG_ Saf_Name8 m32 : 80|8@1+ (1,0) [0|0] "" HMDH_207
 SG_ Saf_Name9 m32 : 88|8@1+ (1,0) [0|0] "" HMDH_207
 SG_ Saf_Name10 m32 : 96|8@1+ (1,0) [0|0] "" HMDH_207
 SG_ Saf_Name11 m32 : 104|8@1+ (1,0) [0|0] "" HMDH_207
 SG_ Saf_Name12 m32 : 112|8@1+ (1,0) [0|0] "" HMDH_207
 SG_ Saf_Name13 m32 : 120|8@1+ (1,0) [0|0] "" HMDH_207
 SG_ Saf_Name14 m32 : 128|8@1+ (1,0) [0|0] "" HMDH_207
 SG_ Saf_Name15 m32 : 136|8@1+ (1,0) [0|0] "" HMDH_207
 SG_ Saf_State m32 : 144|8@1+ (1,0) [0|0] "" HMDH_207
 SG_ Saf_Bits m32 : 152|16@1+ (1,0) [0|0] "" HMDH_207
 SG_ Saf_Estop m32 : 168|8@1+ (1,0) [0|0] "" HMDH_207
 SG_ Saf_FatalLatched m32 : 176|16@1+ (1,0) [0|0] "" HMDH_207
 SG_ Saf_ErrCode m32 : 192|32@1+ (1,0) [0|0] "" HMDH_207

BO_ 2163313764 STATUS_HETC_R_ARM_to_HETC_M_MOB: 48 HETC_R_ARM
 SG_ SubCode M : 0|8@1+ (1,0) [0|0] "" HETC_M_MOB
 SG_ Ping_CanId m5 : 8|8@1+ (1,0) [0|0] "" HETC_M_MOB
 SG_ Ping_HostId m5 : 16|8@1+ (1,0) [0|0] "" HETC_M_MOB
 SG_ Ping_Pid m5 : 24|16@1+ (1,0) [0|0] "" HETC_M_MOB
 SG_ Ping_Bid m5 : 40|16@1+ (1,0) [0|0] "" HETC_M_MOB
 SG_ Ping_Mid m5 : 56|16@1+ (1,0) [0|0] "" HETC_M_MOB
 SG_ Ping_VerMajor m5 : 72|8@1+ (1,0) [0|0] "" HETC_M_MOB
 SG_ Ping_VerMinor m5 : 80|8@1+ (1,0) [0|0] "" HETC_M_MOB
 SG_ Ping_VerPatch m5 : 88|8@1+ (1,0) [0|0] "" HETC_M_MOB
 SG_ Ping_Name0 m5 : 96|8@1+ (1,0) [0|0] "" HETC_M_MOB
 SG_ Ping_Name1 m5 : 104|8@1+ (1,0) [0|0] "" HETC_M_MOB
 SG_ Ping_Name2 m5 : 112|8@1+ (1,0) [0|0] "" HETC_M_MOB
 SG_ Ping_Name3 m5 : 120|8@1+ (1,0) [0|0] "" HETC_M_MOB
 SG_ Ping_Name4 m5 : 128|8@1+ (1,0) [0|0] "" HETC_M_MOB
 SG_ Ping_Name5 m5 : 136|8@1+ (1,0) [0|0] "" HETC_M_MOB
 SG_ Ping_Name6 m5 : 144|8@1+ (1,0) [0|0] "" HETC_M_MOB
 SG_ Ping_Name7 m5 : 152|8@1+ (1,0) [0|0] "" HETC_M_MOB
 SG_ Ping_Name8 m5 : 160|8@1+ (1,0) [0|0] "" HETC_M_MOB
 SG_ Ping_Name9 m5 : 168|8@1+ (1,0) [0|0] "" HETC_M_MOB
 SG_ Ping_Name10 m5 : 176|8@1+ (1,0) [0|0] "" HETC_M_MOB
 SG_ Ping_Name11 m5 : 184|8@1+ (1,0) [0|0] "" HETC_M_MOB
 SG_ Ping_Name12 m5 : 192|8@1+ (1,0) [0|0] "" HETC_M_MOB
 SG_ Ping_Name13 m5 : 200|8@1+ (1,0) [0|0] "" HETC_M_MOB
 SG_ Ping_Name14 m5 : 208|8@1+ (1,0) [0|0] "" HETC_M_MOB
 SG_ Ping_Name15 m5 : 216|8@1+ (1,0) [0|0] "" HETC_M_MOB
 SG_ Ping_FmtVer m5 : 224|8@1+ (1,0) [0|0] "" HETC_M_MOB
 SG_ Ping_GitRev m5 : 232|32@1+ (1,0) [0|0] "" HETC_M_MOB
 SG_ Ping_FwCrc m5 : 264|16@1+ (1,0) [0|0] "" HETC_M_MOB
 SG_ Ping_UptimeS m5 : 280|16@1+ (1,0) [0|0] "s" HETC_M_MOB
 SG_ Ecat_CanId m31 : 8|8@1+ (1,0) [0|0] "" HETC_M_MOB
 SG_ Ecat_Name0 m31 : 16|8@1+ (1,0) [0|0] "" HETC_M_MOB
 SG_ Ecat_Name1 m31 : 24|8@1+ (1,0) [0|0] "" HETC_M_MOB
 SG_ Ecat_Name2 m31 : 32|8@1+ (1,0) [0|0] "" HETC_M_MOB
 SG_ Ecat_Name3 m31 : 40|8@1+ (1,0) [0|0] "" HETC_M_MOB
 SG_ Ecat_Name4 m31 : 48|8@1+ (1,0) [0|0] "" HETC_M_MOB
 SG_ Ecat_Name5 m31 : 56|8@1+ (1,0) [0|0] "" HETC_M_MOB
 SG_ Ecat_Name6 m31 : 64|8@1+ (1,0) [0|0] "" HETC_M_MOB
 SG_ Ecat_Name7 m31 : 72|8@1+ (1,0) [0|0] "" HETC_M_MOB
 SG_ Ecat_Name8 m31 : 80|8@1+ (1,0) [0|0] "" HETC_M_MOB
 SG_ Ecat_Name9 m31 : 88|8@1+ (1,0) [0|0] "" HETC_M_MOB
 SG_ Ecat_Name10 m31 : 96|8@1+ (1,0) [0|0] "" HETC_M_MOB
 SG_ Ecat_Name11 m31 : 104|8@1+ (1,0) [0|0] "" HETC_M_MOB
 SG_ Ecat_Name12 m31 : 112|8@1+ (1,0) [0|0] "" HETC_M_MOB
 SG_ Ecat_Name13 m31 : 120|8@1+ (1,0) [0|0] "" HETC_M_MOB
 SG_ Ecat_Name14 m31 : 128|8@1+ (1,0) [0|0] "" HETC_M_MOB
 SG_ Ecat_Name15 m31 : 136|8@1+ (1,0) [0|0] "" HETC_M_MOB
 SG_ Ecat_Link m31 : 144|8@1+ (1,0) [0|0] "" HETC_M_MOB
 SG_ Ecat_InvalidFrame0 m31 : 152|8@1+ (1,0) [0|0] "" HETC_M_MOB
 SG_ Ecat_InvalidFrame1 m31 : 160|8@1+ (1,0) [0|0] "" HETC_M_MOB
 SG_ Ecat_InvalidFrame2 m31 : 168|8@1+ (1,0) [0|0] "" HETC_M_MOB
 SG_ Ecat_InvalidFrame3 m31 : 176|8@1+ (1,0) [0|0] "" HETC_M_MOB
 SG_ Ecat_RxError0 m31 : 184|8@1+ (1,0) [0|0] "" HETC_M_MOB
 SG_ Ecat_RxError1 m31 : 192|8@1+ (1,0) [0|0] "" HETC_M_MOB
 SG_ Ecat_RxError2 m31 : 200|8@1+ (1,0) [0|0] "" HETC_M_MOB
 SG_ Ecat_RxError3 m31 : 208|8@1+ (1,0) [0|0] "" HETC_M_MOB
 SG_ Ecat_FwdRxError0 m31 : 216|8@1+ (1,0) [0|0] "" HETC_M_MOB
 SG_ Ecat_FwdRxError1 m31 : 224|8@1+ (1,0) [0|0] "" HETC_M_MOB
 SG_ Ecat_FwdRxError2 m31 : 232|8@1+ (1,0) [0|0] "" HETC_M_MOB
 SG_ Ecat_FwdRxError3 m31 : 240|8@1+ (1,0) [0|0] "" HETC_M_MOB
 SG_ Ecat_PuError m31 : 248|8@1+ (1,0) [0|0] "" HETC_M_MOB
 SG_ Ecat_PdiError m31 : 256|8@1+ (1,0) [0|0] "" HETC_M_MOB
 SG_ Ecat_LostLink0 m31 : 264|8@1+ (1,0) [0|0] "" HETC_M_MOB
 SG_ Ecat_LostLink1 m31 : 272|8@1+ (1,0) [0|0] "" HETC_M_MOB
 SG_ Ecat_LostLink2 m31 : 280|8@1+ (1,0) [0|0] "" HETC_M_MOB
 SG_ Ecat_LostLink3 m31 : 288|8@1+ (1,0) [0|0] "" HETC_M_MOB
 SG_ Saf_CanId m32 : 8|8@1+ (1,0) [0|0] "" HETC_M_MOB
 SG_ Saf_Name0 m32 : 16|8@1+ (1,0) [0|0] "" HETC_M_MOB
 SG_ Saf_Name1 m32 : 24|8@1+ (1,0) [0|0] "" HETC_M_MOB
 SG_ Saf_Name2 m32 : 32|8@1+ (1,0) [0|0] "" HETC_M_MOB
 SG_ Saf_Name3 m32 : 40|8@1+ (1,0) [0|0] "" HETC_M_MOB
 SG_ Saf_Name4 m32 : 48|8@1+ (1,0) [0|0] "" HETC_M_MOB
 SG_ Saf_Name5 m32 : 56|8@1+ (1,0) [0|0] "" HETC_M_MOB
 SG_ Saf_Name6 m32 : 64|8@1+ (1,0) [0|0] "" HETC_M_MOB
 SG_ Saf_Name7 m32 : 72|8@1+ (1,0) [0|0] "" HETC_M_MOB
 SG_ Saf_Name8 m32 : 80|8@1+ (1,0) [0|0] "" HETC_M_MOB
 SG_ Saf_Name9 m32 : 88|8@1+ (1,0) [0|0] "" HETC_M_MOB
 SG_ Saf_Name10 m32 : 96|8@1+ (1,0) [0|0] "" HETC_M_MOB
 SG_ Saf_Name11 m32 : 104|8@1+ (1,0) [0|0] "" HETC_M_MOB
 SG_ Saf_Name12 m32 : 112|8@1+ (1,0) [0|0] "" HETC_M_MOB
 SG_ Saf_Name13 m32 : 120|8@1+ (1,0) [0|0] "" HETC_M_MOB
 SG_ Saf_Name14 m32 : 128|8@1+ (1,0) [0|0] "" HETC_M_MOB
 SG_ Saf_Name15 m32 : 136|8@1+ (1,0) [0|0] "" HETC_M_MOB
 SG_ Saf_State m32 : 144|8@1+ (1,0) [0|0] "" HETC_M_MOB
 SG_ Saf_Bits m32 : 152|16@1+ (1,0) [0|0] "" HETC_M_MOB
 SG_ Saf_Estop m32 : 168|8@1+ (1,0) [0|0] "" HETC_M_MOB
 SG_ Saf_FatalLatched m32 : 176|16@1+ (1,0) [0|0] "" HETC_M_MOB
 SG_ Saf_ErrCode m32 : 192|32@1+ (1,0) [0|0] "" HETC_M_MOB

BO_ 2163313774 STATUS_HETC_R_ARM_to_HETC_M_WST: 48 HETC_R_ARM
 SG_ SubCode M : 0|8@1+ (1,0) [0|0] "" HETC_M_WST
 SG_ Ping_CanId m5 : 8|8@1+ (1,0) [0|0] "" HETC_M_WST
 SG_ Ping_HostId m5 : 16|8@1+ (1,0) [0|0] "" HETC_M_WST
 SG_ Ping_Pid m5 : 24|16@1+ (1,0) [0|0] "" HETC_M_WST
 SG_ Ping_Bid m5 : 40|16@1+ (1,0) [0|0] "" HETC_M_WST
 SG_ Ping_Mid m5 : 56|16@1+ (1,0) [0|0] "" HETC_M_WST
 SG_ Ping_VerMajor m5 : 72|8@1+ (1,0) [0|0] "" HETC_M_WST
 SG_ Ping_VerMinor m5 : 80|8@1+ (1,0) [0|0] "" HETC_M_WST
 SG_ Ping_VerPatch m5 : 88|8@1+ (1,0) [0|0] "" HETC_M_WST
 SG_ Ping_Name0 m5 : 96|8@1+ (1,0) [0|0] "" HETC_M_WST
 SG_ Ping_Name1 m5 : 104|8@1+ (1,0) [0|0] "" HETC_M_WST
 SG_ Ping_Name2 m5 : 112|8@1+ (1,0) [0|0] "" HETC_M_WST
 SG_ Ping_Name3 m5 : 120|8@1+ (1,0) [0|0] "" HETC_M_WST
 SG_ Ping_Name4 m5 : 128|8@1+ (1,0) [0|0] "" HETC_M_WST
 SG_ Ping_Name5 m5 : 136|8@1+ (1,0) [0|0] "" HETC_M_WST
 SG_ Ping_Name6 m5 : 144|8@1+ (1,0) [0|0] "" HETC_M_WST
 SG_ Ping_Name7 m5 : 152|8@1+ (1,0) [0|0] "" HETC_M_WST
 SG_ Ping_Name8 m5 : 160|8@1+ (1,0) [0|0] "" HETC_M_WST
 SG_ Ping_Name9 m5 : 168|8@1+ (1,0) [0|0] "" HETC_M_WST
 SG_ Ping_Name10 m5 : 176|8@1+ (1,0) [0|0] "" HETC_M_WST
 SG_ Ping_Name11 m5 : 184|8@1+ (1,0) [0|0] "" HETC_M_WST
 SG_ Ping_Name12 m5 : 192|8@1+ (1,0) [0|0] "" HETC_M_WST
 SG_ Ping_Name13 m5 : 200|8@1+ (1,0) [0|0] "" HETC_M_WST
 SG_ Ping_Name14 m5 : 208|8@1+ (1,0) [0|0] "" HETC_M_WST
 SG_ Ping_Name15 m5 : 216|8@1+ (1,0) [0|0] "" HETC_M_WST
 SG_ Ping_FmtVer m5 : 224|8@1+ (1,0) [0|0] "" HETC_M_WST
 SG_ Ping_GitRev m5 : 232|32@1+ (1,0) [0|0] "" HETC_M_WST
 SG_ Ping_FwCrc m5 : 264|16@1+ (1,0) [0|0] "" HETC_M_WST
 SG_ Ping_UptimeS m5 : 280|16@1+ (1,0) [0|0] "s" HETC_M_WST
 SG_ Ecat_CanId m31 : 8|8@1+ (1,0) [0|0] "" HETC_M_WST
 SG_ Ecat_Name0 m31 : 16|8@1+ (1,0) [0|0] "" HETC_M_WST
 SG_ Ecat_Name1 m31 : 24|8@1+ (1,0) [0|0] "" HETC_M_WST
 SG_ Ecat_Name2 m31 : 32|8@1+ (1,0) [0|0] "" HETC_M_WST
 SG_ Ecat_Name3 m31 : 40|8@1+ (1,0) [0|0] "" HETC_M_WST
 SG_ Ecat_Name4 m31 : 48|8@1+ (1,0) [0|0] "" HETC_M_WST
 SG_ Ecat_Name5 m31 : 56|8@1+ (1,0) [0|0] "" HETC_M_WST
 SG_ Ecat_Name6 m31 : 64|8@1+ (1,0) [0|0] "" HETC_M_WST
 SG_ Ecat_Name7 m31 : 72|8@1+ (1,0) [0|0] "" HETC_M_WST
 SG_ Ecat_Name8 m31 : 80|8@1+ (1,0) [0|0] "" HETC_M_WST
 SG_ Ecat_Name9 m31 : 88|8@1+ (1,0) [0|0] "" HETC_M_WST
 SG_ Ecat_Name10 m31 : 96|8@1+ (1,0) [0|0] "" HETC_M_WST
 SG_ Ecat_Name11 m31 : 104|8@1+ (1,0) [0|0] "" HETC_M_WST
 SG_ Ecat_Name12 m31 : 112|8@1+ (1,0) [0|0] "" HETC_M_WST
 SG_ Ecat_Name13 m31 : 120|8@1+ (1,0) [0|0] "" HETC_M_WST
 SG_ Ecat_Name14 m31 : 128|8@1+ (1,0) [0|0] "" HETC_M_WST
 SG_ Ecat_Name15 m31 : 136|8@1+ (1,0) [0|0] "" HETC_M_WST
 SG_ Ecat_Link m31 : 144|8@1+ (1,0) [0|0] "" HETC_M_WST
 SG_ Ecat_InvalidFrame0 m31 : 152|8@1+ (1,0) [0|0] "" HETC_M_WST
 SG_ Ecat_InvalidFrame1 m31 : 160|8@1+ (1,0) [0|0] "" HETC_M_WST
 SG_ Ecat_InvalidFrame2 m31 : 168|8@1+ (1,0) [0|0] "" HETC_M_WST
 SG_ Ecat_InvalidFrame3 m31 : 176|8@1+ (1,0) [0|0] "" HETC_M_WST
 SG_ Ecat_RxError0 m31 : 184|8@1+ (1,0) [0|0] "" HETC_M_WST
 SG_ Ecat_RxError1 m31 : 192|8@1+ (1,0) [0|0] "" HETC_M_WST
 SG_ Ecat_RxError2 m31 : 200|8@1+ (1,0) [0|0] "" HETC_M_WST
 SG_ Ecat_RxError3 m31 : 208|8@1+ (1,0) [0|0] "" HETC_M_WST
 SG_ Ecat_FwdRxError0 m31 : 216|8@1+ (1,0) [0|0] "" HETC_M_WST
 SG_ Ecat_FwdRxError1 m31 : 224|8@1+ (1,0) [0|0] "" HETC_M_WST
 SG_ Ecat_FwdRxError2 m31 : 232|8@1+ (1,0) [0|0] "" HETC_M_WST
 SG_ Ecat_FwdRxError3 m31 : 240|8@1+ (1,0) [0|0] "" HETC_M_WST
 SG_ Ecat_PuError m31 : 248|8@1+ (1,0) [0|0] "" HETC_M_WST
 SG_ Ecat_PdiError m31 : 256|8@1+ (1,0) [0|0] "" HETC_M_WST
 SG_ Ecat_LostLink0 m31 : 264|8@1+ (1,0) [0|0] "" HETC_M_WST
 SG_ Ecat_LostLink1 m31 : 272|8@1+ (1,0) [0|0] "" HETC_M_WST
 SG_ Ecat_LostLink2 m31 : 280|8@1+ (1,0) [0|0] "" HETC_M_WST
 SG_ Ecat_LostLink3 m31 : 288|8@1+ (1,0) [0|0] "" HETC_M_WST
 SG_ Saf_CanId m32 : 8|8@1+ (1,0) [0|0] "" HETC_M_WST
 SG_ Saf_Name0 m32 : 16|8@1+ (1,0) [0|0] "" HETC_M_WST
 SG_ Saf_Name1 m32 : 24|8@1+ (1,0) [0|0] "" HETC_M_WST
 SG_ Saf_Name2 m32 : 32|8@1+ (1,0) [0|0] "" HETC_M_WST
 SG_ Saf_Name3 m32 : 40|8@1+ (1,0) [0|0] "" HETC_M_WST
 SG_ Saf_Name4 m32 : 48|8@1+ (1,0) [0|0] "" HETC_M_WST
 SG_ Saf_Name5 m32 : 56|8@1+ (1,0) [0|0] "" HETC_M_WST
 SG_ Saf_Name6 m32 : 64|8@1+ (1,0) [0|0] "" HETC_M_WST
 SG_ Saf_Name7 m32 : 72|8@1+ (1,0) [0|0] "" HETC_M_WST
 SG_ Saf_Name8 m32 : 80|8@1+ (1,0) [0|0] "" HETC_M_WST
 SG_ Saf_Name9 m32 : 88|8@1+ (1,0) [0|0] "" HETC_M_WST
 SG_ Saf_Name10 m32 : 96|8@1+ (1,0) [0|0] "" HETC_M_WST
 SG_ Saf_Name11 m32 : 104|8@1+ (1,0) [0|0] "" HETC_M_WST
 SG_ Saf_Name12 m32 : 112|8@1+ (1,0) [0|0] "" HETC_M_WST
 SG_ Saf_Name13 m32 : 120|8@1+ (1,0) [0|0] "" HETC_M_WST
 SG_ Saf_Name14 m32 : 128|8@1+ (1,0) [0|0] "" HETC_M_WST
 SG_ Saf_Name15 m32 : 136|8@1+ (1,0) [0|0] "" HETC_M_WST
 SG_ Saf_State m32 : 144|8@1+ (1,0) [0|0] "" HETC_M_WST
 SG_ Saf_Bits m32 : 152|16@1+ (1,0) [0|0] "" HETC_M_WST
 SG_ Saf_Estop m32 : 168|8@1+ (1,0) [0|0] "" HETC_M_WST
 SG_ Saf_FatalLatched m32 : 176|16@1+ (1,0) [0|0] "" HETC_M_WST
 SG_ Saf_ErrCode m32 : 192|32@1+ (1,0) [0|0] "" HETC_M_WST

BO_ 2163313784 STATUS_HETC_R_ARM_to_HETC_L_ARM: 48 HETC_R_ARM
 SG_ SubCode M : 0|8@1+ (1,0) [0|0] "" HETC_L_ARM
 SG_ Ping_CanId m5 : 8|8@1+ (1,0) [0|0] "" HETC_L_ARM
 SG_ Ping_HostId m5 : 16|8@1+ (1,0) [0|0] "" HETC_L_ARM
 SG_ Ping_Pid m5 : 24|16@1+ (1,0) [0|0] "" HETC_L_ARM
 SG_ Ping_Bid m5 : 40|16@1+ (1,0) [0|0] "" HETC_L_ARM
 SG_ Ping_Mid m5 : 56|16@1+ (1,0) [0|0] "" HETC_L_ARM
 SG_ Ping_VerMajor m5 : 72|8@1+ (1,0) [0|0] "" HETC_L_ARM
 SG_ Ping_VerMinor m5 : 80|8@1+ (1,0) [0|0] "" HETC_L_ARM
 SG_ Ping_VerPatch m5 : 88|8@1+ (1,0) [0|0] "" HETC_L_ARM
 SG_ Ping_Name0 m5 : 96|8@1+ (1,0) [0|0] "" HETC_L_ARM
 SG_ Ping_Name1 m5 : 104|8@1+ (1,0) [0|0] "" HETC_L_ARM
 SG_ Ping_Name2 m5 : 112|8@1+ (1,0) [0|0] "" HETC_L_ARM
 SG_ Ping_Name3 m5 : 120|8@1+ (1,0) [0|0] "" HETC_L_ARM
 SG_ Ping_Name4 m5 : 128|8@1+ (1,0) [0|0] "" HETC_L_ARM
 SG_ Ping_Name5 m5 : 136|8@1+ (1,0) [0|0] "" HETC_L_ARM
 SG_ Ping_Name6 m5 : 144|8@1+ (1,0) [0|0] "" HETC_L_ARM
 SG_ Ping_Name7 m5 : 152|8@1+ (1,0) [0|0] "" HETC_L_ARM
 SG_ Ping_Name8 m5 : 160|8@1+ (1,0) [0|0] "" HETC_L_ARM
 SG_ Ping_Name9 m5 : 168|8@1+ (1,0) [0|0] "" HETC_L_ARM
 SG_ Ping_Name10 m5 : 176|8@1+ (1,0) [0|0] "" HETC_L_ARM
 SG_ Ping_Name11 m5 : 184|8@1+ (1,0) [0|0] "" HETC_L_ARM
 SG_ Ping_Name12 m5 : 192|8@1+ (1,0) [0|0] "" HETC_L_ARM
 SG_ Ping_Name13 m5 : 200|8@1+ (1,0) [0|0] "" HETC_L_ARM
 SG_ Ping_Name14 m5 : 208|8@1+ (1,0) [0|0] "" HETC_L_ARM
 SG_ Ping_Name15 m5 : 216|8@1+ (1,0) [0|0] "" HETC_L_ARM
 SG_ Ping_FmtVer m5 : 224|8@1+ (1,0) [0|0] "" HETC_L_ARM
 SG_ Ping_GitRev m5 : 232|32@1+ (1,0) [0|0] "" HETC_L_ARM
 SG_ Ping_FwCrc m5 : 264|16@1+ (1,0) [0|0] "" HETC_L_ARM
 SG_ Ping_UptimeS m5 : 280|16@1+ (1,0) [0|0] "s" HETC_L_ARM
 SG_ Ecat_CanId m31 : 8|8@1+ (1,0) [0|0] "" HETC_L_ARM
 SG_ Ecat_Name0 m31 : 16|8@1+ (1,0) [0|0] "" HETC_L_ARM
 SG_ Ecat_Name1 m31 : 24|8@1+ (1,0) [0|0] "" HETC_L_ARM
 SG_ Ecat_Name2 m31 : 32|8@1+ (1,0) [0|0] "" HETC_L_ARM
 SG_ Ecat_Name3 m31 : 40|8@1+ (1,0) [0|0] "" HETC_L_ARM
 SG_ Ecat_Name4 m31 : 48|8@1+ (1,0) [0|0] "" HETC_L_ARM
 SG_ Ecat_Name5 m31 : 56|8@1+ (1,0) [0|0] "" HETC_L_ARM
 SG_ Ecat_Name6 m31 : 64|8@1+ (1,0) [0|0] "" HETC_L_ARM
 SG_ Ecat_Name7 m31 : 72|8@1+ (1,0) [0|0] "" HETC_L_ARM
 SG_ Ecat_Name8 m31 : 80|8@1+ (1,0) [0|0] "" HETC_L_ARM
 SG_ Ecat_Name9 m31 : 88|8@1+ (1,0) [0|0] "" HETC_L_ARM
 SG_ Ecat_Name10 m31 : 96|8@1+ (1,0) [0|0] "" HETC_L_ARM
 SG_ Ecat_Name11 m31 : 104|8@1+ (1,0) [0|0] "" HETC_L_ARM
 SG_ Ecat_Name12 m31 : 112|8@1+ (1,0) [0|0] "" HETC_L_ARM
 SG_ Ecat_Name13 m31 : 120|8@1+ (1,0) [0|0] "" HETC_L_ARM
 SG_ Ecat_Name14 m31 : 128|8@1+ (1,0) [0|0] "" HETC_L_ARM
 SG_ Ecat_Name15 m31 : 136|8@1+ (1,0) [0|0] "" HETC_L_ARM
 SG_ Ecat_Link m31 : 144|8@1+ (1,0) [0|0] "" HETC_L_ARM
 SG_ Ecat_InvalidFrame0 m31 : 152|8@1+ (1,0) [0|0] "" HETC_L_ARM
 SG_ Ecat_InvalidFrame1 m31 : 160|8@1+ (1,0) [0|0] "" HETC_L_ARM
 SG_ Ecat_InvalidFrame2 m31 : 168|8@1+ (1,0) [0|0] "" HETC_L_ARM
 SG_ Ecat_InvalidFrame3 m31 : 176|8@1+ (1,0) [0|0] "" HETC_L_ARM
 SG_ Ecat_RxError0 m31 : 184|8@1+ (1,0) [0|0] "" HETC_L_ARM
 SG_ Ecat_RxError1 m31 : 192|8@1+ (1,0) [0|0] "" HETC_L_ARM
 SG_ Ecat_RxError2 m31 : 200|8@1+ (1,0) [0|0] "" HETC_L_ARM
 SG_ Ecat_RxError3 m31 : 208|8@1+ (1,0) [0|0] "" HETC_L_ARM
 SG_ Ecat_FwdRxError0 m31 : 216|8@1+ (1,0) [0|0] "" HETC_L_ARM
 SG_ Ecat_FwdRxError1 m31 : 224|8@1+ (1,0) [0|0] "" HETC_L_ARM
 SG_ Ecat_FwdRxError2 m31 : 232|8@1+ (1,0) [0|0] "" HETC_L_ARM
 SG_ Ecat_FwdRxError3 m31 : 240|8@1+ (1,0) [0|0] "" HETC_L_ARM
 SG_ Ecat_PuError m31 : 248|8@1+ (1,0) [0|0] "" HETC_L_ARM
 SG_ Ecat_PdiError m31 : 256|8@1+ (1,0) [0|0] "" HETC_L_ARM
 SG_ Ecat_LostLink0 m31 : 264|8@1+ (1,0) [0|0] "" HETC_L_ARM
 SG_ Ecat_LostLink1 m31 : 272|8@1+ (1,0) [0|0] "" HETC_L_ARM
 SG_ Ecat_LostLink2 m31 : 280|8@1+ (1,0) [0|0] "" HETC_L_ARM
 SG_ Ecat_LostLink3 m31 : 288|8@1+ (1,0) [0|0] "" HETC_L_ARM
 SG_ Saf_CanId m32 : 8|8@1+ (1,0) [0|0] "" HETC_L_ARM
 SG_ Saf_Name0 m32 : 16|8@1+ (1,0) [0|0] "" HETC_L_ARM
 SG_ Saf_Name1 m32 : 24|8@1+ (1,0) [0|0] "" HETC_L_ARM
 SG_ Saf_Name2 m32 : 32|8@1+ (1,0) [0|0] "" HETC_L_ARM
 SG_ Saf_Name3 m32 : 40|8@1+ (1,0) [0|0] "" HETC_L_ARM
 SG_ Saf_Name4 m32 : 48|8@1+ (1,0) [0|0] "" HETC_L_ARM
 SG_ Saf_Name5 m32 : 56|8@1+ (1,0) [0|0] "" HETC_L_ARM
 SG_ Saf_Name6 m32 : 64|8@1+ (1,0) [0|0] "" HETC_L_ARM
 SG_ Saf_Name7 m32 : 72|8@1+ (1,0) [0|0] "" HETC_L_ARM
 SG_ Saf_Name8 m32 : 80|8@1+ (1,0) [0|0] "" HETC_L_ARM
 SG_ Saf_Name9 m32 : 88|8@1+ (1,0) [0|0] "" HETC_L_ARM
 SG_ Saf_Name10 m32 : 96|8@1+ (1,0) [0|0] "" HETC_L_ARM
 SG_ Saf_Name11 m32 : 104|8@1+ (1,0) [0|0] "" HETC_L_ARM
 SG_ Saf_Name12 m32 : 112|8@1+ (1,0) [0|0] "" HETC_L_ARM
 SG_ Saf_Name13 m32 : 120|8@1+ (1,0) [0|0] "" HETC_L_ARM
 SG_ Saf_Name14 m32 : 128|8@1+ (1,0) [0|0] "" HETC_L_ARM
 SG_ Saf_Name15 m32 : 136|8@1+ (1,0) [0|0] "" HETC_L_ARM
 SG_ Saf_State m32 : 144|8@1+ (1,0) [0|0] "" HETC_L_ARM
 SG_ Saf_Bits m32 : 152|16@1+ (1,0) [0|0] "" HETC_L_ARM
 SG_ Saf_Estop m32 : 168|8@1+ (1,0) [0|0] "" HETC_L_ARM
 SG_ Saf_FatalLatched m32 : 176|16@1+ (1,0) [0|0] "" HETC_L_ARM
 SG_ Saf_ErrCode m32 : 192|32@1+ (1,0) [0|0] "" HETC_L_ARM

BO_ 2163313794 STATUS_HETC_R_ARM_to_HETC_L_TACT: 48 HETC_R_ARM
 SG_ SubCode M : 0|8@1+ (1,0) [0|0] "" HETC_L_TACT
 SG_ Ping_CanId m5 : 8|8@1+ (1,0) [0|0] "" HETC_L_TACT
 SG_ Ping_HostId m5 : 16|8@1+ (1,0) [0|0] "" HETC_L_TACT
 SG_ Ping_Pid m5 : 24|16@1+ (1,0) [0|0] "" HETC_L_TACT
 SG_ Ping_Bid m5 : 40|16@1+ (1,0) [0|0] "" HETC_L_TACT
 SG_ Ping_Mid m5 : 56|16@1+ (1,0) [0|0] "" HETC_L_TACT
 SG_ Ping_VerMajor m5 : 72|8@1+ (1,0) [0|0] "" HETC_L_TACT
 SG_ Ping_VerMinor m5 : 80|8@1+ (1,0) [0|0] "" HETC_L_TACT
 SG_ Ping_VerPatch m5 : 88|8@1+ (1,0) [0|0] "" HETC_L_TACT
 SG_ Ping_Name0 m5 : 96|8@1+ (1,0) [0|0] "" HETC_L_TACT
 SG_ Ping_Name1 m5 : 104|8@1+ (1,0) [0|0] "" HETC_L_TACT
 SG_ Ping_Name2 m5 : 112|8@1+ (1,0) [0|0] "" HETC_L_TACT
 SG_ Ping_Name3 m5 : 120|8@1+ (1,0) [0|0] "" HETC_L_TACT
 SG_ Ping_Name4 m5 : 128|8@1+ (1,0) [0|0] "" HETC_L_TACT
 SG_ Ping_Name5 m5 : 136|8@1+ (1,0) [0|0] "" HETC_L_TACT
 SG_ Ping_Name6 m5 : 144|8@1+ (1,0) [0|0] "" HETC_L_TACT
 SG_ Ping_Name7 m5 : 152|8@1+ (1,0) [0|0] "" HETC_L_TACT
 SG_ Ping_Name8 m5 : 160|8@1+ (1,0) [0|0] "" HETC_L_TACT
 SG_ Ping_Name9 m5 : 168|8@1+ (1,0) [0|0] "" HETC_L_TACT
 SG_ Ping_Name10 m5 : 176|8@1+ (1,0) [0|0] "" HETC_L_TACT
 SG_ Ping_Name11 m5 : 184|8@1+ (1,0) [0|0] "" HETC_L_TACT
 SG_ Ping_Name12 m5 : 192|8@1+ (1,0) [0|0] "" HETC_L_TACT
 SG_ Ping_Name13 m5 : 200|8@1+ (1,0) [0|0] "" HETC_L_TACT
 SG_ Ping_Name14 m5 : 208|8@1+ (1,0) [0|0] "" HETC_L_TACT
 SG_ Ping_Name15 m5 : 216|8@1+ (1,0) [0|0] "" HETC_L_TACT
 SG_ Ping_FmtVer m5 : 224|8@1+ (1,0) [0|0] "" HETC_L_TACT
 SG_ Ping_GitRev m5 : 232|32@1+ (1,0) [0|0] "" HETC_L_TACT
 SG_ Ping_FwCrc m5 : 264|16@1+ (1,0) [0|0] "" HETC_L_TACT
 SG_ Ping_UptimeS m5 : 280|16@1+ (1,0) [0|0] "s" HETC_L_TACT
 SG_ Ecat_CanId m31 : 8|8@1+ (1,0) [0|0] "" HETC_L_TACT
 SG_ Ecat_Name0 m31 : 16|8@1+ (1,0) [0|0] "" HETC_L_TACT
 SG_ Ecat_Name1 m31 : 24|8@1+ (1,0) [0|0] "" HETC_L_TACT
 SG_ Ecat_Name2 m31 : 32|8@1+ (1,0) [0|0] "" HETC_L_TACT
 SG_ Ecat_Name3 m31 : 40|8@1+ (1,0) [0|0] "" HETC_L_TACT
 SG_ Ecat_Name4 m31 : 48|8@1+ (1,0) [0|0] "" HETC_L_TACT
 SG_ Ecat_Name5 m31 : 56|8@1+ (1,0) [0|0] "" HETC_L_TACT
 SG_ Ecat_Name6 m31 : 64|8@1+ (1,0) [0|0] "" HETC_L_TACT
 SG_ Ecat_Name7 m31 : 72|8@1+ (1,0) [0|0] "" HETC_L_TACT
 SG_ Ecat_Name8 m31 : 80|8@1+ (1,0) [0|0] "" HETC_L_TACT
 SG_ Ecat_Name9 m31 : 88|8@1+ (1,0) [0|0] "" HETC_L_TACT
 SG_ Ecat_Name10 m31 : 96|8@1+ (1,0) [0|0] "" HETC_L_TACT
 SG_ Ecat_Name11 m31 : 104|8@1+ (1,0) [0|0] "" HETC_L_TACT
 SG_ Ecat_Name12 m31 : 112|8@1+ (1,0) [0|0] "" HETC_L_TACT
 SG_ Ecat_Name13 m31 : 120|8@1+ (1,0) [0|0] "" HETC_L_TACT
 SG_ Ecat_Name14 m31 : 128|8@1+ (1,0) [0|0] "" HETC_L_TACT
 SG_ Ecat_Name15 m31 : 136|8@1+ (1,0) [0|0] "" HETC_L_TACT
 SG_ Ecat_Link m31 : 144|8@1+ (1,0) [0|0] "" HETC_L_TACT
 SG_ Ecat_InvalidFrame0 m31 : 152|8@1+ (1,0) [0|0] "" HETC_L_TACT
 SG_ Ecat_InvalidFrame1 m31 : 160|8@1+ (1,0) [0|0] "" HETC_L_TACT
 SG_ Ecat_InvalidFrame2 m31 : 168|8@1+ (1,0) [0|0] "" HETC_L_TACT
 SG_ Ecat_InvalidFrame3 m31 : 176|8@1+ (1,0) [0|0] "" HETC_L_TACT
 SG_ Ecat_RxError0 m31 : 184|8@1+ (1,0) [0|0] "" HETC_L_TACT
 SG_ Ecat_RxError1 m31 : 192|8@1+ (1,0) [0|0] "" HETC_L_TACT
 SG_ Ecat_RxError2 m31 : 200|8@1+ (1,0) [0|0] "" HETC_L_TACT
 SG_ Ecat_RxError3 m31 : 208|8@1+ (1,0) [0|0] "" HETC_L_TACT
 SG_ Ecat_FwdRxError0 m31 : 216|8@1+ (1,0) [0|0] "" HETC_L_TACT
 SG_ Ecat_FwdRxError1 m31 : 224|8@1+ (1,0) [0|0] "" HETC_L_TACT
 SG_ Ecat_FwdRxError2 m31 : 232|8@1+ (1,0) [0|0] "" HETC_L_TACT
 SG_ Ecat_FwdRxError3 m31 : 240|8@1+ (1,0) [0|0] "" HETC_L_TACT
 SG_ Ecat_PuError m31 : 248|8@1+ (1,0) [0|0] "" HETC_L_TACT
 SG_ Ecat_PdiError m31 : 256|8@1+ (1,0) [0|0] "" HETC_L_TACT
 SG_ Ecat_LostLink0 m31 : 264|8@1+ (1,0) [0|0] "" HETC_L_TACT
 SG_ Ecat_LostLink1 m31 : 272|8@1+ (1,0) [0|0] "" HETC_L_TACT
 SG_ Ecat_LostLink2 m31 : 280|8@1+ (1,0) [0|0] "" HETC_L_TACT
 SG_ Ecat_LostLink3 m31 : 288|8@1+ (1,0) [0|0] "" HETC_L_TACT
 SG_ Saf_CanId m32 : 8|8@1+ (1,0) [0|0] "" HETC_L_TACT
 SG_ Saf_Name0 m32 : 16|8@1+ (1,0) [0|0] "" HETC_L_TACT
 SG_ Saf_Name1 m32 : 24|8@1+ (1,0) [0|0] "" HETC_L_TACT
 SG_ Saf_Name2 m32 : 32|8@1+ (1,0) [0|0] "" HETC_L_TACT
 SG_ Saf_Name3 m32 : 40|8@1+ (1,0) [0|0] "" HETC_L_TACT
 SG_ Saf_Name4 m32 : 48|8@1+ (1,0) [0|0] "" HETC_L_TACT
 SG_ Saf_Name5 m32 : 56|8@1+ (1,0) [0|0] "" HETC_L_TACT
 SG_ Saf_Name6 m32 : 64|8@1+ (1,0) [0|0] "" HETC_L_TACT
 SG_ Saf_Name7 m32 : 72|8@1+ (1,0) [0|0] "" HETC_L_TACT
 SG_ Saf_Name8 m32 : 80|8@1+ (1,0) [0|0] "" HETC_L_TACT
 SG_ Saf_Name9 m32 : 88|8@1+ (1,0) [0|0] "" HETC_L_TACT
 SG_ Saf_Name10 m32 : 96|8@1+ (1,0) [0|0] "" HETC_L_TACT
 SG_ Saf_Name11 m32 : 104|8@1+ (1,0) [0|0] "" HETC_L_TACT
 SG_ Saf_Name12 m32 : 112|8@1+ (1,0) [0|0] "" HETC_L_TACT
 SG_ Saf_Name13 m32 : 120|8@1+ (1,0) [0|0] "" HETC_L_TACT
 SG_ Saf_Name14 m32 : 128|8@1+ (1,0) [0|0] "" HETC_L_TACT
 SG_ Saf_Name15 m32 : 136|8@1+ (1,0) [0|0] "" HETC_L_TACT
 SG_ Saf_State m32 : 144|8@1+ (1,0) [0|0] "" HETC_L_TACT
 SG_ Saf_Bits m32 : 152|16@1+ (1,0) [0|0] "" HETC_L_TACT
 SG_ Saf_Estop m32 : 168|8@1+ (1,0) [0|0] "" HETC_L_TACT
 SG_ Saf_FatalLatched m32 : 176|16@1+ (1,0) [0|0] "" HETC_L_TACT
 SG_ Saf_ErrCode m32 : 192|32@1+ (1,0) [0|0] "" HETC_L_TACT

BO_ 2163313814 STATUS_HETC_R_ARM_to_HETC_R_TACT: 48 HETC_R_ARM
 SG_ SubCode M : 0|8@1+ (1,0) [0|0] "" HETC_R_TACT
 SG_ Ping_CanId m5 : 8|8@1+ (1,0) [0|0] "" HETC_R_TACT
 SG_ Ping_HostId m5 : 16|8@1+ (1,0) [0|0] "" HETC_R_TACT
 SG_ Ping_Pid m5 : 24|16@1+ (1,0) [0|0] "" HETC_R_TACT
 SG_ Ping_Bid m5 : 40|16@1+ (1,0) [0|0] "" HETC_R_TACT
 SG_ Ping_Mid m5 : 56|16@1+ (1,0) [0|0] "" HETC_R_TACT
 SG_ Ping_VerMajor m5 : 72|8@1+ (1,0) [0|0] "" HETC_R_TACT
 SG_ Ping_VerMinor m5 : 80|8@1+ (1,0) [0|0] "" HETC_R_TACT
 SG_ Ping_VerPatch m5 : 88|8@1+ (1,0) [0|0] "" HETC_R_TACT
 SG_ Ping_Name0 m5 : 96|8@1+ (1,0) [0|0] "" HETC_R_TACT
 SG_ Ping_Name1 m5 : 104|8@1+ (1,0) [0|0] "" HETC_R_TACT
 SG_ Ping_Name2 m5 : 112|8@1+ (1,0) [0|0] "" HETC_R_TACT
 SG_ Ping_Name3 m5 : 120|8@1+ (1,0) [0|0] "" HETC_R_TACT
 SG_ Ping_Name4 m5 : 128|8@1+ (1,0) [0|0] "" HETC_R_TACT
 SG_ Ping_Name5 m5 : 136|8@1+ (1,0) [0|0] "" HETC_R_TACT
 SG_ Ping_Name6 m5 : 144|8@1+ (1,0) [0|0] "" HETC_R_TACT
 SG_ Ping_Name7 m5 : 152|8@1+ (1,0) [0|0] "" HETC_R_TACT
 SG_ Ping_Name8 m5 : 160|8@1+ (1,0) [0|0] "" HETC_R_TACT
 SG_ Ping_Name9 m5 : 168|8@1+ (1,0) [0|0] "" HETC_R_TACT
 SG_ Ping_Name10 m5 : 176|8@1+ (1,0) [0|0] "" HETC_R_TACT
 SG_ Ping_Name11 m5 : 184|8@1+ (1,0) [0|0] "" HETC_R_TACT
 SG_ Ping_Name12 m5 : 192|8@1+ (1,0) [0|0] "" HETC_R_TACT
 SG_ Ping_Name13 m5 : 200|8@1+ (1,0) [0|0] "" HETC_R_TACT
 SG_ Ping_Name14 m5 : 208|8@1+ (1,0) [0|0] "" HETC_R_TACT
 SG_ Ping_Name15 m5 : 216|8@1+ (1,0) [0|0] "" HETC_R_TACT
 SG_ Ping_FmtVer m5 : 224|8@1+ (1,0) [0|0] "" HETC_R_TACT
 SG_ Ping_GitRev m5 : 232|32@1+ (1,0) [0|0] "" HETC_R_TACT
 SG_ Ping_FwCrc m5 : 264|16@1+ (1,0) [0|0] "" HETC_R_TACT
 SG_ Ping_UptimeS m5 : 280|16@1+ (1,0) [0|0] "s" HETC_R_TACT
 SG_ Ecat_CanId m31 : 8|8@1+ (1,0) [0|0] "" HETC_R_TACT
 SG_ Ecat_Name0 m31 : 16|8@1+ (1,0) [0|0] "" HETC_R_TACT
 SG_ Ecat_Name1 m31 : 24|8@1+ (1,0) [0|0] "" HETC_R_TACT
 SG_ Ecat_Name2 m31 : 32|8@1+ (1,0) [0|0] "" HETC_R_TACT
 SG_ Ecat_Name3 m31 : 40|8@1+ (1,0) [0|0] "" HETC_R_TACT
 SG_ Ecat_Name4 m31 : 48|8@1+ (1,0) [0|0] "" HETC_R_TACT
 SG_ Ecat_Name5 m31 : 56|8@1+ (1,0) [0|0] "" HETC_R_TACT
 SG_ Ecat_Name6 m31 : 64|8@1+ (1,0) [0|0] "" HETC_R_TACT
 SG_ Ecat_Name7 m31 : 72|8@1+ (1,0) [0|0] "" HETC_R_TACT
 SG_ Ecat_Name8 m31 : 80|8@1+ (1,0) [0|0] "" HETC_R_TACT
 SG_ Ecat_Name9 m31 : 88|8@1+ (1,0) [0|0] "" HETC_R_TACT
 SG_ Ecat_Name10 m31 : 96|8@1+ (1,0) [0|0] "" HETC_R_TACT
 SG_ Ecat_Name11 m31 : 104|8@1+ (1,0) [0|0] "" HETC_R_TACT
 SG_ Ecat_Name12 m31 : 112|8@1+ (1,0) [0|0] "" HETC_R_TACT
 SG_ Ecat_Name13 m31 : 120|8@1+ (1,0) [0|0] "" HETC_R_TACT
 SG_ Ecat_Name14 m31 : 128|8@1+ (1,0) [0|0] "" HETC_R_TACT
 SG_ Ecat_Name15 m31 : 136|8@1+ (1,0) [0|0] "" HETC_R_TACT
 SG_ Ecat_Link m31 : 144|8@1+ (1,0) [0|0] "" HETC_R_TACT
 SG_ Ecat_InvalidFrame0 m31 : 152|8@1+ (1,0) [0|0] "" HETC_R_TACT
 SG_ Ecat_InvalidFrame1 m31 : 160|8@1+ (1,0) [0|0] "" HETC_R_TACT
 SG_ Ecat_InvalidFrame2 m31 : 168|8@1+ (1,0) [0|0] "" HETC_R_TACT
 SG_ Ecat_InvalidFrame3 m31 : 176|8@1+ (1,0) [0|0] "" HETC_R_TACT
 SG_ Ecat_RxError0 m31 : 184|8@1+ (1,0) [0|0] "" HETC_R_TACT
 SG_ Ecat_RxError1 m31 : 192|8@1+ (1,0) [0|0] "" HETC_R_TACT
 SG_ Ecat_RxError2 m31 : 200|8@1+ (1,0) [0|0] "" HETC_R_TACT
 SG_ Ecat_RxError3 m31 : 208|8@1+ (1,0) [0|0] "" HETC_R_TACT
 SG_ Ecat_FwdRxError0 m31 : 216|8@1+ (1,0) [0|0] "" HETC_R_TACT
 SG_ Ecat_FwdRxError1 m31 : 224|8@1+ (1,0) [0|0] "" HETC_R_TACT
 SG_ Ecat_FwdRxError2 m31 : 232|8@1+ (1,0) [0|0] "" HETC_R_TACT
 SG_ Ecat_FwdRxError3 m31 : 240|8@1+ (1,0) [0|0] "" HETC_R_TACT
 SG_ Ecat_PuError m31 : 248|8@1+ (1,0) [0|0] "" HETC_R_TACT
 SG_ Ecat_PdiError m31 : 256|8@1+ (1,0) [0|0] "" HETC_R_TACT
 SG_ Ecat_LostLink0 m31 : 264|8@1+ (1,0) [0|0] "" HETC_R_TACT
 SG_ Ecat_LostLink1 m31 : 272|8@1+ (1,0) [0|0] "" HETC_R_TACT
 SG_ Ecat_LostLink2 m31 : 280|8@1+ (1,0) [0|0] "" HETC_R_TACT
 SG_ Ecat_LostLink3 m31 : 288|8@1+ (1,0) [0|0] "" HETC_R_TACT
 SG_ Saf_CanId m32 : 8|8@1+ (1,0) [0|0] "" HETC_R_TACT
 SG_ Saf_Name0 m32 : 16|8@1+ (1,0) [0|0] "" HETC_R_TACT
 SG_ Saf_Name1 m32 : 24|8@1+ (1,0) [0|0] "" HETC_R_TACT
 SG_ Saf_Name2 m32 : 32|8@1+ (1,0) [0|0] "" HETC_R_TACT
 SG_ Saf_Name3 m32 : 40|8@1+ (1,0) [0|0] "" HETC_R_TACT
 SG_ Saf_Name4 m32 : 48|8@1+ (1,0) [0|0] "" HETC_R_TACT
 SG_ Saf_Name5 m32 : 56|8@1+ (1,0) [0|0] "" HETC_R_TACT
 SG_ Saf_Name6 m32 : 64|8@1+ (1,0) [0|0] "" HETC_R_TACT
 SG_ Saf_Name7 m32 : 72|8@1+ (1,0) [0|0] "" HETC_R_TACT
 SG_ Saf_Name8 m32 : 80|8@1+ (1,0) [0|0] "" HETC_R_TACT
 SG_ Saf_Name9 m32 : 88|8@1+ (1,0) [0|0] "" HETC_R_TACT
 SG_ Saf_Name10 m32 : 96|8@1+ (1,0) [0|0] "" HETC_R_TACT
 SG_ Saf_Name11 m32 : 104|8@1+ (1,0) [0|0] "" HETC_R_TACT
 SG_ Saf_Name12 m32 : 112|8@1+ (1,0) [0|0] "" HETC_R_TACT
 SG_ Saf_Name13 m32 : 120|8@1+ (1,0) [0|0] "" HETC_R_TACT
 SG_ Saf_Name14 m32 : 128|8@1+ (1,0) [0|0] "" HETC_R_TACT
 SG_ Saf_Name15 m32 : 136|8@1+ (1,0) [0|0] "" HETC_R_TACT
 SG_ Saf_State m32 : 144|8@1+ (1,0) [0|0] "" HETC_R_TACT
 SG_ Saf_Bits m32 : 152|16@1+ (1,0) [0|0] "" HETC_R_TACT
 SG_ Saf_Estop m32 : 168|8@1+ (1,0) [0|0] "" HETC_R_TACT
 SG_ Saf_FatalLatched m32 : 176|16@1+ (1,0) [0|0] "" HETC_R_TACT
 SG_ Saf_ErrCode m32 : 192|32@1+ (1,0) [0|0] "" HETC_R_TACT

BO_ 2163313865 STATUS_HETC_R_ARM_to_HMDH_201: 48 HETC_R_ARM
 SG_ SubCode M : 0|8@1+ (1,0) [0|0] "" HMDH_201
 SG_ Ping_CanId m5 : 8|8@1+ (1,0) [0|0] "" HMDH_201
 SG_ Ping_HostId m5 : 16|8@1+ (1,0) [0|0] "" HMDH_201
 SG_ Ping_Pid m5 : 24|16@1+ (1,0) [0|0] "" HMDH_201
 SG_ Ping_Bid m5 : 40|16@1+ (1,0) [0|0] "" HMDH_201
 SG_ Ping_Mid m5 : 56|16@1+ (1,0) [0|0] "" HMDH_201
 SG_ Ping_VerMajor m5 : 72|8@1+ (1,0) [0|0] "" HMDH_201
 SG_ Ping_VerMinor m5 : 80|8@1+ (1,0) [0|0] "" HMDH_201
 SG_ Ping_VerPatch m5 : 88|8@1+ (1,0) [0|0] "" HMDH_201
 SG_ Ping_Name0 m5 : 96|8@1+ (1,0) [0|0] "" HMDH_201
 SG_ Ping_Name1 m5 : 104|8@1+ (1,0) [0|0] "" HMDH_201
 SG_ Ping_Name2 m5 : 112|8@1+ (1,0) [0|0] "" HMDH_201
 SG_ Ping_Name3 m5 : 120|8@1+ (1,0) [0|0] "" HMDH_201
 SG_ Ping_Name4 m5 : 128|8@1+ (1,0) [0|0] "" HMDH_201
 SG_ Ping_Name5 m5 : 136|8@1+ (1,0) [0|0] "" HMDH_201
 SG_ Ping_Name6 m5 : 144|8@1+ (1,0) [0|0] "" HMDH_201
 SG_ Ping_Name7 m5 : 152|8@1+ (1,0) [0|0] "" HMDH_201
 SG_ Ping_Name8 m5 : 160|8@1+ (1,0) [0|0] "" HMDH_201
 SG_ Ping_Name9 m5 : 168|8@1+ (1,0) [0|0] "" HMDH_201
 SG_ Ping_Name10 m5 : 176|8@1+ (1,0) [0|0] "" HMDH_201
 SG_ Ping_Name11 m5 : 184|8@1+ (1,0) [0|0] "" HMDH_201
 SG_ Ping_Name12 m5 : 192|8@1+ (1,0) [0|0] "" HMDH_201
 SG_ Ping_Name13 m5 : 200|8@1+ (1,0) [0|0] "" HMDH_201
 SG_ Ping_Name14 m5 : 208|8@1+ (1,0) [0|0] "" HMDH_201
 SG_ Ping_Name15 m5 : 216|8@1+ (1,0) [0|0] "" HMDH_201
 SG_ Ping_FmtVer m5 : 224|8@1+ (1,0) [0|0] "" HMDH_201
 SG_ Ping_GitRev m5 : 232|32@1+ (1,0) [0|0] "" HMDH_201
 SG_ Ping_FwCrc m5 : 264|16@1+ (1,0) [0|0] "" HMDH_201
 SG_ Ping_UptimeS m5 : 280|16@1+ (1,0) [0|0] "s" HMDH_201
 SG_ Ecat_CanId m31 : 8|8@1+ (1,0) [0|0] "" HMDH_201
 SG_ Ecat_Name0 m31 : 16|8@1+ (1,0) [0|0] "" HMDH_201
 SG_ Ecat_Name1 m31 : 24|8@1+ (1,0) [0|0] "" HMDH_201
 SG_ Ecat_Name2 m31 : 32|8@1+ (1,0) [0|0] "" HMDH_201
 SG_ Ecat_Name3 m31 : 40|8@1+ (1,0) [0|0] "" HMDH_201
 SG_ Ecat_Name4 m31 : 48|8@1+ (1,0) [0|0] "" HMDH_201
 SG_ Ecat_Name5 m31 : 56|8@1+ (1,0) [0|0] "" HMDH_201
 SG_ Ecat_Name6 m31 : 64|8@1+ (1,0) [0|0] "" HMDH_201
 SG_ Ecat_Name7 m31 : 72|8@1+ (1,0) [0|0] "" HMDH_201
 SG_ Ecat_Name8 m31 : 80|8@1+ (1,0) [0|0] "" HMDH_201
 SG_ Ecat_Name9 m31 : 88|8@1+ (1,0) [0|0] "" HMDH_201
 SG_ Ecat_Name10 m31 : 96|8@1+ (1,0) [0|0] "" HMDH_201
 SG_ Ecat_Name11 m31 : 104|8@1+ (1,0) [0|0] "" HMDH_201
 SG_ Ecat_Name12 m31 : 112|8@1+ (1,0) [0|0] "" HMDH_201
 SG_ Ecat_Name13 m31 : 120|8@1+ (1,0) [0|0] "" HMDH_201
 SG_ Ecat_Name14 m31 : 128|8@1+ (1,0) [0|0] "" HMDH_201
 SG_ Ecat_Name15 m31 : 136|8@1+ (1,0) [0|0] "" HMDH_201
 SG_ Ecat_Link m31 : 144|8@1+ (1,0) [0|0] "" HMDH_201
 SG_ Ecat_InvalidFrame0 m31 : 152|8@1+ (1,0) [0|0] "" HMDH_201
 SG_ Ecat_InvalidFrame1 m31 : 160|8@1+ (1,0) [0|0] "" HMDH_201
 SG_ Ecat_InvalidFrame2 m31 : 168|8@1+ (1,0) [0|0] "" HMDH_201
 SG_ Ecat_InvalidFrame3 m31 : 176|8@1+ (1,0) [0|0] "" HMDH_201
 SG_ Ecat_RxError0 m31 : 184|8@1+ (1,0) [0|0] "" HMDH_201
 SG_ Ecat_RxError1 m31 : 192|8@1+ (1,0) [0|0] "" HMDH_201
 SG_ Ecat_RxError2 m31 : 200|8@1+ (1,0) [0|0] "" HMDH_201
 SG_ Ecat_RxError3 m31 : 208|8@1+ (1,0) [0|0] "" HMDH_201
 SG_ Ecat_FwdRxError0 m31 : 216|8@1+ (1,0) [0|0] "" HMDH_201
 SG_ Ecat_FwdRxError1 m31 : 224|8@1+ (1,0) [0|0] "" HMDH_201
 SG_ Ecat_FwdRxError2 m31 : 232|8@1+ (1,0) [0|0] "" HMDH_201
 SG_ Ecat_FwdRxError3 m31 : 240|8@1+ (1,0) [0|0] "" HMDH_201
 SG_ Ecat_PuError m31 : 248|8@1+ (1,0) [0|0] "" HMDH_201
 SG_ Ecat_PdiError m31 : 256|8@1+ (1,0) [0|0] "" HMDH_201
 SG_ Ecat_LostLink0 m31 : 264|8@1+ (1,0) [0|0] "" HMDH_201
 SG_ Ecat_LostLink1 m31 : 272|8@1+ (1,0) [0|0] "" HMDH_201
 SG_ Ecat_LostLink2 m31 : 280|8@1+ (1,0) [0|0] "" HMDH_201
 SG_ Ecat_LostLink3 m31 : 288|8@1+ (1,0) [0|0] "" HMDH_201
 SG_ Saf_CanId m32 : 8|8@1+ (1,0) [0|0] "" HMDH_201
 SG_ Saf_Name0 m32 : 16|8@1+ (1,0) [0|0] "" HMDH_201
 SG_ Saf_Name1 m32 : 24|8@1+ (1,0) [0|0] "" HMDH_201
 SG_ Saf_Name2 m32 : 32|8@1+ (1,0) [0|0] "" HMDH_201
 SG_ Saf_Name3 m32 : 40|8@1+ (1,0) [0|0] "" HMDH_201
 SG_ Saf_Name4 m32 : 48|8@1+ (1,0) [0|0] "" HMDH_201
 SG_ Saf_Name5 m32 : 56|8@1+ (1,0) [0|0] "" HMDH_201
 SG_ Saf_Name6 m32 : 64|8@1+ (1,0) [0|0] "" HMDH_201
 SG_ Saf_Name7 m32 : 72|8@1+ (1,0) [0|0] "" HMDH_201
 SG_ Saf_Name8 m32 : 80|8@1+ (1,0) [0|0] "" HMDH_201
 SG_ Saf_Name9 m32 : 88|8@1+ (1,0) [0|0] "" HMDH_201
 SG_ Saf_Name10 m32 : 96|8@1+ (1,0) [0|0] "" HMDH_201
 SG_ Saf_Name11 m32 : 104|8@1+ (1,0) [0|0] "" HMDH_201
 SG_ Saf_Name12 m32 : 112|8@1+ (1,0) [0|0] "" HMDH_201
 SG_ Saf_Name13 m32 : 120|8@1+ (1,0) [0|0] "" HMDH_201
 SG_ Saf_Name14 m32 : 128|8@1+ (1,0) [0|0] "" HMDH_201
 SG_ Saf_Name15 m32 : 136|8@1+ (1,0) [0|0] "" HMDH_201
 SG_ Saf_State m32 : 144|8@1+ (1,0) [0|0] "" HMDH_201
 SG_ Saf_Bits m32 : 152|16@1+ (1,0) [0|0] "" HMDH_201
 SG_ Saf_Estop m32 : 168|8@1+ (1,0) [0|0] "" HMDH_201
 SG_ Saf_FatalLatched m32 : 176|16@1+ (1,0) [0|0] "" HMDH_201
 SG_ Saf_ErrCode m32 : 192|32@1+ (1,0) [0|0] "" HMDH_201

BO_ 2163313866 STATUS_HETC_R_ARM_to_HMDH_202: 48 HETC_R_ARM
 SG_ SubCode M : 0|8@1+ (1,0) [0|0] "" HMDH_202
 SG_ Ping_CanId m5 : 8|8@1+ (1,0) [0|0] "" HMDH_202
 SG_ Ping_HostId m5 : 16|8@1+ (1,0) [0|0] "" HMDH_202
 SG_ Ping_Pid m5 : 24|16@1+ (1,0) [0|0] "" HMDH_202
 SG_ Ping_Bid m5 : 40|16@1+ (1,0) [0|0] "" HMDH_202
 SG_ Ping_Mid m5 : 56|16@1+ (1,0) [0|0] "" HMDH_202
 SG_ Ping_VerMajor m5 : 72|8@1+ (1,0) [0|0] "" HMDH_202
 SG_ Ping_VerMinor m5 : 80|8@1+ (1,0) [0|0] "" HMDH_202
 SG_ Ping_VerPatch m5 : 88|8@1+ (1,0) [0|0] "" HMDH_202
 SG_ Ping_Name0 m5 : 96|8@1+ (1,0) [0|0] "" HMDH_202
 SG_ Ping_Name1 m5 : 104|8@1+ (1,0) [0|0] "" HMDH_202
 SG_ Ping_Name2 m5 : 112|8@1+ (1,0) [0|0] "" HMDH_202
 SG_ Ping_Name3 m5 : 120|8@1+ (1,0) [0|0] "" HMDH_202
 SG_ Ping_Name4 m5 : 128|8@1+ (1,0) [0|0] "" HMDH_202
 SG_ Ping_Name5 m5 : 136|8@1+ (1,0) [0|0] "" HMDH_202
 SG_ Ping_Name6 m5 : 144|8@1+ (1,0) [0|0] "" HMDH_202
 SG_ Ping_Name7 m5 : 152|8@1+ (1,0) [0|0] "" HMDH_202
 SG_ Ping_Name8 m5 : 160|8@1+ (1,0) [0|0] "" HMDH_202
 SG_ Ping_Name9 m5 : 168|8@1+ (1,0) [0|0] "" HMDH_202
 SG_ Ping_Name10 m5 : 176|8@1+ (1,0) [0|0] "" HMDH_202
 SG_ Ping_Name11 m5 : 184|8@1+ (1,0) [0|0] "" HMDH_202
 SG_ Ping_Name12 m5 : 192|8@1+ (1,0) [0|0] "" HMDH_202
 SG_ Ping_Name13 m5 : 200|8@1+ (1,0) [0|0] "" HMDH_202
 SG_ Ping_Name14 m5 : 208|8@1+ (1,0) [0|0] "" HMDH_202
 SG_ Ping_Name15 m5 : 216|8@1+ (1,0) [0|0] "" HMDH_202
 SG_ Ping_FmtVer m5 : 224|8@1+ (1,0) [0|0] "" HMDH_202
 SG_ Ping_GitRev m5 : 232|32@1+ (1,0) [0|0] "" HMDH_202
 SG_ Ping_FwCrc m5 : 264|16@1+ (1,0) [0|0] "" HMDH_202
 SG_ Ping_UptimeS m5 : 280|16@1+ (1,0) [0|0] "s" HMDH_202
 SG_ Ecat_CanId m31 : 8|8@1+ (1,0) [0|0] "" HMDH_202
 SG_ Ecat_Name0 m31 : 16|8@1+ (1,0) [0|0] "" HMDH_202
 SG_ Ecat_Name1 m31 : 24|8@1+ (1,0) [0|0] "" HMDH_202
 SG_ Ecat_Name2 m31 : 32|8@1+ (1,0) [0|0] "" HMDH_202
 SG_ Ecat_Name3 m31 : 40|8@1+ (1,0) [0|0] "" HMDH_202
 SG_ Ecat_Name4 m31 : 48|8@1+ (1,0) [0|0] "" HMDH_202
 SG_ Ecat_Name5 m31 : 56|8@1+ (1,0) [0|0] "" HMDH_202
 SG_ Ecat_Name6 m31 : 64|8@1+ (1,0) [0|0] "" HMDH_202
 SG_ Ecat_Name7 m31 : 72|8@1+ (1,0) [0|0] "" HMDH_202
 SG_ Ecat_Name8 m31 : 80|8@1+ (1,0) [0|0] "" HMDH_202
 SG_ Ecat_Name9 m31 : 88|8@1+ (1,0) [0|0] "" HMDH_202
 SG_ Ecat_Name10 m31 : 96|8@1+ (1,0) [0|0] "" HMDH_202
 SG_ Ecat_Name11 m31 : 104|8@1+ (1,0) [0|0] "" HMDH_202
 SG_ Ecat_Name12 m31 : 112|8@1+ (1,0) [0|0] "" HMDH_202
 SG_ Ecat_Name13 m31 : 120|8@1+ (1,0) [0|0] "" HMDH_202
 SG_ Ecat_Name14 m31 : 128|8@1+ (1,0) [0|0] "" HMDH_202
 SG_ Ecat_Name15 m31 : 136|8@1+ (1,0) [0|0] "" HMDH_202
 SG_ Ecat_Link m31 : 144|8@1+ (1,0) [0|0] "" HMDH_202
 SG_ Ecat_InvalidFrame0 m31 : 152|8@1+ (1,0) [0|0] "" HMDH_202
 SG_ Ecat_InvalidFrame1 m31 : 160|8@1+ (1,0) [0|0] "" HMDH_202
 SG_ Ecat_InvalidFrame2 m31 : 168|8@1+ (1,0) [0|0] "" HMDH_202
 SG_ Ecat_InvalidFrame3 m31 : 176|8@1+ (1,0) [0|0] "" HMDH_202
 SG_ Ecat_RxError0 m31 : 184|8@1+ (1,0) [0|0] "" HMDH_202
 SG_ Ecat_RxError1 m31 : 192|8@1+ (1,0) [0|0] "" HMDH_202
 SG_ Ecat_RxError2 m31 : 200|8@1+ (1,0) [0|0] "" HMDH_202
 SG_ Ecat_RxError3 m31 : 208|8@1+ (1,0) [0|0] "" HMDH_202
 SG_ Ecat_FwdRxError0 m31 : 216|8@1+ (1,0) [0|0] "" HMDH_202
 SG_ Ecat_FwdRxError1 m31 : 224|8@1+ (1,0) [0|0] "" HMDH_202
 SG_ Ecat_FwdRxError2 m31 : 232|8@1+ (1,0) [0|0] "" HMDH_202
 SG_ Ecat_FwdRxError3 m31 : 240|8@1+ (1,0) [0|0] "" HMDH_202
 SG_ Ecat_PuError m31 : 248|8@1+ (1,0) [0|0] "" HMDH_202
 SG_ Ecat_PdiError m31 : 256|8@1+ (1,0) [0|0] "" HMDH_202
 SG_ Ecat_LostLink0 m31 : 264|8@1+ (1,0) [0|0] "" HMDH_202
 SG_ Ecat_LostLink1 m31 : 272|8@1+ (1,0) [0|0] "" HMDH_202
 SG_ Ecat_LostLink2 m31 : 280|8@1+ (1,0) [0|0] "" HMDH_202
 SG_ Ecat_LostLink3 m31 : 288|8@1+ (1,0) [0|0] "" HMDH_202
 SG_ Saf_CanId m32 : 8|8@1+ (1,0) [0|0] "" HMDH_202
 SG_ Saf_Name0 m32 : 16|8@1+ (1,0) [0|0] "" HMDH_202
 SG_ Saf_Name1 m32 : 24|8@1+ (1,0) [0|0] "" HMDH_202
 SG_ Saf_Name2 m32 : 32|8@1+ (1,0) [0|0] "" HMDH_202
 SG_ Saf_Name3 m32 : 40|8@1+ (1,0) [0|0] "" HMDH_202
 SG_ Saf_Name4 m32 : 48|8@1+ (1,0) [0|0] "" HMDH_202
 SG_ Saf_Name5 m32 : 56|8@1+ (1,0) [0|0] "" HMDH_202
 SG_ Saf_Name6 m32 : 64|8@1+ (1,0) [0|0] "" HMDH_202
 SG_ Saf_Name7 m32 : 72|8@1+ (1,0) [0|0] "" HMDH_202
 SG_ Saf_Name8 m32 : 80|8@1+ (1,0) [0|0] "" HMDH_202
 SG_ Saf_Name9 m32 : 88|8@1+ (1,0) [0|0] "" HMDH_202
 SG_ Saf_Name10 m32 : 96|8@1+ (1,0) [0|0] "" HMDH_202
 SG_ Saf_Name11 m32 : 104|8@1+ (1,0) [0|0] "" HMDH_202
 SG_ Saf_Name12 m32 : 112|8@1+ (1,0) [0|0] "" HMDH_202
 SG_ Saf_Name13 m32 : 120|8@1+ (1,0) [0|0] "" HMDH_202
 SG_ Saf_Name14 m32 : 128|8@1+ (1,0) [0|0] "" HMDH_202
 SG_ Saf_Name15 m32 : 136|8@1+ (1,0) [0|0] "" HMDH_202
 SG_ Saf_State m32 : 144|8@1+ (1,0) [0|0] "" HMDH_202
 SG_ Saf_Bits m32 : 152|16@1+ (1,0) [0|0] "" HMDH_202
 SG_ Saf_Estop m32 : 168|8@1+ (1,0) [0|0] "" HMDH_202
 SG_ Saf_FatalLatched m32 : 176|16@1+ (1,0) [0|0] "" HMDH_202
 SG_ Saf_ErrCode m32 : 192|32@1+ (1,0) [0|0] "" HMDH_202

BO_ 2163313867 STATUS_HETC_R_ARM_to_HMDH_203: 48 HETC_R_ARM
 SG_ SubCode M : 0|8@1+ (1,0) [0|0] "" HMDH_203
 SG_ Ping_CanId m5 : 8|8@1+ (1,0) [0|0] "" HMDH_203
 SG_ Ping_HostId m5 : 16|8@1+ (1,0) [0|0] "" HMDH_203
 SG_ Ping_Pid m5 : 24|16@1+ (1,0) [0|0] "" HMDH_203
 SG_ Ping_Bid m5 : 40|16@1+ (1,0) [0|0] "" HMDH_203
 SG_ Ping_Mid m5 : 56|16@1+ (1,0) [0|0] "" HMDH_203
 SG_ Ping_VerMajor m5 : 72|8@1+ (1,0) [0|0] "" HMDH_203
 SG_ Ping_VerMinor m5 : 80|8@1+ (1,0) [0|0] "" HMDH_203
 SG_ Ping_VerPatch m5 : 88|8@1+ (1,0) [0|0] "" HMDH_203
 SG_ Ping_Name0 m5 : 96|8@1+ (1,0) [0|0] "" HMDH_203
 SG_ Ping_Name1 m5 : 104|8@1+ (1,0) [0|0] "" HMDH_203
 SG_ Ping_Name2 m5 : 112|8@1+ (1,0) [0|0] "" HMDH_203
 SG_ Ping_Name3 m5 : 120|8@1+ (1,0) [0|0] "" HMDH_203
 SG_ Ping_Name4 m5 : 128|8@1+ (1,0) [0|0] "" HMDH_203
 SG_ Ping_Name5 m5 : 136|8@1+ (1,0) [0|0] "" HMDH_203
 SG_ Ping_Name6 m5 : 144|8@1+ (1,0) [0|0] "" HMDH_203
 SG_ Ping_Name7 m5 : 152|8@1+ (1,0) [0|0] "" HMDH_203
 SG_ Ping_Name8 m5 : 160|8@1+ (1,0) [0|0] "" HMDH_203
 SG_ Ping_Name9 m5 : 168|8@1+ (1,0) [0|0] "" HMDH_203
 SG_ Ping_Name10 m5 : 176|8@1+ (1,0) [0|0] "" HMDH_203
 SG_ Ping_Name11 m5 : 184|8@1+ (1,0) [0|0] "" HMDH_203
 SG_ Ping_Name12 m5 : 192|8@1+ (1,0) [0|0] "" HMDH_203
 SG_ Ping_Name13 m5 : 200|8@1+ (1,0) [0|0] "" HMDH_203
 SG_ Ping_Name14 m5 : 208|8@1+ (1,0) [0|0] "" HMDH_203
 SG_ Ping_Name15 m5 : 216|8@1+ (1,0) [0|0] "" HMDH_203
 SG_ Ping_FmtVer m5 : 224|8@1+ (1,0) [0|0] "" HMDH_203
 SG_ Ping_GitRev m5 : 232|32@1+ (1,0) [0|0] "" HMDH_203
 SG_ Ping_FwCrc m5 : 264|16@1+ (1,0) [0|0] "" HMDH_203
 SG_ Ping_UptimeS m5 : 280|16@1+ (1,0) [0|0] "s" HMDH_203
 SG_ Ecat_CanId m31 : 8|8@1+ (1,0) [0|0] "" HMDH_203
 SG_ Ecat_Name0 m31 : 16|8@1+ (1,0) [0|0] "" HMDH_203
 SG_ Ecat_Name1 m31 : 24|8@1+ (1,0) [0|0] "" HMDH_203
 SG_ Ecat_Name2 m31 : 32|8@1+ (1,0) [0|0] "" HMDH_203
 SG_ Ecat_Name3 m31 : 40|8@1+ (1,0) [0|0] "" HMDH_203
 SG_ Ecat_Name4 m31 : 48|8@1+ (1,0) [0|0] "" HMDH_203
 SG_ Ecat_Name5 m31 : 56|8@1+ (1,0) [0|0] "" HMDH_203
 SG_ Ecat_Name6 m31 : 64|8@1+ (1,0) [0|0] "" HMDH_203
 SG_ Ecat_Name7 m31 : 72|8@1+ (1,0) [0|0] "" HMDH_203
 SG_ Ecat_Name8 m31 : 80|8@1+ (1,0) [0|0] "" HMDH_203
 SG_ Ecat_Name9 m31 : 88|8@1+ (1,0) [0|0] "" HMDH_203
 SG_ Ecat_Name10 m31 : 96|8@1+ (1,0) [0|0] "" HMDH_203
 SG_ Ecat_Name11 m31 : 104|8@1+ (1,0) [0|0] "" HMDH_203
 SG_ Ecat_Name12 m31 : 112|8@1+ (1,0) [0|0] "" HMDH_203
 SG_ Ecat_Name13 m31 : 120|8@1+ (1,0) [0|0] "" HMDH_203
 SG_ Ecat_Name14 m31 : 128|8@1+ (1,0) [0|0] "" HMDH_203
 SG_ Ecat_Name15 m31 : 136|8@1+ (1,0) [0|0] "" HMDH_203
 SG_ Ecat_Link m31 : 144|8@1+ (1,0) [0|0] "" HMDH_203
 SG_ Ecat_InvalidFrame0 m31 : 152|8@1+ (1,0) [0|0] "" HMDH_203
 SG_ Ecat_InvalidFrame1 m31 : 160|8@1+ (1,0) [0|0] "" HMDH_203
 SG_ Ecat_InvalidFrame2 m31 : 168|8@1+ (1,0) [0|0] "" HMDH_203
 SG_ Ecat_InvalidFrame3 m31 : 176|8@1+ (1,0) [0|0] "" HMDH_203
 SG_ Ecat_RxError0 m31 : 184|8@1+ (1,0) [0|0] "" HMDH_203
 SG_ Ecat_RxError1 m31 : 192|8@1+ (1,0) [0|0] "" HMDH_203
 SG_ Ecat_RxError2 m31 : 200|8@1+ (1,0) [0|0] "" HMDH_203
 SG_ Ecat_RxError3 m31 : 208|8@1+ (1,0) [0|0] "" HMDH_203
 SG_ Ecat_FwdRxError0 m31 : 216|8@1+ (1,0) [0|0] "" HMDH_203
 SG_ Ecat_FwdRxError1 m31 : 224|8@1+ (1,0) [0|0] "" HMDH_203
 SG_ Ecat_FwdRxError2 m31 : 232|8@1+ (1,0) [0|0] "" HMDH_203
 SG_ Ecat_FwdRxError3 m31 : 240|8@1+ (1,0) [0|0] "" HMDH_203
 SG_ Ecat_PuError m31 : 248|8@1+ (1,0) [0|0] "" HMDH_203
 SG_ Ecat_PdiError m31 : 256|8@1+ (1,0) [0|0] "" HMDH_203
 SG_ Ecat_LostLink0 m31 : 264|8@1+ (1,0) [0|0] "" HMDH_203
 SG_ Ecat_LostLink1 m31 : 272|8@1+ (1,0) [0|0] "" HMDH_203
 SG_ Ecat_LostLink2 m31 : 280|8@1+ (1,0) [0|0] "" HMDH_203
 SG_ Ecat_LostLink3 m31 : 288|8@1+ (1,0) [0|0] "" HMDH_203
 SG_ Saf_CanId m32 : 8|8@1+ (1,0) [0|0] "" HMDH_203
 SG_ Saf_Name0 m32 : 16|8@1+ (1,0) [0|0] "" HMDH_203
 SG_ Saf_Name1 m32 : 24|8@1+ (1,0) [0|0] "" HMDH_203
 SG_ Saf_Name2 m32 : 32|8@1+ (1,0) [0|0] "" HMDH_203
 SG_ Saf_Name3 m32 : 40|8@1+ (1,0) [0|0] "" HMDH_203
 SG_ Saf_Name4 m32 : 48|8@1+ (1,0) [0|0] "" HMDH_203
 SG_ Saf_Name5 m32 : 56|8@1+ (1,0) [0|0] "" HMDH_203
 SG_ Saf_Name6 m32 : 64|8@1+ (1,0) [0|0] "" HMDH_203
 SG_ Saf_Name7 m32 : 72|8@1+ (1,0) [0|0] "" HMDH_203
 SG_ Saf_Name8 m32 : 80|8@1+ (1,0) [0|0] "" HMDH_203
 SG_ Saf_Name9 m32 : 88|8@1+ (1,0) [0|0] "" HMDH_203
 SG_ Saf_Name10 m32 : 96|8@1+ (1,0) [0|0] "" HMDH_203
 SG_ Saf_Name11 m32 : 104|8@1+ (1,0) [0|0] "" HMDH_203
 SG_ Saf_Name12 m32 : 112|8@1+ (1,0) [0|0] "" HMDH_203
 SG_ Saf_Name13 m32 : 120|8@1+ (1,0) [0|0] "" HMDH_203
 SG_ Saf_Name14 m32 : 128|8@1+ (1,0) [0|0] "" HMDH_203
 SG_ Saf_Name15 m32 : 136|8@1+ (1,0) [0|0] "" HMDH_203
 SG_ Saf_State m32 : 144|8@1+ (1,0) [0|0] "" HMDH_203
 SG_ Saf_Bits m32 : 152|16@1+ (1,0) [0|0] "" HMDH_203
 SG_ Saf_Estop m32 : 168|8@1+ (1,0) [0|0] "" HMDH_203
 SG_ Saf_FatalLatched m32 : 176|16@1+ (1,0) [0|0] "" HMDH_203
 SG_ Saf_ErrCode m32 : 192|32@1+ (1,0) [0|0] "" HMDH_203

BO_ 2163313868 STATUS_HETC_R_ARM_to_HMDH_204: 48 HETC_R_ARM
 SG_ SubCode M : 0|8@1+ (1,0) [0|0] "" HMDH_204
 SG_ Ping_CanId m5 : 8|8@1+ (1,0) [0|0] "" HMDH_204
 SG_ Ping_HostId m5 : 16|8@1+ (1,0) [0|0] "" HMDH_204
 SG_ Ping_Pid m5 : 24|16@1+ (1,0) [0|0] "" HMDH_204
 SG_ Ping_Bid m5 : 40|16@1+ (1,0) [0|0] "" HMDH_204
 SG_ Ping_Mid m5 : 56|16@1+ (1,0) [0|0] "" HMDH_204
 SG_ Ping_VerMajor m5 : 72|8@1+ (1,0) [0|0] "" HMDH_204
 SG_ Ping_VerMinor m5 : 80|8@1+ (1,0) [0|0] "" HMDH_204
 SG_ Ping_VerPatch m5 : 88|8@1+ (1,0) [0|0] "" HMDH_204
 SG_ Ping_Name0 m5 : 96|8@1+ (1,0) [0|0] "" HMDH_204
 SG_ Ping_Name1 m5 : 104|8@1+ (1,0) [0|0] "" HMDH_204
 SG_ Ping_Name2 m5 : 112|8@1+ (1,0) [0|0] "" HMDH_204
 SG_ Ping_Name3 m5 : 120|8@1+ (1,0) [0|0] "" HMDH_204
 SG_ Ping_Name4 m5 : 128|8@1+ (1,0) [0|0] "" HMDH_204
 SG_ Ping_Name5 m5 : 136|8@1+ (1,0) [0|0] "" HMDH_204
 SG_ Ping_Name6 m5 : 144|8@1+ (1,0) [0|0] "" HMDH_204
 SG_ Ping_Name7 m5 : 152|8@1+ (1,0) [0|0] "" HMDH_204
 SG_ Ping_Name8 m5 : 160|8@1+ (1,0) [0|0] "" HMDH_204
 SG_ Ping_Name9 m5 : 168|8@1+ (1,0) [0|0] "" HMDH_204
 SG_ Ping_Name10 m5 : 176|8@1+ (1,0) [0|0] "" HMDH_204
 SG_ Ping_Name11 m5 : 184|8@1+ (1,0) [0|0] "" HMDH_204
 SG_ Ping_Name12 m5 : 192|8@1+ (1,0) [0|0] "" HMDH_204
 SG_ Ping_Name13 m5 : 200|8@1+ (1,0) [0|0] "" HMDH_204
 SG_ Ping_Name14 m5 : 208|8@1+ (1,0) [0|0] "" HMDH_204
 SG_ Ping_Name15 m5 : 216|8@1+ (1,0) [0|0] "" HMDH_204
 SG_ Ping_FmtVer m5 : 224|8@1+ (1,0) [0|0] "" HMDH_204
 SG_ Ping_GitRev m5 : 232|32@1+ (1,0) [0|0] "" HMDH_204
 SG_ Ping_FwCrc m5 : 264|16@1+ (1,0) [0|0] "" HMDH_204
 SG_ Ping_UptimeS m5 : 280|16@1+ (1,0) [0|0] "s" HMDH_204
 SG_ Ecat_CanId m31 : 8|8@1+ (1,0) [0|0] "" HMDH_204
 SG_ Ecat_Name0 m31 : 16|8@1+ (1,0) [0|0] "" HMDH_204
 SG_ Ecat_Name1 m31 : 24|8@1+ (1,0) [0|0] "" HMDH_204
 SG_ Ecat_Name2 m31 : 32|8@1+ (1,0) [0|0] "" HMDH_204
 SG_ Ecat_Name3 m31 : 40|8@1+ (1,0) [0|0] "" HMDH_204
 SG_ Ecat_Name4 m31 : 48|8@1+ (1,0) [0|0] "" HMDH_204
 SG_ Ecat_Name5 m31 : 56|8@1+ (1,0) [0|0] "" HMDH_204
 SG_ Ecat_Name6 m31 : 64|8@1+ (1,0) [0|0] "" HMDH_204
 SG_ Ecat_Name7 m31 : 72|8@1+ (1,0) [0|0] "" HMDH_204
 SG_ Ecat_Name8 m31 : 80|8@1+ (1,0) [0|0] "" HMDH_204
 SG_ Ecat_Name9 m31 : 88|8@1+ (1,0) [0|0] "" HMDH_204
 SG_ Ecat_Name10 m31 : 96|8@1+ (1,0) [0|0] "" HMDH_204
 SG_ Ecat_Name11 m31 : 104|8@1+ (1,0) [0|0] "" HMDH_204
 SG_ Ecat_Name12 m31 : 112|8@1+ (1,0) [0|0] "" HMDH_204
 SG_ Ecat_Name13 m31 : 120|8@1+ (1,0) [0|0] "" HMDH_204
 SG_ Ecat_Name14 m31 : 128|8@1+ (1,0) [0|0] "" HMDH_204
 SG_ Ecat_Name15 m31 : 136|8@1+ (1,0) [0|0] "" HMDH_204
 SG_ Ecat_Link m31 : 144|8@1+ (1,0) [0|0] "" HMDH_204
 SG_ Ecat_InvalidFrame0 m31 : 152|8@1+ (1,0) [0|0] "" HMDH_204
 SG_ Ecat_InvalidFrame1 m31 : 160|8@1+ (1,0) [0|0] "" HMDH_204
 SG_ Ecat_InvalidFrame2 m31 : 168|8@1+ (1,0) [0|0] "" HMDH_204
 SG_ Ecat_InvalidFrame3 m31 : 176|8@1+ (1,0) [0|0] "" HMDH_204
 SG_ Ecat_RxError0 m31 : 184|8@1+ (1,0) [0|0] "" HMDH_204
 SG_ Ecat_RxError1 m31 : 192|8@1+ (1,0) [0|0] "" HMDH_204
 SG_ Ecat_RxError2 m31 : 200|8@1+ (1,0) [0|0] "" HMDH_204
 SG_ Ecat_RxError3 m31 : 208|8@1+ (1,0) [0|0] "" HMDH_204
 SG_ Ecat_FwdRxError0 m31 : 216|8@1+ (1,0) [0|0] "" HMDH_204
 SG_ Ecat_FwdRxError1 m31 : 224|8@1+ (1,0) [0|0] "" HMDH_204
 SG_ Ecat_FwdRxError2 m31 : 232|8@1+ (1,0) [0|0] "" HMDH_204
 SG_ Ecat_FwdRxError3 m31 : 240|8@1+ (1,0) [0|0] "" HMDH_204
 SG_ Ecat_PuError m31 : 248|8@1+ (1,0) [0|0] "" HMDH_204
 SG_ Ecat_PdiError m31 : 256|8@1+ (1,0) [0|0] "" HMDH_204
 SG_ Ecat_LostLink0 m31 : 264|8@1+ (1,0) [0|0] "" HMDH_204
 SG_ Ecat_LostLink1 m31 : 272|8@1+ (1,0) [0|0] "" HMDH_204
 SG_ Ecat_LostLink2 m31 : 280|8@1+ (1,0) [0|0] "" HMDH_204
 SG_ Ecat_LostLink3 m31 : 288|8@1+ (1,0) [0|0] "" HMDH_204
 SG_ Saf_CanId m32 : 8|8@1+ (1,0) [0|0] "" HMDH_204
 SG_ Saf_Name0 m32 : 16|8@1+ (1,0) [0|0] "" HMDH_204
 SG_ Saf_Name1 m32 : 24|8@1+ (1,0) [0|0] "" HMDH_204
 SG_ Saf_Name2 m32 : 32|8@1+ (1,0) [0|0] "" HMDH_204
 SG_ Saf_Name3 m32 : 40|8@1+ (1,0) [0|0] "" HMDH_204
 SG_ Saf_Name4 m32 : 48|8@1+ (1,0) [0|0] "" HMDH_204
 SG_ Saf_Name5 m32 : 56|8@1+ (1,0) [0|0] "" HMDH_204
 SG_ Saf_Name6 m32 : 64|8@1+ (1,0) [0|0] "" HMDH_204
 SG_ Saf_Name7 m32 : 72|8@1+ (1,0) [0|0] "" HMDH_204
 SG_ Saf_Name8 m32 : 80|8@1+ (1,0) [0|0] "" HMDH_204
 SG_ Saf_Name9 m32 : 88|8@1+ (1,0) [0|0] "" HMDH_204
 SG_ Saf_Name10 m32 : 96|8@1+ (1,0) [0|0] "" HMDH_204
 SG_ Saf_Name11 m32 : 104|8@1+ (1,0) [0|0] "" HMDH_204
 SG_ Saf_Name12 m32 : 112|8@1+ (1,0) [0|0] "" HMDH_204
 SG_ Saf_Name13 m32 : 120|8@1+ (1,0) [0|0] "" HMDH_204
 SG_ Saf_Name14 m32 : 128|8@1+ (1,0) [0|0] "" HMDH_204
 SG_ Saf_Name15 m32 : 136|8@1+ (1,0) [0|0] "" HMDH_204
 SG_ Saf_State m32 : 144|8@1+ (1,0) [0|0] "" HMDH_204
 SG_ Saf_Bits m32 : 152|16@1+ (1,0) [0|0] "" HMDH_204
 SG_ Saf_Estop m32 : 168|8@1+ (1,0) [0|0] "" HMDH_204
 SG_ Saf_FatalLatched m32 : 176|16@1+ (1,0) [0|0] "" HMDH_204
 SG_ Saf_ErrCode m32 : 192|32@1+ (1,0) [0|0] "" HMDH_204

BO_ 2163313869 STATUS_HETC_R_ARM_to_HMDH_205: 48 HETC_R_ARM
 SG_ SubCode M : 0|8@1+ (1,0) [0|0] "" HMDH_205
 SG_ Ping_CanId m5 : 8|8@1+ (1,0) [0|0] "" HMDH_205
 SG_ Ping_HostId m5 : 16|8@1+ (1,0) [0|0] "" HMDH_205
 SG_ Ping_Pid m5 : 24|16@1+ (1,0) [0|0] "" HMDH_205
 SG_ Ping_Bid m5 : 40|16@1+ (1,0) [0|0] "" HMDH_205
 SG_ Ping_Mid m5 : 56|16@1+ (1,0) [0|0] "" HMDH_205
 SG_ Ping_VerMajor m5 : 72|8@1+ (1,0) [0|0] "" HMDH_205
 SG_ Ping_VerMinor m5 : 80|8@1+ (1,0) [0|0] "" HMDH_205
 SG_ Ping_VerPatch m5 : 88|8@1+ (1,0) [0|0] "" HMDH_205
 SG_ Ping_Name0 m5 : 96|8@1+ (1,0) [0|0] "" HMDH_205
 SG_ Ping_Name1 m5 : 104|8@1+ (1,0) [0|0] "" HMDH_205
 SG_ Ping_Name2 m5 : 112|8@1+ (1,0) [0|0] "" HMDH_205
 SG_ Ping_Name3 m5 : 120|8@1+ (1,0) [0|0] "" HMDH_205
 SG_ Ping_Name4 m5 : 128|8@1+ (1,0) [0|0] "" HMDH_205
 SG_ Ping_Name5 m5 : 136|8@1+ (1,0) [0|0] "" HMDH_205
 SG_ Ping_Name6 m5 : 144|8@1+ (1,0) [0|0] "" HMDH_205
 SG_ Ping_Name7 m5 : 152|8@1+ (1,0) [0|0] "" HMDH_205
 SG_ Ping_Name8 m5 : 160|8@1+ (1,0) [0|0] "" HMDH_205
 SG_ Ping_Name9 m5 : 168|8@1+ (1,0) [0|0] "" HMDH_205
 SG_ Ping_Name10 m5 : 176|8@1+ (1,0) [0|0] "" HMDH_205
 SG_ Ping_Name11 m5 : 184|8@1+ (1,0) [0|0] "" HMDH_205
 SG_ Ping_Name12 m5 : 192|8@1+ (1,0) [0|0] "" HMDH_205
 SG_ Ping_Name13 m5 : 200|8@1+ (1,0) [0|0] "" HMDH_205
 SG_ Ping_Name14 m5 : 208|8@1+ (1,0) [0|0] "" HMDH_205
 SG_ Ping_Name15 m5 : 216|8@1+ (1,0) [0|0] "" HMDH_205
 SG_ Ping_FmtVer m5 : 224|8@1+ (1,0) [0|0] "" HMDH_205
 SG_ Ping_GitRev m5 : 232|32@1+ (1,0) [0|0] "" HMDH_205
 SG_ Ping_FwCrc m5 : 264|16@1+ (1,0) [0|0] "" HMDH_205
 SG_ Ping_UptimeS m5 : 280|16@1+ (1,0) [0|0] "s" HMDH_205
 SG_ Ecat_CanId m31 : 8|8@1+ (1,0) [0|0] "" HMDH_205
 SG_ Ecat_Name0 m31 : 16|8@1+ (1,0) [0|0] "" HMDH_205
 SG_ Ecat_Name1 m31 : 24|8@1+ (1,0) [0|0] "" HMDH_205
 SG_ Ecat_Name2 m31 : 32|8@1+ (1,0) [0|0] "" HMDH_205
 SG_ Ecat_Name3 m31 : 40|8@1+ (1,0) [0|0] "" HMDH_205
 SG_ Ecat_Name4 m31 : 48|8@1+ (1,0) [0|0] "" HMDH_205
 SG_ Ecat_Name5 m31 : 56|8@1+ (1,0) [0|0] "" HMDH_205
 SG_ Ecat_Name6 m31 : 64|8@1+ (1,0) [0|0] "" HMDH_205
 SG_ Ecat_Name7 m31 : 72|8@1+ (1,0) [0|0] "" HMDH_205
 SG_ Ecat_Name8 m31 : 80|8@1+ (1,0) [0|0] "" HMDH_205
 SG_ Ecat_Name9 m31 : 88|8@1+ (1,0) [0|0] "" HMDH_205
 SG_ Ecat_Name10 m31 : 96|8@1+ (1,0) [0|0] "" HMDH_205
 SG_ Ecat_Name11 m31 : 104|8@1+ (1,0) [0|0] "" HMDH_205
 SG_ Ecat_Name12 m31 : 112|8@1+ (1,0) [0|0] "" HMDH_205
 SG_ Ecat_Name13 m31 : 120|8@1+ (1,0) [0|0] "" HMDH_205
 SG_ Ecat_Name14 m31 : 128|8@1+ (1,0) [0|0] "" HMDH_205
 SG_ Ecat_Name15 m31 : 136|8@1+ (1,0) [0|0] "" HMDH_205
 SG_ Ecat_Link m31 : 144|8@1+ (1,0) [0|0] "" HMDH_205
 SG_ Ecat_InvalidFrame0 m31 : 152|8@1+ (1,0) [0|0] "" HMDH_205
 SG_ Ecat_InvalidFrame1 m31 : 160|8@1+ (1,0) [0|0] "" HMDH_205
 SG_ Ecat_InvalidFrame2 m31 : 168|8@1+ (1,0) [0|0] "" HMDH_205
 SG_ Ecat_InvalidFrame3 m31 : 176|8@1+ (1,0) [0|0] "" HMDH_205
 SG_ Ecat_RxError0 m31 : 184|8@1+ (1,0) [0|0] "" HMDH_205
 SG_ Ecat_RxError1 m31 : 192|8@1+ (1,0) [0|0] "" HMDH_205
 SG_ Ecat_RxError2 m31 : 200|8@1+ (1,0) [0|0] "" HMDH_205
 SG_ Ecat_RxError3 m31 : 208|8@1+ (1,0) [0|0] "" HMDH_205
 SG_ Ecat_FwdRxError0 m31 : 216|8@1+ (1,0) [0|0] "" HMDH_205
 SG_ Ecat_FwdRxError1 m31 : 224|8@1+ (1,0) [0|0] "" HMDH_205
 SG_ Ecat_FwdRxError2 m31 : 232|8@1+ (1,0) [0|0] "" HMDH_205
 SG_ Ecat_FwdRxError3 m31 : 240|8@1+ (1,0) [0|0] "" HMDH_205
 SG_ Ecat_PuError m31 : 248|8@1+ (1,0) [0|0] "" HMDH_205
 SG_ Ecat_PdiError m31 : 256|8@1+ (1,0) [0|0] "" HMDH_205
 SG_ Ecat_LostLink0 m31 : 264|8@1+ (1,0) [0|0] "" HMDH_205
 SG_ Ecat_LostLink1 m31 : 272|8@1+ (1,0) [0|0] "" HMDH_205
 SG_ Ecat_LostLink2 m31 : 280|8@1+ (1,0) [0|0] "" HMDH_205
 SG_ Ecat_LostLink3 m31 : 288|8@1+ (1,0) [0|0] "" HMDH_205
 SG_ Saf_CanId m32 : 8|8@1+ (1,0) [0|0] "" HMDH_205
 SG_ Saf_Name0 m32 : 16|8@1+ (1,0) [0|0] "" HMDH_205
 SG_ Saf_Name1 m32 : 24|8@1+ (1,0) [0|0] "" HMDH_205
 SG_ Saf_Name2 m32 : 32|8@1+ (1,0) [0|0] "" HMDH_205
 SG_ Saf_Name3 m32 : 40|8@1+ (1,0) [0|0] "" HMDH_205
 SG_ Saf_Name4 m32 : 48|8@1+ (1,0) [0|0] "" HMDH_205
 SG_ Saf_Name5 m32 : 56|8@1+ (1,0) [0|0] "" HMDH_205
 SG_ Saf_Name6 m32 : 64|8@1+ (1,0) [0|0] "" HMDH_205
 SG_ Saf_Name7 m32 : 72|8@1+ (1,0) [0|0] "" HMDH_205
 SG_ Saf_Name8 m32 : 80|8@1+ (1,0) [0|0] "" HMDH_205
 SG_ Saf_Name9 m32 : 88|8@1+ (1,0) [0|0] "" HMDH_205
 SG_ Saf_Name10 m32 : 96|8@1+ (1,0) [0|0] "" HMDH_205
 SG_ Saf_Name11 m32 : 104|8@1+ (1,0) [0|0] "" HMDH_205
 SG_ Saf_Name12 m32 : 112|8@1+ (1,0) [0|0] "" HMDH_205
 SG_ Saf_Name13 m32 : 120|8@1+ (1,0) [0|0] "" HMDH_205
 SG_ Saf_Name14 m32 : 128|8@1+ (1,0) [0|0] "" HMDH_205
 SG_ Saf_Name15 m32 : 136|8@1+ (1,0) [0|0] "" HMDH_205
 SG_ Saf_State m32 : 144|8@1+ (1,0) [0|0] "" HMDH_205
 SG_ Saf_Bits m32 : 152|16@1+ (1,0) [0|0] "" HMDH_205
 SG_ Saf_Estop m32 : 168|8@1+ (1,0) [0|0] "" HMDH_205
 SG_ Saf_FatalLatched m32 : 176|16@1+ (1,0) [0|0] "" HMDH_205
 SG_ Saf_ErrCode m32 : 192|32@1+ (1,0) [0|0] "" HMDH_205

BO_ 2163313870 STATUS_HETC_R_ARM_to_HMDH_206: 48 HETC_R_ARM
 SG_ SubCode M : 0|8@1+ (1,0) [0|0] "" HMDH_206
 SG_ Ping_CanId m5 : 8|8@1+ (1,0) [0|0] "" HMDH_206
 SG_ Ping_HostId m5 : 16|8@1+ (1,0) [0|0] "" HMDH_206
 SG_ Ping_Pid m5 : 24|16@1+ (1,0) [0|0] "" HMDH_206
 SG_ Ping_Bid m5 : 40|16@1+ (1,0) [0|0] "" HMDH_206
 SG_ Ping_Mid m5 : 56|16@1+ (1,0) [0|0] "" HMDH_206
 SG_ Ping_VerMajor m5 : 72|8@1+ (1,0) [0|0] "" HMDH_206
 SG_ Ping_VerMinor m5 : 80|8@1+ (1,0) [0|0] "" HMDH_206
 SG_ Ping_VerPatch m5 : 88|8@1+ (1,0) [0|0] "" HMDH_206
 SG_ Ping_Name0 m5 : 96|8@1+ (1,0) [0|0] "" HMDH_206
 SG_ Ping_Name1 m5 : 104|8@1+ (1,0) [0|0] "" HMDH_206
 SG_ Ping_Name2 m5 : 112|8@1+ (1,0) [0|0] "" HMDH_206
 SG_ Ping_Name3 m5 : 120|8@1+ (1,0) [0|0] "" HMDH_206
 SG_ Ping_Name4 m5 : 128|8@1+ (1,0) [0|0] "" HMDH_206
 SG_ Ping_Name5 m5 : 136|8@1+ (1,0) [0|0] "" HMDH_206
 SG_ Ping_Name6 m5 : 144|8@1+ (1,0) [0|0] "" HMDH_206
 SG_ Ping_Name7 m5 : 152|8@1+ (1,0) [0|0] "" HMDH_206
 SG_ Ping_Name8 m5 : 160|8@1+ (1,0) [0|0] "" HMDH_206
 SG_ Ping_Name9 m5 : 168|8@1+ (1,0) [0|0] "" HMDH_206
 SG_ Ping_Name10 m5 : 176|8@1+ (1,0) [0|0] "" HMDH_206
 SG_ Ping_Name11 m5 : 184|8@1+ (1,0) [0|0] "" HMDH_206
 SG_ Ping_Name12 m5 : 192|8@1+ (1,0) [0|0] "" HMDH_206
 SG_ Ping_Name13 m5 : 200|8@1+ (1,0) [0|0] "" HMDH_206
 SG_ Ping_Name14 m5 : 208|8@1+ (1,0) [0|0] "" HMDH_206
 SG_ Ping_Name15 m5 : 216|8@1+ (1,0) [0|0] "" HMDH_206
 SG_ Ping_FmtVer m5 : 224|8@1+ (1,0) [0|0] "" HMDH_206
 SG_ Ping_GitRev m5 : 232|32@1+ (1,0) [0|0] "" HMDH_206
 SG_ Ping_FwCrc m5 : 264|16@1+ (1,0) [0|0] "" HMDH_206
 SG_ Ping_UptimeS m5 : 280|16@1+ (1,0) [0|0] "s" HMDH_206
 SG_ Ecat_CanId m31 : 8|8@1+ (1,0) [0|0] "" HMDH_206
 SG_ Ecat_Name0 m31 : 16|8@1+ (1,0) [0|0] "" HMDH_206
 SG_ Ecat_Name1 m31 : 24|8@1+ (1,0) [0|0] "" HMDH_206
 SG_ Ecat_Name2 m31 : 32|8@1+ (1,0) [0|0] "" HMDH_206
 SG_ Ecat_Name3 m31 : 40|8@1+ (1,0) [0|0] "" HMDH_206
 SG_ Ecat_Name4 m31 : 48|8@1+ (1,0) [0|0] "" HMDH_206
 SG_ Ecat_Name5 m31 : 56|8@1+ (1,0) [0|0] "" HMDH_206
 SG_ Ecat_Name6 m31 : 64|8@1+ (1,0) [0|0] "" HMDH_206
 SG_ Ecat_Name7 m31 : 72|8@1+ (1,0) [0|0] "" HMDH_206
 SG_ Ecat_Name8 m31 : 80|8@1+ (1,0) [0|0] "" HMDH_206
 SG_ Ecat_Name9 m31 : 88|8@1+ (1,0) [0|0] "" HMDH_206
 SG_ Ecat_Name10 m31 : 96|8@1+ (1,0) [0|0] "" HMDH_206
 SG_ Ecat_Name11 m31 : 104|8@1+ (1,0) [0|0] "" HMDH_206
 SG_ Ecat_Name12 m31 : 112|8@1+ (1,0) [0|0] "" HMDH_206
 SG_ Ecat_Name13 m31 : 120|8@1+ (1,0) [0|0] "" HMDH_206
 SG_ Ecat_Name14 m31 : 128|8@1+ (1,0) [0|0] "" HMDH_206
 SG_ Ecat_Name15 m31 : 136|8@1+ (1,0) [0|0] "" HMDH_206
 SG_ Ecat_Link m31 : 144|8@1+ (1,0) [0|0] "" HMDH_206
 SG_ Ecat_InvalidFrame0 m31 : 152|8@1+ (1,0) [0|0] "" HMDH_206
 SG_ Ecat_InvalidFrame1 m31 : 160|8@1+ (1,0) [0|0] "" HMDH_206
 SG_ Ecat_InvalidFrame2 m31 : 168|8@1+ (1,0) [0|0] "" HMDH_206
 SG_ Ecat_InvalidFrame3 m31 : 176|8@1+ (1,0) [0|0] "" HMDH_206
 SG_ Ecat_RxError0 m31 : 184|8@1+ (1,0) [0|0] "" HMDH_206
 SG_ Ecat_RxError1 m31 : 192|8@1+ (1,0) [0|0] "" HMDH_206
 SG_ Ecat_RxError2 m31 : 200|8@1+ (1,0) [0|0] "" HMDH_206
 SG_ Ecat_RxError3 m31 : 208|8@1+ (1,0) [0|0] "" HMDH_206
 SG_ Ecat_FwdRxError0 m31 : 216|8@1+ (1,0) [0|0] "" HMDH_206
 SG_ Ecat_FwdRxError1 m31 : 224|8@1+ (1,0) [0|0] "" HMDH_206
 SG_ Ecat_FwdRxError2 m31 : 232|8@1+ (1,0) [0|0] "" HMDH_206
 SG_ Ecat_FwdRxError3 m31 : 240|8@1+ (1,0) [0|0] "" HMDH_206
 SG_ Ecat_PuError m31 : 248|8@1+ (1,0) [0|0] "" HMDH_206
 SG_ Ecat_PdiError m31 : 256|8@1+ (1,0) [0|0] "" HMDH_206
 SG_ Ecat_LostLink0 m31 : 264|8@1+ (1,0) [0|0] "" HMDH_206
 SG_ Ecat_LostLink1 m31 : 272|8@1+ (1,0) [0|0] "" HMDH_206
 SG_ Ecat_LostLink2 m31 : 280|8@1+ (1,0) [0|0] "" HMDH_206
 SG_ Ecat_LostLink3 m31 : 288|8@1+ (1,0) [0|0] "" HMDH_206
 SG_ Saf_CanId m32 : 8|8@1+ (1,0) [0|0] "" HMDH_206
 SG_ Saf_Name0 m32 : 16|8@1+ (1,0) [0|0] "" HMDH_206
 SG_ Saf_Name1 m32 : 24|8@1+ (1,0) [0|0] "" HMDH_206
 SG_ Saf_Name2 m32 : 32|8@1+ (1,0) [0|0] "" HMDH_206
 SG_ Saf_Name3 m32 : 40|8@1+ (1,0) [0|0] "" HMDH_206
 SG_ Saf_Name4 m32 : 48|8@1+ (1,0) [0|0] "" HMDH_206
 SG_ Saf_Name5 m32 : 56|8@1+ (1,0) [0|0] "" HMDH_206
 SG_ Saf_Name6 m32 : 64|8@1+ (1,0) [0|0] "" HMDH_206
 SG_ Saf_Name7 m32 : 72|8@1+ (1,0) [0|0] "" HMDH_206
 SG_ Saf_Name8 m32 : 80|8@1+ (1,0) [0|0] "" HMDH_206
 SG_ Saf_Name9 m32 : 88|8@1+ (1,0) [0|0] "" HMDH_206
 SG_ Saf_Name10 m32 : 96|8@1+ (1,0) [0|0] "" HMDH_206
 SG_ Saf_Name11 m32 : 104|8@1+ (1,0) [0|0] "" HMDH_206
 SG_ Saf_Name12 m32 : 112|8@1+ (1,0) [0|0] "" HMDH_206
 SG_ Saf_Name13 m32 : 120|8@1+ (1,0) [0|0] "" HMDH_206
 SG_ Saf_Name14 m32 : 128|8@1+ (1,0) [0|0] "" HMDH_206
 SG_ Saf_Name15 m32 : 136|8@1+ (1,0) [0|0] "" HMDH_206
 SG_ Saf_State m32 : 144|8@1+ (1,0) [0|0] "" HMDH_206
 SG_ Saf_Bits m32 : 152|16@1+ (1,0) [0|0] "" HMDH_206
 SG_ Saf_Estop m32 : 168|8@1+ (1,0) [0|0] "" HMDH_206
 SG_ Saf_FatalLatched m32 : 176|16@1+ (1,0) [0|0] "" HMDH_206
 SG_ Saf_ErrCode m32 : 192|32@1+ (1,0) [0|0] "" HMDH_206

CM_ BO_ 2163308674 "diagnostic response";
CM_ BO_ 2163308684 "diagnostic response";
CM_ BO_ 2163308694 "diagnostic response";
CM_ BO_ 2163308745 "diagnostic response";
CM_ BO_ 2163308746 "diagnostic response";
CM_ BO_ 2163308747 "diagnostic response";
CM_ BO_ 2163308748 "diagnostic response";
CM_ BO_ 2163308749 "diagnostic response";
CM_ BO_ 2163308750 "diagnostic response";
CM_ BO_ 2163308751 "diagnostic response";
CM_ BO_ 2163311204 "diagnostic response";
CM_ BO_ 2163311214 "diagnostic response";
CM_ BO_ 2163311224 "diagnostic response";
CM_ BO_ 2163311244 "diagnostic response";
CM_ BO_ 2163311254 "diagnostic response";
CM_ BO_ 2163311305 "diagnostic response";
CM_ BO_ 2163311306 "diagnostic response";
CM_ BO_ 2163311307 "diagnostic response";
CM_ BO_ 2163311308 "diagnostic response";
CM_ BO_ 2163311309 "diagnostic response";
CM_ BO_ 2163311310 "diagnostic response";
CM_ BO_ 2163311311 "diagnostic response";
CM_ BO_ 2163313764 "diagnostic response";
CM_ BO_ 2163313774 "diagnostic response";
CM_ BO_ 2163313784 "diagnostic response";
CM_ BO_ 2163313794 "diagnostic response";
CM_ BO_ 2163313814 "diagnostic response";
CM_ BO_ 2163313865 "diagnostic response";
CM_ BO_ 2163313866 "diagnostic response";
CM_ BO_ 2163313867 "diagnostic response";
CM_ BO_ 2163313868 "diagnostic response";
CM_ BO_ 2163313869 "diagnostic response";
CM_ BO_ 2163313870 "diagnostic response";
BA_DEF_ BO_ "GenMsgCycleTime" INT 0 65535;
BA_DEF_ BO_ "VFrameFormat" ENUM "StandardCAN","ExtendedCAN","reserved","reserved","reserved","reserved","reserved","reserved","reserved","reserved","reserved","reserved","reserved","reserved","StandardCAN_FD","ExtendedCAN_FD";
BA_DEF_ BO_ "CANFD_BRS" ENUM "0","1";
BA_DEF_ BO_ "SubCodeCycles" STRING ;
BA_DEF_ BO_ "SubCodeLengths" STRING ;
BA_DEF_DEF_ "GenMsgCycleTime" 0;
BA_DEF_DEF_ "VFrameFormat" "ExtendedCAN_FD";
BA_DEF_DEF_ "CANFD_BRS" "1";
BA_DEF_DEF_ "SubCodeCycles" "";
BA_DEF_DEF_ "SubCodeLengths" "";
BA_ "SubCodeLengths" BO_ 2163308674 "5:37;31:37;32:28";
BA_ "SubCodeLengths" BO_ 2163308684 "5:37;31:37;32:28";
BA_ "SubCodeLengths" BO_ 2163308694 "5:37;31:37;32:28";
BA_ "SubCodeLengths" BO_ 2163308745 "5:37;31:37;32:28";
BA_ "SubCodeLengths" BO_ 2163308746 "5:37;31:37;32:28";
BA_ "SubCodeLengths" BO_ 2163308747 "5:37;31:37;32:28";
BA_ "SubCodeLengths" BO_ 2163308748 "5:37;31:37;32:28";
BA_ "SubCodeLengths" BO_ 2163308749 "5:37;31:37;32:28";
BA_ "SubCodeLengths" BO_ 2163308750 "5:37;31:37;32:28";
BA_ "SubCodeLengths" BO_ 2163308751 "5:37;31:37;32:28";
BA_ "SubCodeLengths" BO_ 2163311204 "5:37;31:37;32:28";
BA_ "SubCodeLengths" BO_ 2163311214 "5:37;31:37;32:28";
BA_ "SubCodeLengths" BO_ 2163311224 "5:37;31:37;32:28";
BA_ "SubCodeLengths" BO_ 2163311244 "5:37;31:37;32:28";
BA_ "SubCodeLengths" BO_ 2163311254 "5:37;31:37;32:28";
BA_ "SubCodeLengths" BO_ 2163311305 "5:37;31:37;32:28";
BA_ "SubCodeLengths" BO_ 2163311306 "5:37;31:37;32:28";
BA_ "SubCodeLengths" BO_ 2163311307 "5:37;31:37;32:28";
BA_ "SubCodeLengths" BO_ 2163311308 "5:37;31:37;32:28";
BA_ "SubCodeLengths" BO_ 2163311309 "5:37;31:37;32:28";
BA_ "SubCodeLengths" BO_ 2163311310 "5:37;31:37;32:28";
BA_ "SubCodeLengths" BO_ 2163311311 "5:37;31:37;32:28";
BA_ "SubCodeLengths" BO_ 2163313764 "5:37;31:37;32:28";
BA_ "SubCodeLengths" BO_ 2163313774 "5:37;31:37;32:28";
BA_ "SubCodeLengths" BO_ 2163313784 "5:37;31:37;32:28";
BA_ "SubCodeLengths" BO_ 2163313794 "5:37;31:37;32:28";
BA_ "SubCodeLengths" BO_ 2163313814 "5:37;31:37;32:28";
BA_ "SubCodeLengths" BO_ 2163313865 "5:37;31:37;32:28";
BA_ "SubCodeLengths" BO_ 2163313866 "5:37;31:37;32:28";
BA_ "SubCodeLengths" BO_ 2163313867 "5:37;31:37;32:28";
BA_ "SubCodeLengths" BO_ 2163313868 "5:37;31:37;32:28";
BA_ "SubCodeLengths" BO_ 2163313869 "5:37;31:37;32:28";
BA_ "SubCodeLengths" BO_ 2163313870 "5:37;31:37;32:28";
VAL_ 2163308674 SubCode 34 "POWER" 33 "THOR" 32 "SAFETY" 31 "ECAT_ERR" 30 "BUZZER_CFG" 27 "ANGLE_MULTI" 26 "BAT_LATCH" 25 "SAFETY_SENSOR" 22 "HRMC" 19 "TOF" 18 "USS" 17 "ANGLE" 9 "TACTILE_G2" 5 "PING" ;
VAL_ 2163308674 Saf_State 4 "RESETTING" 3 "FAULT" 2 "STOPPED" 1 "STOPPING" 0 "NORMAL" ;
VAL_ 2163308684 SubCode 34 "POWER" 33 "THOR" 32 "SAFETY" 31 "ECAT_ERR" 30 "BUZZER_CFG" 27 "ANGLE_MULTI" 26 "BAT_LATCH" 25 "SAFETY_SENSOR" 22 "HRMC" 19 "TOF" 18 "USS" 17 "ANGLE" 9 "TACTILE_G2" 5 "PING" ;
VAL_ 2163308684 Saf_State 4 "RESETTING" 3 "FAULT" 2 "STOPPED" 1 "STOPPING" 0 "NORMAL" ;
VAL_ 2163308694 SubCode 34 "POWER" 33 "THOR" 32 "SAFETY" 31 "ECAT_ERR" 30 "BUZZER_CFG" 27 "ANGLE_MULTI" 26 "BAT_LATCH" 25 "SAFETY_SENSOR" 22 "HRMC" 19 "TOF" 18 "USS" 17 "ANGLE" 9 "TACTILE_G2" 5 "PING" ;
VAL_ 2163308694 Saf_State 4 "RESETTING" 3 "FAULT" 2 "STOPPED" 1 "STOPPING" 0 "NORMAL" ;
VAL_ 2163308745 SubCode 34 "POWER" 33 "THOR" 32 "SAFETY" 31 "ECAT_ERR" 30 "BUZZER_CFG" 27 "ANGLE_MULTI" 26 "BAT_LATCH" 25 "SAFETY_SENSOR" 22 "HRMC" 19 "TOF" 18 "USS" 17 "ANGLE" 9 "TACTILE_G2" 5 "PING" ;
VAL_ 2163308745 Saf_State 4 "RESETTING" 3 "FAULT" 2 "STOPPED" 1 "STOPPING" 0 "NORMAL" ;
VAL_ 2163308746 SubCode 34 "POWER" 33 "THOR" 32 "SAFETY" 31 "ECAT_ERR" 30 "BUZZER_CFG" 27 "ANGLE_MULTI" 26 "BAT_LATCH" 25 "SAFETY_SENSOR" 22 "HRMC" 19 "TOF" 18 "USS" 17 "ANGLE" 9 "TACTILE_G2" 5 "PING" ;
VAL_ 2163308746 Saf_State 4 "RESETTING" 3 "FAULT" 2 "STOPPED" 1 "STOPPING" 0 "NORMAL" ;
VAL_ 2163308747 SubCode 34 "POWER" 33 "THOR" 32 "SAFETY" 31 "ECAT_ERR" 30 "BUZZER_CFG" 27 "ANGLE_MULTI" 26 "BAT_LATCH" 25 "SAFETY_SENSOR" 22 "HRMC" 19 "TOF" 18 "USS" 17 "ANGLE" 9 "TACTILE_G2" 5 "PING" ;
VAL_ 2163308747 Saf_State 4 "RESETTING" 3 "FAULT" 2 "STOPPED" 1 "STOPPING" 0 "NORMAL" ;
VAL_ 2163308748 SubCode 34 "POWER" 33 "THOR" 32 "SAFETY" 31 "ECAT_ERR" 30 "BUZZER_CFG" 27 "ANGLE_MULTI" 26 "BAT_LATCH" 25 "SAFETY_SENSOR" 22 "HRMC" 19 "TOF" 18 "USS" 17 "ANGLE" 9 "TACTILE_G2" 5 "PING" ;
VAL_ 2163308748 Saf_State 4 "RESETTING" 3 "FAULT" 2 "STOPPED" 1 "STOPPING" 0 "NORMAL" ;
VAL_ 2163308749 SubCode 34 "POWER" 33 "THOR" 32 "SAFETY" 31 "ECAT_ERR" 30 "BUZZER_CFG" 27 "ANGLE_MULTI" 26 "BAT_LATCH" 25 "SAFETY_SENSOR" 22 "HRMC" 19 "TOF" 18 "USS" 17 "ANGLE" 9 "TACTILE_G2" 5 "PING" ;
VAL_ 2163308749 Saf_State 4 "RESETTING" 3 "FAULT" 2 "STOPPED" 1 "STOPPING" 0 "NORMAL" ;
VAL_ 2163308750 SubCode 34 "POWER" 33 "THOR" 32 "SAFETY" 31 "ECAT_ERR" 30 "BUZZER_CFG" 27 "ANGLE_MULTI" 26 "BAT_LATCH" 25 "SAFETY_SENSOR" 22 "HRMC" 19 "TOF" 18 "USS" 17 "ANGLE" 9 "TACTILE_G2" 5 "PING" ;
VAL_ 2163308750 Saf_State 4 "RESETTING" 3 "FAULT" 2 "STOPPED" 1 "STOPPING" 0 "NORMAL" ;
VAL_ 2163308751 SubCode 34 "POWER" 33 "THOR" 32 "SAFETY" 31 "ECAT_ERR" 30 "BUZZER_CFG" 27 "ANGLE_MULTI" 26 "BAT_LATCH" 25 "SAFETY_SENSOR" 22 "HRMC" 19 "TOF" 18 "USS" 17 "ANGLE" 9 "TACTILE_G2" 5 "PING" ;
VAL_ 2163308751 Saf_State 4 "RESETTING" 3 "FAULT" 2 "STOPPED" 1 "STOPPING" 0 "NORMAL" ;
VAL_ 2163311204 SubCode 34 "POWER" 33 "THOR" 32 "SAFETY" 31 "ECAT_ERR" 30 "BUZZER_CFG" 27 "ANGLE_MULTI" 26 "BAT_LATCH" 25 "SAFETY_SENSOR" 22 "HRMC" 19 "TOF" 18 "USS" 17 "ANGLE" 9 "TACTILE_G2" 5 "PING" ;
VAL_ 2163311204 Saf_State 4 "RESETTING" 3 "FAULT" 2 "STOPPED" 1 "STOPPING" 0 "NORMAL" ;
VAL_ 2163311214 SubCode 34 "POWER" 33 "THOR" 32 "SAFETY" 31 "ECAT_ERR" 30 "BUZZER_CFG" 27 "ANGLE_MULTI" 26 "BAT_LATCH" 25 "SAFETY_SENSOR" 22 "HRMC" 19 "TOF" 18 "USS" 17 "ANGLE" 9 "TACTILE_G2" 5 "PING" ;
VAL_ 2163311214 Saf_State 4 "RESETTING" 3 "FAULT" 2 "STOPPED" 1 "STOPPING" 0 "NORMAL" ;
VAL_ 2163311224 SubCode 34 "POWER" 33 "THOR" 32 "SAFETY" 31 "ECAT_ERR" 30 "BUZZER_CFG" 27 "ANGLE_MULTI" 26 "BAT_LATCH" 25 "SAFETY_SENSOR" 22 "HRMC" 19 "TOF" 18 "USS" 17 "ANGLE" 9 "TACTILE_G2" 5 "PING" ;
VAL_ 2163311224 Saf_State 4 "RESETTING" 3 "FAULT" 2 "STOPPED" 1 "STOPPING" 0 "NORMAL" ;
VAL_ 2163311244 SubCode 34 "POWER" 33 "THOR" 32 "SAFETY" 31 "ECAT_ERR" 30 "BUZZER_CFG" 27 "ANGLE_MULTI" 26 "BAT_LATCH" 25 "SAFETY_SENSOR" 22 "HRMC" 19 "TOF" 18 "USS" 17 "ANGLE" 9 "TACTILE_G2" 5 "PING" ;
VAL_ 2163311244 Saf_State 4 "RESETTING" 3 "FAULT" 2 "STOPPED" 1 "STOPPING" 0 "NORMAL" ;
VAL_ 2163311254 SubCode 34 "POWER" 33 "THOR" 32 "SAFETY" 31 "ECAT_ERR" 30 "BUZZER_CFG" 27 "ANGLE_MULTI" 26 "BAT_LATCH" 25 "SAFETY_SENSOR" 22 "HRMC" 19 "TOF" 18 "USS" 17 "ANGLE" 9 "TACTILE_G2" 5 "PING" ;
VAL_ 2163311254 Saf_State 4 "RESETTING" 3 "FAULT" 2 "STOPPED" 1 "STOPPING" 0 "NORMAL" ;
VAL_ 2163311305 SubCode 34 "POWER" 33 "THOR" 32 "SAFETY" 31 "ECAT_ERR" 30 "BUZZER_CFG" 27 "ANGLE_MULTI" 26 "BAT_LATCH" 25 "SAFETY_SENSOR" 22 "HRMC" 19 "TOF" 18 "USS" 17 "ANGLE" 9 "TACTILE_G2" 5 "PING" ;
VAL_ 2163311305 Saf_State 4 "RESETTING" 3 "FAULT" 2 "STOPPED" 1 "STOPPING" 0 "NORMAL" ;
VAL_ 2163311306 SubCode 34 "POWER" 33 "THOR" 32 "SAFETY" 31 "ECAT_ERR" 30 "BUZZER_CFG" 27 "ANGLE_MULTI" 26 "BAT_LATCH" 25 "SAFETY_SENSOR" 22 "HRMC" 19 "TOF" 18 "USS" 17 "ANGLE" 9 "TACTILE_G2" 5 "PING" ;
VAL_ 2163311306 Saf_State 4 "RESETTING" 3 "FAULT" 2 "STOPPED" 1 "STOPPING" 0 "NORMAL" ;
VAL_ 2163311307 SubCode 34 "POWER" 33 "THOR" 32 "SAFETY" 31 "ECAT_ERR" 30 "BUZZER_CFG" 27 "ANGLE_MULTI" 26 "BAT_LATCH" 25 "SAFETY_SENSOR" 22 "HRMC" 19 "TOF" 18 "USS" 17 "ANGLE" 9 "TACTILE_G2" 5 "PING" ;
VAL_ 2163311307 Saf_State 4 "RESETTING" 3 "FAULT" 2 "STOPPED" 1 "STOPPING" 0 "NORMAL" ;
VAL_ 2163311308 SubCode 34 "POWER" 33 "THOR" 32 "SAFETY" 31 "ECAT_ERR" 30 "BUZZER_CFG" 27 "ANGLE_MULTI" 26 "BAT_LATCH" 25 "SAFETY_SENSOR" 22 "HRMC" 19 "TOF" 18 "USS" 17 "ANGLE" 9 "TACTILE_G2" 5 "PING" ;
VAL_ 2163311308 Saf_State 4 "RESETTING" 3 "FAULT" 2 "STOPPED" 1 "STOPPING" 0 "NORMAL" ;
VAL_ 2163311309 SubCode 34 "POWER" 33 "THOR" 32 "SAFETY" 31 "ECAT_ERR" 30 "BUZZER_CFG" 27 "ANGLE_MULTI" 26 "BAT_LATCH" 25 "SAFETY_SENSOR" 22 "HRMC" 19 "TOF" 18 "USS" 17 "ANGLE" 9 "TACTILE_G2" 5 "PING" ;
VAL_ 2163311309 Saf_State 4 "RESETTING" 3 "FAULT" 2 "STOPPED" 1 "STOPPING" 0 "NORMAL" ;
VAL_ 2163311310 SubCode 34 "POWER" 33 "THOR" 32 "SAFETY" 31 "ECAT_ERR" 30 "BUZZER_CFG" 27 "ANGLE_MULTI" 26 "BAT_LATCH" 25 "SAFETY_SENSOR" 22 "HRMC" 19 "TOF" 18 "USS" 17 "ANGLE" 9 "TACTILE_G2" 5 "PING" ;
VAL_ 2163311310 Saf_State 4 "RESETTING" 3 "FAULT" 2 "STOPPED" 1 "STOPPING" 0 "NORMAL" ;
VAL_ 2163311311 SubCode 34 "POWER" 33 "THOR" 32 "SAFETY" 31 "ECAT_ERR" 30 "BUZZER_CFG" 27 "ANGLE_MULTI" 26 "BAT_LATCH" 25 "SAFETY_SENSOR" 22 "HRMC" 19 "TOF" 18 "USS" 17 "ANGLE" 9 "TACTILE_G2" 5 "PING" ;
VAL_ 2163311311 Saf_State 4 "RESETTING" 3 "FAULT" 2 "STOPPED" 1 "STOPPING" 0 "NORMAL" ;
VAL_ 2163313764 SubCode 34 "POWER" 33 "THOR" 32 "SAFETY" 31 "ECAT_ERR" 30 "BUZZER_CFG" 27 "ANGLE_MULTI" 26 "BAT_LATCH" 25 "SAFETY_SENSOR" 22 "HRMC" 19 "TOF" 18 "USS" 17 "ANGLE" 9 "TACTILE_G2" 5 "PING" ;
VAL_ 2163313764 Saf_State 4 "RESETTING" 3 "FAULT" 2 "STOPPED" 1 "STOPPING" 0 "NORMAL" ;
VAL_ 2163313774 SubCode 34 "POWER" 33 "THOR" 32 "SAFETY" 31 "ECAT_ERR" 30 "BUZZER_CFG" 27 "ANGLE_MULTI" 26 "BAT_LATCH" 25 "SAFETY_SENSOR" 22 "HRMC" 19 "TOF" 18 "USS" 17 "ANGLE" 9 "TACTILE_G2" 5 "PING" ;
VAL_ 2163313774 Saf_State 4 "RESETTING" 3 "FAULT" 2 "STOPPED" 1 "STOPPING" 0 "NORMAL" ;
VAL_ 2163313784 SubCode 34 "POWER" 33 "THOR" 32 "SAFETY" 31 "ECAT_ERR" 30 "BUZZER_CFG" 27 "ANGLE_MULTI" 26 "BAT_LATCH" 25 "SAFETY_SENSOR" 22 "HRMC" 19 "TOF" 18 "USS" 17 "ANGLE" 9 "TACTILE_G2" 5 "PING" ;
VAL_ 2163313784 Saf_State 4 "RESETTING" 3 "FAULT" 2 "STOPPED" 1 "STOPPING" 0 "NORMAL" ;
VAL_ 2163313794 SubCode 34 "POWER" 33 "THOR" 32 "SAFETY" 31 "ECAT_ERR" 30 "BUZZER_CFG" 27 "ANGLE_MULTI" 26 "BAT_LATCH" 25 "SAFETY_SENSOR" 22 "HRMC" 19 "TOF" 18 "USS" 17 "ANGLE" 9 "TACTILE_G2" 5 "PING" ;
VAL_ 2163313794 Saf_State 4 "RESETTING" 3 "FAULT" 2 "STOPPED" 1 "STOPPING" 0 "NORMAL" ;
VAL_ 2163313814 SubCode 34 "POWER" 33 "THOR" 32 "SAFETY" 31 "ECAT_ERR" 30 "BUZZER_CFG" 27 "ANGLE_MULTI" 26 "BAT_LATCH" 25 "SAFETY_SENSOR" 22 "HRMC" 19 "TOF" 18 "USS" 17 "ANGLE" 9 "TACTILE_G2" 5 "PING" ;
VAL_ 2163313814 Saf_State 4 "RESETTING" 3 "FAULT" 2 "STOPPED" 1 "STOPPING" 0 "NORMAL" ;
VAL_ 2163313865 SubCode 34 "POWER" 33 "THOR" 32 "SAFETY" 31 "ECAT_ERR" 30 "BUZZER_CFG" 27 "ANGLE_MULTI" 26 "BAT_LATCH" 25 "SAFETY_SENSOR" 22 "HRMC" 19 "TOF" 18 "USS" 17 "ANGLE" 9 "TACTILE_G2" 5 "PING" ;
VAL_ 2163313865 Saf_State 4 "RESETTING" 3 "FAULT" 2 "STOPPED" 1 "STOPPING" 0 "NORMAL" ;
VAL_ 2163313866 SubCode 34 "POWER" 33 "THOR" 32 "SAFETY" 31 "ECAT_ERR" 30 "BUZZER_CFG" 27 "ANGLE_MULTI" 26 "BAT_LATCH" 25 "SAFETY_SENSOR" 22 "HRMC" 19 "TOF" 18 "USS" 17 "ANGLE" 9 "TACTILE_G2" 5 "PING" ;
VAL_ 2163313866 Saf_State 4 "RESETTING" 3 "FAULT" 2 "STOPPED" 1 "STOPPING" 0 "NORMAL" ;
VAL_ 2163313867 SubCode 34 "POWER" 33 "THOR" 32 "SAFETY" 31 "ECAT_ERR" 30 "BUZZER_CFG" 27 "ANGLE_MULTI" 26 "BAT_LATCH" 25 "SAFETY_SENSOR" 22 "HRMC" 19 "TOF" 18 "USS" 17 "ANGLE" 9 "TACTILE_G2" 5 "PING" ;
VAL_ 2163313867 Saf_State 4 "RESETTING" 3 "FAULT" 2 "STOPPED" 1 "STOPPING" 0 "NORMAL" ;
VAL_ 2163313868 SubCode 34 "POWER" 33 "THOR" 32 "SAFETY" 31 "ECAT_ERR" 30 "BUZZER_CFG" 27 "ANGLE_MULTI" 26 "BAT_LATCH" 25 "SAFETY_SENSOR" 22 "HRMC" 19 "TOF" 18 "USS" 17 "ANGLE" 9 "TACTILE_G2" 5 "PING" ;
VAL_ 2163313868 Saf_State 4 "RESETTING" 3 "FAULT" 2 "STOPPED" 1 "STOPPING" 0 "NORMAL" ;
VAL_ 2163313869 SubCode 34 "POWER" 33 "THOR" 32 "SAFETY" 31 "ECAT_ERR" 30 "BUZZER_CFG" 27 "ANGLE_MULTI" 26 "BAT_LATCH" 25 "SAFETY_SENSOR" 22 "HRMC" 19 "TOF" 18 "USS" 17 "ANGLE" 9 "TACTILE_G2" 5 "PING" ;
VAL_ 2163313869 Saf_State 4 "RESETTING" 3 "FAULT" 2 "STOPPED" 1 "STOPPING" 0 "NORMAL" ;
VAL_ 2163313870 SubCode 34 "POWER" 33 "THOR" 32 "SAFETY" 31 "ECAT_ERR" 30 "BUZZER_CFG" 27 "ANGLE_MULTI" 26 "BAT_LATCH" 25 "SAFETY_SENSOR" 22 "HRMC" 19 "TOF" 18 "USS" 17 "ANGLE" 9 "TACTILE_G2" 5 "PING" ;
VAL_ 2163313870 Saf_State 4 "RESETTING" 3 "FAULT" 2 "STOPPED" 1 "STOPPING" 0 "NORMAL" ;
